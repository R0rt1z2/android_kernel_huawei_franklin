#include "huawei-audio.dtsi"
#include "huawei-storage.dtsi"
#include "huawei-charger.dtsi"
#include "huawei-tp.dtsi"
#include "huawei-camera.dtsi"
#include "huawei-lcd.dtsi"
#include "huawei-led.dtsi"
#include "huawei-nfc.dtsi"
#include "huawei-irda.dtsi"
#include "huawei-sensor.dtsi"
#include "huawei-fingerprint.dtsi"
#include "huawei-wifi.dtsi"
#include "huawei-rf.dtsi"
#include "huawei-reserved-tee-mem.dtsi"
#include "huawei-key.dtsi"
#include "huawei_bastet.dtsi"
