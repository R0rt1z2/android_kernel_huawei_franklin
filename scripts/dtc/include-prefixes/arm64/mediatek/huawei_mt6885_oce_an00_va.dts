#include <dt-bindings/interrupt-controller/irq.h>
#include <dt-bindings/interrupt-controller/arm-gic.h>
#include <dt-bindings/spmi/spmi.h>
#include <dt-bindings/pinctrl/mt6885-pinfunc.h>
/dts-v1/;
/plugin/;

#include "huawei_mt6885_oce_an00_va/huawei.dtsi"

&rootparam {
    mtk,boardid = <4 4 0 0>;
    mtk,board_name = "OCE_AN00_VA";
    mtk,product_name = "OCE-AN00";
    hardware_version = "HN1OCETM01";
};

&display_share_mem {
	compatible = "delicon,desharemem";
	status = "ok";
};

/*
 * Each set of pins contains the pin number and pins voltage
 * values, and must end with the names _num and _val.
 */
&gpio_check {
	buckle_num = "15 77 101";
	buckle_val = "0 0 0";
};

#include <huawei_mt6889_oce/cust.dtsi>

/*End of this file, DO NOT ADD ANYTHING HERE*/
