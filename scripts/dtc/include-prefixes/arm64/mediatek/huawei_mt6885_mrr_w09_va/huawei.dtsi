#include "huawei-charger.dtsi"
#include "huawei-sim.dtsi"
#include "huawei-led.dtsi"
#include "huawei-lcd.dtsi"
#include "huawei-tp.dtsi"
#include "huawei-sensor.dtsi"
#include "huawei-camera.dtsi"
#include "huawei-audio.dtsi"