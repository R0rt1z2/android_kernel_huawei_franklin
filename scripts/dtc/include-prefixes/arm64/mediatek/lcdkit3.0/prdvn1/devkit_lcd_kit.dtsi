/*---------------------------------------------------------------------------
 * This file is autogenerated file using huawei LCD parser. Please do not edit it.
 * Update input XML file to add a new entry or update variable in this file
 * Parser location: vendor/huawei/chipset_common/devkit/lcdkit/tools 
 *---------------------------------------------------------------------------*/


#include "prdvn1_110_208_6p6_d0.dtsi"
#include "prdvn1_110_208_6p6_d1.dtsi"
#include "prdvn1_190_208_6p6_d0.dtsi"
#include "prdvn1_190_208_6p6_d1.dtsi"
#include "prdvn1_300_208_6p6_d0.dtsi"
#include "prdvn1_300_208_6p6_d1.dtsi"
#include "prdvn1_auo_otm1901a_5p2_1080p_video_default.dtsi"