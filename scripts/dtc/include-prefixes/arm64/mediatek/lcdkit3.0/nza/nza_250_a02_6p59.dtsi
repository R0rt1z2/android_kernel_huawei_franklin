/* Copyright (c) 2013, The Linux Foundation. All rights reserved.
 *
 * This program is free software; you can redistribute it and/or modify
 * it under the terms of the GNU General Public License version 2 and
 * only version 2 as published by the Free Software Foundation.
 *
 * This program is distributed in the hope that it will be useful,
 * but WITHOUT ANY WARRANTY; without even the implied warranty of
 * MERCHANTABILITY or FITNESS FOR A PARTICULAR PURPOSE.  See the
 * GNU General Public License for more details.
 */

/*-------------------------------------------------------------------------
 * This file is autogenerated file using gcdb parser. Please do not edit it.
 * Update input XML file to add a new entry or update variable in this file
 * VERSION = 1.1
 *-----------------------------------------------------------------------*/
&huawei_lcd_config {
	dsi_nza_250_a02_6p59: lcd_kit_nza_250_a02_6p59 {
		compatible = "250_a02_6p59";
		lcd-kit,panel-name = "250_A02 6.59' VIDEO 720 x 1600";
		lcd-kit,panel-type = <0x01>;
		lcd-kit,panel-xres = <720>;
		lcd-kit,panel-yres = <1600>;
		lcd-kit,panel-width = <68>;
		lcd-kit,panel-height = <152>;
		lcd-kit,panel-on-cmds = <0x29 0x01 0x00 0x00 0x0a 0x00 0x04 0xFF 0x98 0x81 0x06
			0x15 0x01 0x00 0x00 0x0a 0x00 0x02 0x3E 0x60
			0x29 0x01 0x00 0x00 0x0a 0x00 0x04 0xFF 0x98 0x81 0x05
			0x15 0x01 0x00 0x00 0x0a 0x00 0x02 0x19 0xB1
			0x29 0x01 0x00 0x00 0x0a 0x00 0x04 0xFF 0x98 0x81 0x02
			0x15 0x01 0x00 0x00 0x0a 0x00 0x02 0x01 0x35
			0x15 0x01 0x00 0x00 0x0a 0x00 0x02 0x02 0x0A
			0x29 0x01 0x00 0x00 0x0a 0x00 0x04 0xFF 0x98 0x81 0x00
			0x05 0x01 0x00 0x00 0x50 0x01 0x01 0x11
			0x05 0x01 0x00 0x00 0x14 0x01 0x01 0x29>;
		lcd-kit,panel-off-cmds = <0x05 0x01 0x00 0x00 0x14 0x01 0x01 0x28
		0x05 0x01 0x00 0x00 0x64 0x01 0x01 0x10>;
		lcd-kit,inversion-dot-cmds = <0x29 0x01 0x00 0x00 0x00 0x00 0x04 0xFF 0x98 0x81 0x02
		0x15 0x01 0x00 0x00 0x00 0x00 0x02 0x44 0x03
		0x29 0x01 0x00 0x00 0x00 0x00 0x04 0xFF 0x98 0x81 0x00>;
		lcd-kit,inversion-column-cmds = <0x29 0x01 0x00 0x00 0x00 0x00 0x04 0xFF 0x98 0x81 0x02
		0x15 0x01 0x00 0x00 0x00 0x00 0x02 0x44 0x08
		0x29 0x01 0x00 0x00 0x00 0x00 0x04 0xFF 0x98 0x81 0x00>;
		lcd-kit,esd-reg-cmds = <0x06 0x01 0x00 0x00 0x0a 0x00 0x01 0x0a
		0x06 0x01 0x00 0x00 0x0a 0x00 0x01 0x0d
		0x06 0x01 0x00 0x00 0x0a 0x00 0x01 0x0b>;
		lcd-kit,esd-reg-cmds-state = "dsi_lp_mode";
		lcd-kit,esd-value = <0x9c 0x00 0x00>;
		lcd-kit,check-reg-cmds = <0x06 0x01 0x00 0x00 0x0a 0x00 0x01 0x0a>;
		lcd-kit,check-reg-cmds-state = "dsi_lp_mode";
		lcd-kit,check-reg-value = <0x9c>;
		lcd-kit,barcode-2d-cmds-state = "dsi_lp_mode";
		lcd-kit,barcode-2d-cmds = <0x29 0x01 0x00 0x00 0x0a 0x00 0x04 0xFF 0x98 0x81 0x0D
		0x06 0x01 0x00 0x00 0x0a 0x00 0x01 0x00
		0x06 0x01 0x00 0x00 0x0a 0x00 0x01 0x01
		0x06 0x01 0x00 0x00 0x0a 0x00 0x01 0x02
		0x06 0x01 0x00 0x00 0x0a 0x00 0x01 0x03
		0x06 0x01 0x00 0x00 0x0a 0x00 0x01 0x04
		0x06 0x01 0x00 0x00 0x0a 0x00 0x01 0x05
		0x06 0x01 0x00 0x00 0x0a 0x00 0x01 0x06
		0x06 0x01 0x00 0x00 0x0a 0x00 0x01 0x07
		0x06 0x01 0x00 0x00 0x0a 0x00 0x01 0x08
		0x06 0x01 0x00 0x00 0x0a 0x00 0x01 0x09
		0x06 0x01 0x00 0x00 0x0a 0x00 0x01 0x0a
		0x06 0x01 0x00 0x00 0x0a 0x00 0x01 0x0b
		0x06 0x01 0x00 0x00 0x0a 0x00 0x01 0x0c
		0x06 0x01 0x00 0x00 0x0a 0x00 0x01 0x0d
		0x06 0x01 0x00 0x00 0x0a 0x00 0x01 0x0e
		0x06 0x01 0x00 0x00 0x0a 0x00 0x01 0x0f
		0x06 0x01 0x00 0x00 0x0a 0x00 0x01 0x10
		0x06 0x01 0x00 0x00 0x0a 0x00 0x01 0x11
		0x06 0x01 0x00 0x00 0x0a 0x00 0x01 0x12
		0x06 0x01 0x00 0x00 0x0a 0x00 0x01 0x13
		0x06 0x01 0x00 0x00 0x0a 0x00 0x01 0x14
		0x29 0x01 0x00 0x00 0x0a 0x00 0x04 0xFF 0x98 0x81 0x00>;
		lcd-kit,project-id-cmds = <0x29 0x01 0x00 0x00 0x0a 0x00 0x04 0xFF 0x98 0x81 0x0D
		0x06 0x01 0x00 0x00 0x0a 0x00 0x01 0x15
		0x06 0x01 0x00 0x00 0x0a 0x00 0x01 0x16
		0x06 0x01 0x00 0x00 0x0a 0x00 0x01 0x17
		0x06 0x01 0x00 0x00 0x0a 0x00 0x01 0x18
		0x06 0x01 0x00 0x00 0x0a 0x00 0x01 0x19
		0x06 0x01 0x00 0x00 0x0a 0x00 0x01 0x1a
		0x06 0x01 0x00 0x00 0x0a 0x00 0x01 0x1b
		0x06 0x01 0x00 0x00 0x0a 0x00 0x01 0x1c
		0x06 0x01 0x00 0x00 0x0a 0x00 0x01 0x1d
		0x06 0x01 0x00 0x00 0x0a 0x00 0x01 0x1e
		0x29 0x01 0x00 0x00 0x0a 0x00 0x04 0xFF 0x98 0x81 0x00>;
		lcd-kit,project-id-cmds-state = "dsi_lp_mode";
		lcd-kit,panel-bl-maxnit-command = <0x06 0x01 0x00 0x00 0x0a 0x00 0x01 0xdb>;
		lcd-kit,panel-bl-maxnit-command-state = "dsi_lp_mode";
		lcd-kit,lcd-btb-support = <0>;
		lcd-kit,lcd-btb-check-type = <0>;
		lcd-kit,lcd-btb-gpio = <73 76>;
		lcd-kit,panel-lcm-type = <2>;
		lcd-kit,panel-ldi-dsi-mode = <1>;
		lcd-kit,panel-dsi-switch-mode = <0>;
		lcd-kit,panel-dsi-switch-mode-en = <0>;
		lcd-kit,panel-ldi-trans-seq = <0>;
		lcd-kit,panel-ldi-data-padding = <0>;
		lcd-kit,panel-ldi-packet-size = <256>;
		lcd-kit,panel-ldi-ps = <2>;
		lcd-kit,panel-vfp-lp = <0>;
		lcd-kit,panel-fbk-div = <1>;
		lcd-kit,panel-orientation = <1>;
		lcd-kit,panel-bpp = <2>;
		lcd-kit,panel-bgr-fmt = <0>;
		lcd-kit,panel-cmd-type = <8>;
		lcd-kit,panel-pxl-clk = <0>;
		lcd-kit,panel-pxl-clk-div = <0>;
		lcd-kit,panel-data-rate = <726>;
		lcd-kit,mipi-lane-nums = <3>;
		lcd-kit,h-back-porch = <20>;
		lcd-kit,h-front-porch = <20>;
		lcd-kit,h-pulse-width = <4>;
		lcd-kit,project-id-support = <1>;
		lcd-kit,default-project-id = "G21579250";
		lcd-kit,v-back-porch = <18>;
		lcd-kit,v-front-porch = <250>;
		lcd-kit,v-pulse-width = <4>;
		lcd-kit,mipi-clk-post-adjust = <0>;
		lcd-kit,mipi-lp11-flag = <0>;
		lcd-kit,esd-support = <1>;
		lcd-kit,skip-poweron-esd-check = <0>;
		lcd-kit,esd-recovery-bl-support = <1>;
		lcd-kit,thp-proximity-support = <0>;
		lcd-kit,tp-color-support = <0>;
		lcd-kit,lcd-vsp = <2 137 6000000>;
		lcd-kit,lcd-vsn = <2 138 6000000>;
		lcd-kit,lcd-reset = <2 86 0>;
		lcd-kit,power-on-stage = <11 1 1
				5 2 2
				3 1 1
				4 1 11
				5 1 6
				5 2 2
				5 1 11
				7 1 0
				8 1 0
				6 1 0>;
		lcd-kit,lp-on-stage = <0 0 0>;
		lcd-kit,hs-on-stage = <0 0 0>;
		lcd-kit,hs-off-stage = <0 0 0>;
		lcd-kit,lp-off-stage = <0 0 0>;
		lcd-kit,power-off-stage = <7 0 0
				6 0 0
				8 0 0
				4 0 2
				3 0 5>;
		lcd-kit,only-power-off-stage = <0 0 0>;
		lcd-kit,pt-support = <1>;
		lcd-kit,panel-density = <320>;
		lcd-kit,ssc-disable = <1>;
		lcd-kit,inversion-support = <1>;
		lcd-kit,check-reg-support = <1>;
		lcd-kit,panel-bl-min = <53>;
		lcd-kit,panel-bl-max = <6000>;
		lcd-kit,panel-bl-max-nit = <450>;
		lcd-kit,panel-bl-boot = <234>;
		lcd-kit,mipi-non-continue-enable = <1>;
		lcd-kit,panel-getblmaxnit-type = <1>;
		lcd-kit,panel-bl-ic-ctrl-type = <6>;
		lcd-kit,panel-bias-ic-ctrl-type = <3>;
		lcd-kit,oem-info-support = <1>;
		lcd-kit,oem-barcode-2d-support = <1>;
		lcd-kit,oem-barcode-2d-num-offset = <0>;
		lcd-kit,panel-on-always-reset = <1>;
		lcd-kit,panel-gpio-offset = <300>;
		lcd-kit,backlight-order = <0>;
		lcd-kit,fps-support = <0>;
		lcd-kit,dsc-enable = <0>;
		lcd-kit,dsc-ver = <17>;
		lcd-kit,dsc-slice-mode = <1>;
		lcd-kit,dsc-rgb-swap = <0>;
		lcd-kit,dsc-cfg = <34>;
		lcd-kit,dsc-rct-on = <1>;
		lcd-kit,dsc-bit-per-channel = <8>;
		lcd-kit,dsc-line-buf-depth = <9>;
		lcd-kit,dsc-bp-enable = <1>;
		lcd-kit,dsc-bit-per-pixel = <128>;
		lcd-kit,dsc-pic-height = <2400>;
		lcd-kit,dsc-pic-width = <1080>;
		lcd-kit,dsc-slice-height = <20>;
		lcd-kit,dsc-slice-width = <540>;
		lcd-kit,dsc-chunk-size = <540>;
		lcd-kit,dsc-xmit-delay = <512>;
		lcd-kit,dsc-dec-delay = <526>;
		lcd-kit,dsc-scale-value = <32>;
		lcd-kit,dsc-increment-interval = <488>;
		lcd-kit,dsc-decrement-interval = <7>;
		lcd-kit,dsc-line-bpg-offset = <12>;
		lcd-kit,dsc-nfl-bpg-offset = <1294>;
		lcd-kit,dsc-slice-bpg-offset = <1302>;
		lcd-kit,dsc-initial-offset = <6144>;
		lcd-kit,dsc-final-offset = <4336>;
		lcd-kit,dsc-flatness-minqp = <3>;
		lcd-kit,dsc-flatness-maxqp = <12>;
		lcd-kit,dsc-rc-model-size = <8192>;
		lcd-kit,dsc-rc-edge-factor = <6>;
		lcd-kit,dsc-rc-quant-incr-limit0 = <11>;
		lcd-kit,dsc-rc-quant-incr-limit1 = <11>;
		lcd-kit,dsc-rc-tgt-offset-hi = <3>;
		lcd-kit,dsc-rc-tgt-offset-lo = <3>;
		lcd-kit,vetical-refresh = <60>;
		lcd-kit,inversion-column-cmds-state = "dsi_lp_mode";
		lcd-kit,inversion-dot-cmds-state = "dsi_lp_mode";
		lcd-kit,quickly-sleep-out-support = <0>;
		lcd-kit,quickly-sleep-out-interval = <0>;
		lcd-kit,mipi-hop-h-back-porch = <10>;
		lcd-kit,mipi-hop-h-front-porch = <32>;
		lcd-kit,mipi-hop-h-pulse-width = <10>;
		lcd-kit,mipi-hop-v-back-porch = <60>;
		lcd-kit,mipi-hop-v-front-porch = <14>;
		lcd-kit,mipi-hop-v-pulse-width = <30>;
		lcd-kit,mipi-hop-lp-v-front-porch = <14>;
		lcd-kit,Does-lcd-poweron-tp = <0>;
		lcd-kit,mipi-hop-support = <0>;
		lcd-kit,mipi-read-gerneric = <1>;
		lcd-kit,rgbw-support = <0>;
		lcd-kit,imax-lcd-luminance = <500>;
		lcd-kit,imin-lcd-luminance = <3>;
		lcd-kit,panel-blmaxnit-min-value = <400>;
		lcd-kit,mtk-high-left-time-th-us = <5000>;
		lcd-kit,mtk-high-right-time-th-us = <9000>;
		lcd-kit,mtk-high-te-inerval-time-us = <11111>;
		lcd-kit,mtk-low-left-time-th-us = <9000>;
		lcd-kit,mtk-low-right-time-th-us = <15000>;
		lcd-kit,mtk-low-te-inerval-time-us = <16667>;
		lcd-kit,sn-code-support = <0>;
		lcd-kit,panel-round-corner-enable = <0>;
		lcd-kit,panel-round-corner-full-content = <0>;
		lcd-kit,panel-round-corner-h = <0>;
		lcd-kit,panel-round-corner-h-bot = <0>;
    };
};