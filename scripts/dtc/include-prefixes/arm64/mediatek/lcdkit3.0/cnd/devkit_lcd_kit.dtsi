/*---------------------------------------------------------------------------
 * This file is autogenerated file using huawei LCD parser. Please do not edit it.
 * Update input XML file to add a new entry or update variable in this file
 * Parser location: vendor/huawei/chipset_common/devkit/lcdkit/tools 
 *---------------------------------------------------------------------------*/


#include "cnd_110_203_6p5.dtsi"
#include "cnd_191_101_6p5.dtsi"
#include "cnd_290_203_6p5.dtsi"
#include "cnd_auo_otm1901a_5p2_1080p_video_default.dtsi"