/*---------------------------------------------------------------------------
 * This file is autogenerated file using huawei LCD parser. Please do not edit it.
 * Update input XML file to add a new entry or update variable in this file
 * Parser location: vendor/huawei/chipset_common/devkit/lcdkit/tools 
 *---------------------------------------------------------------------------*/


#include "chl_110_208_6p6.dtsi"
#include "chl_190_208_6p6.dtsi"
#include "chl_300_208_6p6.dtsi"
#include "chl_auo_otm1901a_5p2_1080p_video_default.dtsi"