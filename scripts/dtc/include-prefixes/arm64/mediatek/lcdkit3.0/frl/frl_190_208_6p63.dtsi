/* Copyright (c) 2013, The Linux Foundation. All rights reserved.
 *
 * This program is free software; you can redistribute it and/or modify
 * it under the terms of the GNU General Public License version 2 and
 * only version 2 as published by the Free Software Foundation.
 *
 * This program is distributed in the hope that it will be useful,
 * but WITHOUT ANY WARRANTY; without even the implied warranty of
 * MERCHANTABILITY or FITNESS FOR A PARTICULAR PURPOSE.  See the
 * GNU General Public License for more details.
 */

/*-------------------------------------------------------------------------
 * This file is autogenerated file using gcdb parser. Please do not edit it.
 * Update input XML file to add a new entry or update variable in this file
 * VERSION = 1.1
 *-----------------------------------------------------------------------*/
&huawei_lcd_config {
	dsi_frl_190_208_6p63: lcd_kit_frl_190_208_6p63 {
		compatible = "190_208_6p63_1080p_video";
		lcd-kit,panel-name = "190_208 6.63' VIDEO 1080 x 2400";
		lcd-kit,panel-type = <0x01>;
		lcd-kit,panel-xres = <1080>;
		lcd-kit,panel-yres = <2400>;
		lcd-kit,panel-width = <69>;
		lcd-kit,panel-height = <154>;
		lcd-kit,panel-on-cmds = <0x15 0x01 0x00 0x00 0x0a 0x00 0x02 0xFF 0x25
		0x15 0x01 0x00 0x00 0x0a 0x00 0x02 0xFB 0x01
		0x15 0x01 0x00 0x00 0x0a 0x00 0x02 0x21 0x40
		0x15 0x01 0x00 0x00 0x0a 0x00 0x02 0x18 0x20
		0x15 0x01 0x00 0x00 0x0a 0x00 0x02 0xBD 0x01
		0x15 0x01 0x00 0x00 0x0a 0x00 0x02 0x91 0x1F
		0x15 0x01 0x00 0x00 0x0a 0x00 0x02 0x92 0x0F
		0x15 0x01 0x00 0x00 0x0a 0x00 0x02 0x94 0x18
		0x15 0x01 0x00 0x00 0x0a 0x00 0x02 0x95 0x03
		0x15 0x01 0x00 0x00 0x0a 0x00 0x02 0x96 0x01
		0x15 0x01 0x00 0x00 0x0a 0x00 0x02 0x93 0x01
		0x15 0x01 0x00 0x00 0x0a 0x00 0x02 0xFF 0x26
		0x15 0x01 0x00 0x00 0x0a 0x00 0x02 0xFB 0x01
		0x15 0x01 0x00 0x00 0x0a 0x00 0x02 0x01 0xF4
		0x15 0x01 0x00 0x00 0x0a 0x00 0x02 0x02 0xF4
		0x15 0x01 0x00 0x00 0x0a 0x00 0x02 0x04 0xF4
		0x15 0x01 0x00 0x00 0x0a 0x00 0x02 0x06 0x1B
		0x15 0x01 0x00 0x00 0x0a 0x00 0x02 0x07 0x1B
		0x15 0x01 0x00 0x00 0x0a 0x00 0x02 0x08 0x1B
		0x15 0x01 0x00 0x00 0x0a 0x00 0x02 0x81 0x14
		0x15 0x01 0x00 0x00 0x0a 0x00 0x02 0x83 0x05
		0x15 0x01 0x00 0x00 0x0a 0x00 0x02 0x88 0x02
		0x15 0x01 0x00 0x00 0x0a 0x00 0x02 0x9B 0x16
		0x15 0x01 0x00 0x00 0x0a 0x00 0x02 0xFF 0x2A
		0x15 0x01 0x00 0x00 0x0a 0x00 0x02 0xFB 0x01
		0x15 0x01 0x00 0x00 0x0a 0x00 0x02 0x00 0xD1
		0x15 0x01 0x00 0x00 0x0a 0x00 0x02 0x07 0x50
		0x15 0x01 0x00 0x00 0x0a 0x00 0x02 0x0C 0x09
		0x15 0x01 0x00 0x00 0x0a 0x00 0x02 0x0D 0x40
		0x15 0x01 0x00 0x00 0x0a 0x00 0x02 0x11 0xEF
		0x15 0x01 0x00 0x00 0x0a 0x00 0x02 0x15 0x0F
		0x15 0x01 0x00 0x00 0x0a 0x00 0x02 0x16 0x41
		0x15 0x01 0x00 0x00 0x0a 0x00 0x02 0x19 0x0E
		0x15 0x01 0x00 0x00 0x0a 0x00 0x02 0x1A 0xBD
		0x15 0x01 0x00 0x00 0x0a 0x00 0x02 0x1F 0x58
		0x15 0x01 0x00 0x00 0x0a 0x00 0x02 0x28 0xC6
		0x15 0x01 0x00 0x00 0x0a 0x00 0x02 0x2A 0x2B
		0x15 0x01 0x00 0x00 0x0a 0x00 0x02 0x30 0x45
		0x15 0x01 0x00 0x00 0x0a 0x00 0x02 0x32 0x32
		0x15 0x01 0x00 0x00 0x0a 0x00 0x02 0x33 0x7C
		0x15 0x01 0x00 0x00 0x0a 0x00 0x02 0x34 0xC8
		0x15 0x01 0x00 0x00 0x0a 0x00 0x02 0x35 0x32
		0x15 0x01 0x00 0x00 0x0a 0x00 0x02 0x36 0x1A
		0x15 0x01 0x00 0x00 0x0a 0x00 0x02 0x37 0xC3
		0x15 0x01 0x00 0x00 0x0a 0x00 0x02 0x38 0x35
		0x15 0x01 0x00 0x00 0x0a 0x00 0x02 0x39 0x17
		0x15 0x01 0x00 0x00 0x0a 0x00 0x02 0x3A 0x45
		0x15 0x01 0x00 0x00 0x0a 0x00 0x02 0x45 0x09
		0x15 0x01 0x00 0x00 0x0a 0x00 0x02 0x46 0x40
		0x15 0x01 0x00 0x00 0x0a 0x00 0x02 0x4A 0xEF
		0x15 0x01 0x00 0x00 0x0a 0x00 0x02 0x4E 0x0F
		0x15 0x01 0x00 0x00 0x0a 0x00 0x02 0x4F 0x41
		0x15 0x01 0x00 0x00 0x0a 0x00 0x02 0x52 0x0E
		0x15 0x01 0x00 0x00 0x0a 0x00 0x02 0x53 0xBD
		0x15 0x01 0x00 0x00 0x0a 0x00 0x02 0x58 0x85
		0x15 0x01 0x00 0x00 0x0a 0x00 0x02 0xF0 0xF8
		0x15 0x01 0x00 0x00 0x0a 0x00 0x02 0xF1 0xF8
		0x15 0x01 0x00 0x00 0x0a 0x00 0x02 0xFF 0x2C
		0x15 0x01 0x00 0x00 0x0a 0x00 0x02 0xFB 0x01
		0x15 0x01 0x00 0x00 0x0a 0x00 0x02 0x30 0xF4
		0x15 0x01 0x00 0x00 0x0a 0x00 0x02 0x31 0xF4
		0x15 0x01 0x00 0x00 0x0a 0x00 0x02 0x33 0xF4
		0x15 0x01 0x00 0x00 0x0a 0x00 0x02 0x35 0x26
		0x15 0x01 0x00 0x00 0x0a 0x00 0x02 0x36 0x26
		0x15 0x01 0x00 0x00 0x0a 0x00 0x02 0x37 0x26
		0x15 0x01 0x00 0x00 0x0a 0x00 0x02 0x4D 0x20
		0x15 0x01 0x00 0x00 0x0a 0x00 0x02 0x4E 0x05
		0x15 0x01 0x00 0x00 0x0a 0x00 0x02 0x4F 0x0D
		0x15 0x01 0x00 0x00 0x0a 0x00 0x02 0xFF 0xE0
		0x15 0x01 0x00 0x00 0x0a 0x00 0x02 0xFB 0x01
		0x15 0x01 0x00 0x00 0x0a 0x00 0x02 0x35 0x82
		0x15 0x01 0x00 0x00 0x0a 0x00 0x02 0xFF 0xF0
		0x15 0x01 0x00 0x00 0x0a 0x00 0x02 0xFB 0x01
		0x15 0x01 0x00 0x00 0x0a 0x00 0x02 0x5A 0x00
		0x15 0x01 0x00 0x00 0x0a 0x00 0x02 0xBE 0x08
		0x15 0x01 0x00 0x00 0x0a 0x00 0x02 0xD2 0x50
		0x15 0x01 0x00 0x00 0x0a 0x00 0x02 0x84 0x08
		0x15 0x01 0x00 0x00 0x0a 0x00 0x02 0x85 0x0C
		0x15 0x01 0x00 0x00 0x0a 0x00 0x02 0xFF 0xD0
		0x15 0x01 0x00 0x00 0x0a 0x00 0x02 0xFB 0x01
		0x15 0x01 0x00 0x00 0x0a 0x00 0x02 0x09 0xAD
		0x15 0x01 0x00 0x00 0x0a 0x00 0x02 0xFF 0xC0
		0x15 0x01 0x00 0x00 0x0a 0x00 0x02 0xFB 0x01
		0x15 0x01 0x00 0x00 0x0a 0x00 0x02 0x9C 0x11
		0x15 0x01 0x00 0x00 0x0a 0x00 0x02 0x9D 0x11
		0x15 0x01 0x00 0x00 0x0a 0x00 0x02 0xFF 0x10
		0x15 0x01 0x00 0x00 0x0a 0x00 0x02 0xFB 0x01
		0x39 0x01 0x00 0x00 0x0a 0x00 0x11 0xC1 0x89 0x28 0x00 0x14 0x02 0x00 0x02 0x0E 0x01 0xE8 0x00 0x07 0x05 0x0E 0x05 0x16
		0x39 0x01 0x00 0x00 0x0a 0x00 0x03 0xC2 0x10 0xF0
		0x15 0x01 0x00 0x00 0x0a 0x00 0x02 0xC0 0x03
		0x05 0x01 0x00 0x00 0x0a 0x01 0x02 0x11 0x00
		0x05 0x01 0x00 0x00 0x00 0x00 0x02 0x29 0x00>;
		lcd-kit,panel-on-cmds-state = "dsi_lp_mode";
		lcd-kit,panel-off-cmds = <0x05 0x01 0x00 0x00 0x78 0x01 0x02 0x28 0x00>;
		lcd-kit,panel-off-cmds-state = "dsi_lp_mode";
		lcd-kit,tp-color-cmds = <0x15 0x01 0x00 0x00 0x0a 0x00 0x02 0xFF 0x21
		0x15 0x01 0x00 0x00 0x0a 0x00 0x02 0xFB 0x01
		0x06 0x01 0x00 0x00 0x0a 0x00 0x01 0xda
		0x15 0x01 0x00 0x00 0x0a 0x00 0x02 0xFF 0x10>;
		lcd-kit,inversion-dot-cmds = <0x15 0x01 0x00 0x00 0x0a 0x00 0x02 0xFF 0x24
		0x15 0x01 0x00 0x00 0x0a 0x00 0x02 0xFB 0x01
		0x15 0x01 0x00 0x00 0x0a 0x00 0x02 0xCF 0x00
		0x15 0x01 0x00 0x00 0x0a 0x00 0x02 0xFF 0x10>;
		lcd-kit,inversion-column-cmds = <0x15 0x01 0x00 0x00 0x0a 0x00 0x02 0xFF 0x24
		0x15 0x01 0x00 0x00 0x0a 0x00 0x02 0xFB 0x01
		0x15 0x01 0x00 0x00 0x0a 0x00 0x02 0xCF 0xFF
		0x15 0x01 0x00 0x00 0x0a 0x00 0x02 0xFF 0x10>;
		lcd-kit,scan-forword-cmds = <0x15 0x01 0x00 0x00 0x0a 0x00 0x02 0xFF 0x10
		0x15 0x01 0x00 0x00 0x0a 0x00 0x02 0xFB 0x01
		0x15 0x01 0x00 0x00 0x0a 0x00 0x02 0x36 0x00
		0x15 0x01 0x00 0x00 0x0a 0x00 0x02 0xFF 0x10>;
		lcd-kit,scan-revert-cmds = <0x15 0x01 0x00 0x00 0x0a 0x00 0x02 0xFF 0x10
		0x15 0x01 0x00 0x00 0x0a 0x00 0x02 0xFB 0x01
		0x15 0x01 0x00 0x00 0x0a 0x00 0x02 0x36 0x03
		0x15 0x01 0x00 0x00 0x0a 0x00 0x02 0xFF 0x10>;
		lcd-kit,scan-revert-cmds-state = "dsi_lp_mode";
		lcd-kit,scan-forword-cmds-state = "dsi_lp_mode";
		lcd-kit,esd-reg-cmds = <0x06 0x01 0x00 0x00 0x0a 0x00 0x01 0x0a
		0x06 0x01 0x00 0x00 0x0a 0x00 0x01 0x0d
		0x06 0x01 0x00 0x00 0x0a 0x00 0x01 0xc1>;
		lcd-kit,esd-reg-cmds-state = "dsi_hs_mode";
		lcd-kit,esd-value = <0x9c 0x00 0x89>;
		lcd-kit,check-reg-cmds = <0x06 0x01 0x00 0x00 0x0a 0x00 0x01 0x0a>;
		lcd-kit,check-reg-cmds-state = "dsi_lp_mode";
		lcd-kit,check-reg-value = <0x9c>;
		lcd-kit,check-reg-on-cmds = <0x06 0x01 0x00 0x00 0x0a 0x00 0x01 0x0a>;
		lcd-kit,check-reg-on-value = <0x9c>;
		lcd-kit,mipi-check-cmds = <0x06 0x01 0x00 0x00 0x0a 0x00 0x01 0x05>;
		lcd-kit,mipi-check-cmds-state = "dsi_lp_mode";
		lcd-kit,mipi-check-value = <0x00>;
		lcd-kit,barcode-2d-cmds = <0x15 0x01 0x00 0x00 0x0a 0x00 0x02 0xFF 0x21
		0x06 0x01 0x00 0x00 0x0a 0x00 0x07 0xF1 0x00 0x00 0x00 0x00 0x00 0x00
		0x15 0x01 0x00 0x00 0x0a 0x00 0x02 0xFA 0x07
		0x06 0x01 0x00 0x00 0x0a 0x00 0x07 0xF1 0x00 0x00 0x00 0x00 0x00 0x00
		0x15 0x01 0x00 0x00 0x0a 0x00 0x02 0xFA 0x0E
		0x06 0x01 0x00 0x00 0x0a 0x00 0x02 0xF1 0x00
		0x15 0x01 0x00 0x00 0x0a 0x00 0x02 0xFA 0x00
		0x06 0x01 0x00 0x00 0x0a 0x00 0x07 0xF2 0x00 0x00 0x00 0x00 0x00 0x00
		0x15 0x01 0x00 0x00 0x0a 0x00 0x02 0xFA 0x07
		0x06 0x01 0x00 0x00 0x0a 0x00 0x07 0xF2 0x00 0x00 0x00 0x00 0x00 0x00
		0x15 0x01 0x00 0x00 0x0a 0x00 0x02 0xFA 0x0E
		0x06 0x01 0x00 0x00 0x0a 0x00 0x02 0xF2 0x00
		0x15 0x01 0x00 0x00 0x0a 0x00 0x02 0xFA 0x00
		0x06 0x01 0x00 0x00 0x0a 0x00 0x07 0xF3 0x00 0x00 0x00 0x00 0x00 0x00
		0x15 0x01 0x00 0x00 0x0a 0x00 0x02 0xFA 0x07
		0x06 0x01 0x00 0x00 0x0a 0x00 0x07 0xF3 0x00 0x00 0x00 0x00 0x00 0x00
		0x15 0x01 0x00 0x00 0x0a 0x00 0x02 0xFA 0x0E
		0x06 0x01 0x00 0x00 0x0a 0x00 0x01 0xF3
		0x15 0x01 0x00 0x00 0x0a 0x00 0x02 0xFF 0x10>;
		lcd-kit,project-id-cmds = <0x15 0x01 0x00 0x00 0x0a 0x00 0x02 0xFF 0x10
		0x06 0x01 0x00 0x00 0x0a 0x00 0x05 0xB1 0x00 0x00 0x00 0x00
		0x15 0x01 0x00 0x00 0x0a 0x00 0x02 0xFA 0x05
		0x06 0x01 0x00 0x00 0x0a 0x00 0x05 0xB1 0x00 0x00 0x00 0x00
		0x15 0x01 0x00 0x00 0x0a 0x00 0x02 0xFF 0x10>;
		lcd-kit,project-id-cmds-state = "dsi_lp_mode";
		lcd-kit,panel-bl-maxnit-command = <0x06 0x01 0x00 0x00 0x0a 0x00 0x01 0xdb>;
		lcd-kit,panel-bl-maxnit-command-state = "dsi_lp_mode";
		lcd-kit,lcd-btb-support = <0>;
		lcd-kit,lcd-btb-check-type = <0>;
		lcd-kit,lcd-btb-gpio = <73 76>;
		lcd-kit,vtc-line-cmds = <0x15 0x01 0x00 0x00 0x0a 0x00 0x02 0xFF 0x20
		0x15 0x01 0x00 0x00 0x0a 0x00 0x02 0xFB 0x01
		0x15 0x01 0x00 0x00 0x0a 0x00 0x02 0x94 0xC0
		0x15 0x01 0x00 0x00 0x0a 0x00 0x02 0x95 0x17
		0x15 0x01 0x00 0x00 0x0a 0x00 0x02 0x96 0x17
		0x15 0x01 0x00 0x00 0x0a 0x00 0x02 0xFF 0x10>;
		lcd-kit,vtc-line-cmds-state  = "dsi_lp_mode";
		lcd-kit,panel-lcm-type = <2>;
		lcd-kit,panel-ldi-dsi-mode = <1>;
		lcd-kit,panel-dsi-switch-mode = <0>;
		lcd-kit,panel-dsi-switch-mode-en = <0>;
		lcd-kit,panel-ldi-trans-seq = <0>;
		lcd-kit,panel-ldi-data-padding = <0>;
		lcd-kit,panel-ldi-packet-size = <256>;
		lcd-kit,panel-ldi-ps = <2>;
		lcd-kit,panel-vfp-lp = <0>;
		lcd-kit,panel-fbk-div = <1>;
		lcd-kit,panel-orientation = <1>;
		lcd-kit,panel-bpp = <2>;
		lcd-kit,panel-bgr-fmt = <0>;
		lcd-kit,panel-cmd-type = <8>;
		lcd-kit,panel-pxl-clk = <0>;
		lcd-kit,panel-pxl-clk-div = <0>;
		lcd-kit,panel-data-rate = <952>;
		lcd-kit,mipi-lane-nums = <4>;
		lcd-kit,h-back-porch = <100>;
		lcd-kit,h-front-porch = <156>;
		lcd-kit,h-pulse-width = <16>;
		lcd-kit,project-id-support = <1>;
		lcd-kit,default-project-id = "G1929M1300";
		lcd-kit,v-back-porch = <54>;
		lcd-kit,v-front-porch = <1286>;
		lcd-kit,v-pulse-width = <10>;
		lcd-kit,mipi-clk-post-adjust = <0>;
		lcd-kit,mipi-lp11-flag = <0>;
		lcd-kit,esd-support = <1>;
		lcd-kit,skip-poweron-esd-check = <0>;
		lcd-kit,esd-recovery-bl-support = <1>;
		lcd-kit,thp-proximity-support = <1>;
		lcd-kit,tp-color-support = <0>;
		lcd-kit,lcd-vsp = <2 137 5500000>;
		lcd-kit,lcd-vsn = <2 138 5500000>;
		lcd-kit,lcd-power-down-vsp = <2 137 4700000>;
		lcd-kit,lcd-power-down-vsn = <2 138 4700000>;
		lcd-kit,lcd-reset = <2 86 0>;
		lcd-kit,power-on-stage = <11 1 5
				3 1 1
				4 1 10
				5 1 5
				5 2 1
				5 1 5
				5 2 1
				5 1 10
				7 1 2
				6 1 0
				8 1 0>;
		lcd-kit,lp-on-stage = <0 0 0>;
		lcd-kit,hs-on-stage = <0 0 0>;
		lcd-kit,hs-off-stage = <0 0 0>;
		lcd-kit,lp-off-stage = <0 0 0>;
		lcd-kit,power-off-stage = <7 0 0
				6 0 0
				8 0 0
				11 0 5
				4 0 0
				3 0 6>;
		lcd-kit,only-power-off-stage = <15 0 80
				4 0 0
				3 0 6>;
		lcd-kit,pt-support = <1>;
		lcd-kit,panel-density = <320>;
		lcd-kit,ssc-disable = <1>;
		lcd-kit,inversion-support = <1>;
		lcd-kit,check-reg-support = <1>;
		lcd-kit,panel-bl-min = <50>;
		lcd-kit,panel-bl-max = <6600>;
		lcd-kit,panel-bl-max-nit = <470>;
		lcd-kit,panel-bl-boot = <255>;
		lcd-kit,mipi-non-continue-enable = <1>;
		lcd-kit,panel-getblmaxnit-type = <1>;
		lcd-kit,panel-bl-ic-ctrl-type = <6>;
		lcd-kit,panel-bias-ic-ctrl-type = <3>;
		lcd-kit,oem-info-support = <1>;
		lcd-kit,oem-barcode-2d-support = <1>;
		lcd-kit,oem-barcode-2d-num-offset = <1>;
		lcd-kit,panel-on-always-reset = <1>;
		lcd-kit,panel-gpio-offset = <300>;
		lcd-kit,backlight-order = <0>;
		lcd-kit,fps-support = <1>;
		lcd-kit,fps-high-60-mipi-hopping = <101 100 16 1286 54 10 868 1286>;
		lcd-kit,fps-90-mipi-hopping = <101 100 16 36 54 10 868 36>;
		lcd-kit,fps-normal-60-dsi-timming = <172 156 16 1286 54 10 60 1080 0>;
		lcd-kit,fps-high-60-dsi-timming = <156 100 16 1286 54 10 60 952 0>;
		lcd-kit,fps-90-dsi-timming = <156 100 16 36 54 10 90 952 0>;
		lcd-kit,panel-support-fps-list = <1 2>;
		lcd-kit,dsc-enable = <1>;
		lcd-kit,dsc-ver = <17>;
		lcd-kit,dsc-slice-mode = <1>;
		lcd-kit,dsc-rgb-swap = <0>;
		lcd-kit,dsc-cfg = <34>;
		lcd-kit,dsc-rct-on = <1>;
		lcd-kit,dsc-bit-per-channel = <8>;
		lcd-kit,dsc-line-buf-depth = <9>;
		lcd-kit,dsc-bp-enable = <1>;
		lcd-kit,dsc-bit-per-pixel = <128>;
		lcd-kit,dsc-pic-height = <2400>;
		lcd-kit,dsc-pic-width = <1080>;
		lcd-kit,dsc-slice-height = <20>;
		lcd-kit,dsc-slice-width = <540>;
		lcd-kit,dsc-chunk-size = <540>;
		lcd-kit,dsc-xmit-delay = <512>;
		lcd-kit,dsc-dec-delay = <526>;
		lcd-kit,dsc-scale-value = <32>;
		lcd-kit,dsc-increment-interval = <488>;
		lcd-kit,dsc-decrement-interval = <7>;
		lcd-kit,dsc-line-bpg-offset = <12>;
		lcd-kit,dsc-nfl-bpg-offset = <1294>;
		lcd-kit,dsc-slice-bpg-offset = <1302>;
		lcd-kit,dsc-initial-offset = <6144>;
		lcd-kit,dsc-final-offset = <4336>;
		lcd-kit,dsc-flatness-minqp = <3>;
		lcd-kit,dsc-flatness-maxqp = <12>;
		lcd-kit,dsc-rc-model-size = <8192>;
		lcd-kit,dsc-rc-edge-factor = <6>;
		lcd-kit,dsc-rc-quant-incr-limit0 = <11>;
		lcd-kit,dsc-rc-quant-incr-limit1 = <11>;
		lcd-kit,dsc-rc-tgt-offset-hi = <3>;
		lcd-kit,dsc-rc-tgt-offset-lo = <3>;
		lcd-kit,vetical-refresh = <60>;
		lcd-kit,inversion-column-cmds-state = "dsi_lp_mode";
		lcd-kit,inversion-dot-cmds-state = "dsi_lp_mode";
		lcd-kit,proximity-reset-delay-min = <65>;
		lcd-kit,quickly-sleep-out-support = <1>;
		lcd-kit,quickly-sleep-out-interval = <70>;
		lcd-kit,mipi-hop-h-back-porch = <10>;
		lcd-kit,mipi-hop-h-front-porch = <32>;
		lcd-kit,mipi-hop-h-pulse-width = <10>;
		lcd-kit,mipi-hop-v-back-porch = <60>;
		lcd-kit,mipi-hop-v-front-porch = <14>;
		lcd-kit,mipi-hop-v-pulse-width = <30>;
		lcd-kit,mipi-hop-lp-v-front-porch = <14>;
		lcd-kit,Does-lcd-poweron-tp = <0>;
		lcd-kit,mipi-hop-support = <1>;
		lcd-kit,mipi-read-gerneric = <1>;
		lcd-kit,rgbw-support = <0>;
		lcd-kit,imax-lcd-luminance = <500>;
		lcd-kit,imin-lcd-luminance = <3>;
		lcd-kit,panel-blmaxnit-min-value = <400>;
		lcd-kit,mtk-high-left-time-th-us = <5000>;
		lcd-kit,mtk-high-right-time-th-us = <9000>;
		lcd-kit,mtk-high-te-inerval-time-us = <11111>;
		lcd-kit,mtk-low-left-time-th-us = <9000>;
		lcd-kit,mtk-low-right-time-th-us = <15000>;
		lcd-kit,mtk-low-te-inerval-time-us = <16667>;
		lcd-kit,sn-code-support = <0>;
		lcd-kit,panel-round-corner-enable = <0>;
		lcd-kit,panel-round-corner-full-content = <0>;
		lcd-kit,panel-round-corner-h = <0>;
		lcd-kit,panel-round-corner-h-bot = <0>;
    };
};