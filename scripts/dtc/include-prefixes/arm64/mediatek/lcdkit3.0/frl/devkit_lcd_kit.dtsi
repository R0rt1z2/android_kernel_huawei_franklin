/*---------------------------------------------------------------------------
 * This file is autogenerated file using huawei LCD parser. Please do not edit it.
 * Update input XML file to add a new entry or update variable in this file
 * Parser location: vendor/huawei/chipset_common/devkit/lcdkit/tools 
 *---------------------------------------------------------------------------*/


#include "frl_110_208_6p63.dtsi"
#include "frl_120_208_6p63.dtsi"
#include "frl_120_602_6p63.dtsi"
#include "frl_190_208_6p63.dtsi"
#include "frl_190_602_6p63.dtsi"
#include "frl_290_208_6p63.dtsi"
#include "frl_auo_otm1901a_5p2_1080p_video_default.dtsi"