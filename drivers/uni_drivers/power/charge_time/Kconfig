## kernel/sched/hw_walt/Kconfig
```kconfig
#
# Huawei enhanced options for sched walt
#

if SCHED_WALT

config HW_SCHED_PRED_LOAD
	bool "Calculate predicted load for each task"
	default y
	depends on SCHED_WALT
	help
	  Another signal to improve schedutil. This will help to ramp up
	  cpufreq quickly.
	  To enable this signal, say yes here and set predl_enable to 1
	  in init rc.

config HW_SCHED_CHECK_IRQLOAD
	bool "Scheduler check irqload when select task's cpu"
	default y
	help
	  WALT caculates an irqload for each cpu and scheduler will avoid
	  placing task on a high irqload cpu (if WALT enabled).

config HW_SCHED_WALT
	bool "WALT platform functions"
	default y
	depends on SCHED_WALT
	select HAVE_QCOM_SCHED_WALT if ARCH_QCOM
	help
          WALT platform functions

config HAVE_QCOM_SCHED_WALT
	bool "QCOM WALT features"
	default n
	help
	  This option used to identify platform difference

config HW_SCHED_WALT_DEBUG
	bool "Debug HW WALT features"
	depends on HW_SCHED_WALT
	default n
	help
	  This option used to debug walt features

endif # SCHED_WALT
```

## mm/mem_track/Kconfig
```kconfig
menuconfig MM_TRACK
    bool "MM Track support"
    default y
    ---help---
      This option add some mm track codes, needed by following modules.

if MM_TRACK

config MM_PAGE_TRACE
    bool "MM page trace"
    default n
    ---help---
      This option enables mm page trace, needed by memleak check modules.

config MM_PAGE_TRACE_TEST
    bool "MM page trace test"
        default n
    depends on MM_PAGE_TRACE
    ---help---
      This option enables mm page trace test, needed by mm page trace modules.

config MEMORY_STATIC_FOOTPRINT
    bool "dt reserved memory show"
    default n
    depends on DEBUG_FS
    ---help---
      This option enables of_reserved_memory show.

endif
```

## security/eima/Kconfig
```kconfig
# Copyright (c) Huawei Technologies Co., Ltd. 2017-2020. All rights reserved.
#
# EMUI Integrity Measurement Architecture(EIMA) configuration
#

config HUAWEI_EIMA
	bool "enables HUAWEI EMUI Integrity Measurement Architecture"
	default n
	help
	  The EMUI Integrity Measurement Architecture (EIMA)
	  framework is composed of a set of subsystems that
	  are needed to measure the integrity of the platform
	  and inform the decision on platform integrity to
	  clients who seek such services.
config HUAWEI_ENG_EIMA
	bool "Huawei EIMA for engineering mode debug"
	depends on HUAWEI_EIMA
	default n
	help
	  This option should only be enabled for engineering mode & debug test.
	  In engineering mode, EIMA will be turnoff(default) after init,
	  tester can use supported interface to turn it on, and do debug test.
config HUAWEI_EIMA_ACCESS_CONTROL
	bool "enables one process access control by verifying the integrity of other processes"
	depends on HUAWEI_EIMA
	default n
	help
	  If the option is on, one process can request EIMA
	  to verify the integrity of other processes by including libeima.
	  The signature of the RE segment of the other process is generated on
	  the Signature Center of Huawei CBG and sent to EIMA as an input.
	  The signature is verified through libeima with the corresponding public
	  key. After successful verification, the hash is compared with the hash
	  data computed by EIMA. Then EIMA returns the result to the process.
```

## security/kernel_harden_test/Kconfig
```kconfig
config MTK_KERNEL_HARDEN_DEBUG
	bool "MTK kernel harden test support"
	default n
	help
	  Say yes here to support the MTK kernel harden debug
```
