## drivers/uni_drivers/power/charge_time/Kconfig
```kconfig
config HW_CHARGE_TIME
	depends on HW_PLAT_POWER
	bool "huawei charge time"
	default n

config HW_CHARGE_TIME_DEBUG
	depends on HW_CHARGE_TIME
	bool "huawei charge time debug"
	default n
```

## drivers/uni_drivers/secmem/Kconfig
```kconfig
menu "huawei secmem"

config HW_VLTMM
	bool "Enable huawei secure memory dynamic allocate"
	default n
	help
	  Support allocate secure volatil memory from secos.

config HW_SECMEM
	bool "Enable huawei secure memory"
	default n
	help
	  Support secure memory.

config HW_SECMEM_DEBUG
	bool "Enable huawei secure memory debug"
	default n
	help
	  Support secure memory debug.

endmenu
```

## drivers/xhub_router/Kconfig
```kconfig
menuconfig XHUB_ROUTER
	bool "xhub router support"
	default n
	help
	Say yes here to support xhub router feature.
```

## fs/crypto/Kconfig
```kconfig
config FS_ENCRYPTION
	tristate "FS Encryption (Per-file encryption)"
	select CRYPTO
	select CRYPTO_AES
	select CRYPTO_CBC
	select CRYPTO_ECB
	select CRYPTO_XTS
	select CRYPTO_CTS
	select CRYPTO_CTR
	select CRYPTO_SHA256
	select KEYS
	help
	  Enable encryption of files and directories.  This
	  feature is similar to ecryptfs, but it is more memory
	  efficient since it avoids caching the encrypted and
	  decrypted pages in the page cache.
config FS_UNI_ENCRYPTION
	depends on FS_ENCRYPTION
	tristate "FS Universal Encryption (Per-file encryption)"
	help
	  Enable universal encryption for files and directories.
config FS_SDP_ENCRYPTION
	depends on FS_ENCRYPTION
	tristate "FS Sensitive data protection Encryption (Per-file encryption)"
	help
	  Enable sdp encryption for files and directories.
```

## kernel/sched/Kconfig
```kconfig
#
# Huawei enhanced options for sched
#
config HUAWEI_SCHED_EAS
	bool "Huawei EAS enhance"
	default n
	help
	  EAS enhanced on huawei products.

config SCHED_TOPOLOGY
	bool "EAS support multiple cluster"
	default n
	help
	  Sched support multi cluster.

config SCHED_MULTI_MARGIN
	bool "EAS multiple margin"
	default n
	help
	  Allow each cluster has its own capacity_margin/sd_capacity_margin.

config SCHED_ED_TASK
	bool "Early detection tasks for freq guidance"
	default n
	help
	  early detection tasks for frequency guidance.

config ED_TASK_RESET_AT_UPMIGRATION
	bool "Reset ed task's run/wait time when migrate to faster cpu"
	depends on SCHED_ED_TASK
	default n
	help
	  This feature reset an ed task's last_wake_ts/last_wake_wait_sum if
	  task migrate to faster cpu. This prevents little core's ed task
	  boost big core's freq when it upmigrate.
	  However, it might be confusing if a task become ed task on big core
	  by its earlier running time on little core. Disable this feature
	  and do not reset ed task on migration is a better choice.

config SCHED_RTG
	bool "Related threads group"
	default n
	help
	  Set ux related threads into a group.

config SCHED_RTG_DEBUG
	bool "Related threads group debug"
	depends on SCHED_RTG
	default n
	help
	  Related threads group debugfs.

config SCHED_CGROUP_RTG
	bool "Related threads group sync with stune control"
	depends on SCHED_RTG
	depends on SCHED_TUNE
	default n
	help
	  set schedtune group tasks into a rtg.

config SCHED_CGROUP_RTG
	bool "Related threads group sync with stune control"
	depends on SCHED_RTG
	depends on SCHED_TUNE
	default n
	help
	  set schedtune group tasks into a rtg.

config HUAWEI_SCHED_WALT
	bool "Huawei WALT optimize"
        depends on SCHED_WALT
        default n

if HUAWEI_SCHED_WALT

config SCHED_WALT_WINDOW_SIZE_TUNABLE
	bool "Make WALT window size tunable"
	default n
	help
	  Make walt_ravg_window tunable in early param.

config SCHED_CALC_CUM_WINDOW_DEMAND
	bool "WALT calculate cum window demand"
	default n
	help
	  This option caculates WALT's cum_window_demand.

config SCHED_CHECK_IRQLOAD
	bool "Scheduler check irqload when select task's cpu"
	default n
	help
	  WALT caculates an irqload for each cpu and scheduler will avoid
	  placing task on a high irqload cpu (if WALT enabled).
	  Default disabled because we haven't tested to find out which
	  threshold is the best.

config SCHED_TOP_TASK
	bool "Maintain the top task load of each cpu"
	default n
	help
	  Schedutil governor use the top task load as a guide to
	  frequency evaluation.

config SCHED_MIGRATE_SPREAD_LOAD
	bool "Spread task's load when inter-cluster migration"
	default n
	help
	  In inter-cluster migration, this option will spread task's
	  prev_window/curr_window to all cpus that the task has been
	  running on before in a window. If disabled, task's whole load
	  will move to dest cpu and that will make dest cpu's cpu load
	  very high in same cases.

config SCHED_PRED_LOAD
	bool "Calculate predicted load for each task"
	default n
	depends on HUAWEI_CPU_FREQ_GOV_SCHEDUTIL
	help
	  Another signal to improve schedutil. This will help to ramp up
	  cpufreq quickly.
	  To enable this signal, say yes here and set predl_enable to 1
	  in init rc.

config SCHED_TASK_RAVG_SUM
	bool "Task normalized running time sum"
	default n
	help
	  Sum all normalized running time for each task.

config SCHED_RT_CAS
	bool "rt sched class capacity aware scheduling"
	default n
	help
	  allow rt task to be scheduled according to task util and cpu capacity.

config SCHED_RT_ACTIVE_LB
	bool "RT sched class active balance optimization"
	depends on SCHED_RT_CAS
	default n
	help
	  allow migrating running rt task.

config SCHED_MIGRATION_NOTIFY
	bool "Task migration notify freq change"
	default n
	help
	  tasks migration notify frequency change.

endif # HUAWEI_SCHED_WALT

config HUAWEI_SCHED_VIP
	bool "Support a high prio sched policy in fair sched class"
	default n

config SCHED_TASK_UTIL_CLAMP
	bool "Support userspace constraints on a task's min/max util use"
	default n

config SCHED_DEBUG_TRACE
	bool "Detailed trace for EAS debug"
	default n
	help
	  This option enable detailed tracepoint for EAS debug, there
	  will be more tracepoint in find best target, load balance and
	  energy diff.

config SCHED_PERF_CTRL
	bool "Perf ctrl interface of sched"
	depends on HUAWEI_PERF_CTRL
	default n

config HUAWEI_SCHED_STAT_YIELD
	bool "Report task's cumulative_yield_time"
	default n

config HUAWEI_RT_BLOCKED_REASON
	bool "Add rt task blocked reason trace"
	default n
```

## kernel/sched/hw_cluster/Kconfig
```kconfig
config HW_SCHED_CLUSTER
	bool "Huawei related thread group"
	default n
	help
	  set real time scheduler for dedicated thread

config HW_SCHED_CLUSTER_DEBUG
	bool "Huawei related thread group debug"
	default n
	help
	  set real time scheduler for dedicated thread
```

## kernel/sched/hw_eas/Kconfig
```kconfig
config HW_EAS_SCHED
	bool "Huawei EAS scheduler"
	default n
	depends on ARCH_HW
	select HW_CPU_FREQ_GOV_SCHEDUTIL
	help
	  Huawei EAS scheduler, it makes scheduling more
	  efficient and energy-saving.

config HW_MULTI_MARGIN
	bool "Huawei multiple margin"
	default n
	depends on HW_SCHED_CLUSTER
	depends on HW_EAS_SCHED
	help
	  Allow each cluster has its own capacity_margin/sd_capacity_margin.

config HW_BOOST
	bool "Huawei boost support"
	depends on HW_EAS_SCHED
	default n
	help
	  macro switch of boost

config HW_BOOT_BOOST
	bool "Huawei boot boost support"
	depends on HW_BOOST
	default n
	help
	  on system boot scenarios, it is used to accelerate
	  system startup.

config HW_FORK_BOOST
	bool "Huawei fork boost support"
	depends on HW_BOOST
	default n
	help
	  on fork scenarios, it is used to set task boost to
	  512, which is used to run the task quickly.

config HW_GLOBAL_BOOST
	bool "Huawei global boost support"
	depends on HW_BOOST
	default n
	help
	  on some interactive scenarios, it is used to enable
	  boost function in a short time to improve performance.

config HW_NEGATIVE_BOOST
	bool "Huawei negative boost support"
	depends on HW_BOOST
	default n
	help
	  We can increase the value of boost to make the task select
	  the large core, or reduce the value of boost to make the task
	  select the small core. At this time, the range of boost is
	  - 100 to 100.

config HW_SPREAD_TASK
	bool "Huawei spread task"
	depends on HW_EAS_SCHED
	default n
	help
	  when each CPU in the cluster is overloaded, the packaged
	  small tasks need to be split to improve performance.

config HW_FAVOR_SMALL_CAP
	bool "Huawei config favor small capacity"
	depends on HW_EAS_SCHED
	default n
	help
	  users turn on or off the switch through ioctrl, when
	  the switch is turned on, the task witch TIF_FAVOR_SMALL_CAP
	  will select little core.

config HW_EAS_TRACE
	bool "Huawei EAS Trace"
	depends on HW_EAS_SCHED
	default n
	help
	  enable huawei eas trace.
```

## kernel/sched/hw_migration_notify/Kconfig
```kconfig
config HW_MIGRATION_NOTIFY
	bool "Huawei task migration notify freq change"
	depends on HW_EAS_SCHED
	default n
	help
	  tasks migration notify frequency change.
```

## kernel/sched/hw_rtg/Kconfig
```kconfig
menu "HUAWEI Related Thread Group"

config HW_RTG
	bool "HUAWEI Related Thread Group"
	default n
	help
	  Set real time scheduler for dedicated thread

config HW_RTG_BOOST
	bool "HUAWEI Related Thread Group"
	default n
	help
	  Sensing boost in RTG groups

config HW_RTG_NORMALIZED_UTIL
	bool "HUAWEI RTG Normalized Util and Preferred-Cluster"
	depends on HW_RTG
	default n
	help
	  Use normalized util as rtg util, also enabled Preferred-Cluster

config HW_RTG_UCLAMP_UTIL
	bool "HUAWEI RTG Uclamp Util"
	depends on HW_RTG
	depends on SCHED_TASK_UTIL_CLAMP
	default n
	help
	  Used uclamp min util as rtg util

config HW_RTG_WALT
	bool "Use WALT to track the RTG tasks load"
	depends on HW_RTG
	default n
	help
	  Set real time scheduler for dedicated thread

config HW_RTG_CPU_TIME
	bool "Steal CPU time from RTG"
	depends on HW_RTG_WALT
	help
	  Record cpu_time in RTG Group

config HW_RTG_FRAME
	bool "Frame RTG Scheduling"
	depends on HW_RTG
	default n
	help
	  Use frame_rtg group

config HW_RTG_AUX
	bool "RTG AUX Group"
	depends on HW_RTG_FRAME
	default n
	help
	  Use hw rme optimize

config HW_RTG_MULTI_FRAME
	bool "Multi-Frame RTG Scheduling"
	depends on HW_RTG_FRAME
	default n
	help
	  Use multi frame_rtg group

config HW_RTG_RT_THREAD_LIMIT
	bool "Limit the number of RT threads"
	depends on HW_RTG
	default n
	help
	  If set, limit the number of RT threads in AUX and Frame rtg.

config HW_RTG_FRAME_RME
	bool "Frame RTG RME Optimize"
	depends on HW_RTG_FRAME
	default n
	help
	  Use hw rme optimize

config HW_RTG_DEBUG
	bool "HW RTG DebugFS"
	depends on HW_RTG_FRAME || HW_RTG_AUX
	default n
	help
	  If set, debug node will show rtg threads
	  /proc/sched_frame_debug
	  /proc/sched_aux_debug

config HW_RTG_TRACE
	bool "HW RTG Tracing"
	depends on HW_RTG
	default n
	help
	  If set, there will be rtg tag on systrace

config HW_RTG_PERF_CTRL
	bool "HW RTG Perl Ctrl Interface"
	depends on HW_RTG
	depends on HUAWEI_PERF_CTRL
	default n
	help
	  Use the /dev/hw_perf_ctrl to operate the RTG through ioctl.

config HW_RTG_FRAME_NO_FORCE_FAST_DOWN
       bool "Schedutil frame_update do not force skip_min_sample_time"
       depends on !HW_BOOST
       default n
       help
         Boosted scene like appstart do not want cpu to fast ramp
         down. Frame sched should not break it. This option won't
         set skip_min_sample_time for freq update marked by
         sched_set_group_normalized_util() if userspace has
         configured fast_ramp_down to 0.
         Please say Y.

config HW_RTG_PSEUDO_TICK
	bool "update rtg by pseudo tick"
	depends on HW_RTG_FRAME
	default n
	help
	  In the 120-frame scenario, the tick is used to update the
	  RTG information. Therefore, high-precision timers are used
	  to implement pseudo ticks.

config HW_CGROUP_RTG
	bool "enable DEFAULT_CGROUP_COLOC RTG"
	depends on HW_RTG
	default n
	help
	  Through schedtune, all top-app threads are added to
	  DEFAULT_CGROUP_COLOC RTG.

choice
	prompt "HW RTG util control mode"
	default HW_RTG_FRAME_USE_NORMALIZED_UTIL if HW_RTG_NORMALIZED_UTIL
	default HW_RTG_FRAME_USE_MIN_UTIL if !HW_RTG_NORMALIZED_UTIL
	default HW_RTG_FRAME_USE_MIN_UTIL if !HW_CPU_FREQ_GOV_SCHEDUTIL
	help
	  Provides multiple methods to deliver the RTG util to control
	  core selection and frequency modulation.

config HW_RTG_FRAME_USE_MIN_UTIL
	bool "change group util by min util"
	depends on HW_RTG_UCLAMP_UTIL
	depends on HW_RTG_FRAME
	help
	  This is done by setting min util for all threads in the RTG group.

config HW_RTG_FRAME_USE_NORMALIZED_UTIL
	bool "change group util by normalized util"
	depends on HW_RTG_NORMALIZED_UTIL
	help
	  This is done by setting normalized-util and prefer-cluster for
	  the RTG group.
endchoice

choice
	prompt "HW RTG working mode"
	default HW_RTG_CUSTOM
	help
	  Provides multiple methods to deliver the RTG util to control
	  core selection and frequency modulation.

config HW_RTG_CUSTOM
	bool "custom RTG support"
	help
	  Common RTG working mode, you can customize the RTG mode and
	  enable the features as required.

config HW_RTG_NORMAL
	bool "normal RTG support"
	select HW_RTG
	select SCHED_WALT
	select HW_RTG_WALT
	select HW_RT_CAS
	select HW_RT_ACTIVE_LB
	select HW_RTG_FRAME
	select HW_RTG_AUX
	select SCHED_TASK_UTIL_CLAMP
	select HW_RTG_UCLAMP_UTIL
	select HW_RTG_NORMALIZED_UTIL
	select HW_RTG_FRAME_USE_NORMALIZED_UTIL
	select HW_RTG_PERF_CTRL
	help
	  Common RTG working mode, supporting AI scheduling, FRAME, and RME,
	  using normalized util and userspace freq for frequency modulation,
	  and supporting pref_cluster.

config HW_MTK_RTG_SCHED
	bool "iaware RTG support"
	select HW_RTG
	select SCHED_WALT
	select HW_RTG_WALT
	select HW_RT_CAS
	select HW_RT_ACTIVE_LB
	select HW_RTG_FRAME
	select HW_RTG_AUX
	select SCHED_TASK_UTIL_CLAMP
	select HW_UCLAMP_MIN_UTIL_DEPRECATED
	select HW_RTG_UCLAMP_UTIL
	select HW_RTG_FRAME_USE_MIN_UTIL
	select HW_CPU_FREQ_GOV_SCHEDUTIL_COMMON
	help
	  Simplified RTG working mode supports only FRAME and uses min_util
	  for frequency modulation. Normalized_util, preferred cluster, and
	  userspace mode freq are not supported. RME and AI scheduling are
	  not supported.
endchoice

config MTK_RTG_SCHED_DEBUG
	bool "/proc/sched_frame_debug, /proc/sched_aux_debug support"
	select HW_RTG_DEBUG
	default n
	help
	  if set, debug node will show rtg threads

config HW_MTK_RTG_SCHED_TRACE
	bool "enable rtg runnable trace tag print"
	select HW_RTG_TRACE
	default n
	help
	  if set, there will be rtg tag on systrace

endmenu
```

## kernel/sched/hw_task/Kconfig
```kconfig
config HW_ED_TASK
	bool "Huawei early detection tasks for frequency guidance"
	depends on SCHED_WALT
	depends on HW_CPU_FREQ_GOV_SCHEDUTIL
	default n
	help
	  Huawei early detection tasks for frequency guidance.

config HW_TOP_TASK
	bool "Maintain the top task load of each cpu"
	depends on SCHED_WALT
	depends on HW_CPU_FREQ_GOV_SCHEDUTIL
	default n
	help
	  huawei schedutil governor may use the top task load as a guide to
	  frequency evaluation.

config HW_TOP_TASK_SKIP_HISPEED_LOGIC
	bool "Let top task ignore above_hipeed_delay"
	depends on HW_TOP_TASK
	default n
	help
	  For schedutil governor, this option skips hispeed logic when
	  ADD_TOP_TASK event triggers freq update.
```
