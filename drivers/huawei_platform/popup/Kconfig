## drivers/huawei_platform/popup/Kconfig
```kconfig
#
# popup driver configuration
#

menuconfig HUAWEI_POPUP
	bool "Huawei popup driver"
	default n
	help
	Say yes here to support for popup.

source "drivers/huawei_platform/popup/pos_hall/Kconfig"
source "drivers/huawei_platform/popup/step_motor/Kconfig"
```

## drivers/huawei_platform/power/Kconfig
```kconfig
source "drivers/huawei_platform/power/charger/Kconfig"
source "drivers/huawei_platform/power/pid_socket/Kconfig"
source "drivers/huawei_platform/power/wireless/Kconfig"
source "drivers/huawei_platform/power/hardware_ic/Kconfig"
source "drivers/huawei_platform/power/battery/Kconfig"
source "drivers/huawei_platform/power/dubai/Kconfig"
```

## drivers/huawei_platform/power/charger/charger_ap/Kconfig
```kconfig
source "drivers/huawei_platform/power/charger/charger_ap/direct_charger/Kconfig"
source "drivers/huawei_platform/power/charger/charger_ap/huawei_charger/Kconfig"
```

## drivers/huawei_platform/power/charger/charger_ap/direct_charger/Kconfig
```kconfig
#
# huawei direct charger drivers
#

config DIRECT_CHARGER
        bool "direct_charger"
        default n
```

## drivers/huawei_platform/power/charger/charger_ap/huawei_charger/Kconfig
```kconfig
config HUAWEI_CHARGER
        bool "huawei charger"
        default n
config FCP_CHARGER
        bool "fcp charger"
        default n

config MT6873_USCP_ADC
	bool "mt6873_uscp_adc"
	default n
```

## drivers/huawei_platform/power/dubai/Kconfig
```kconfig
config HUAWEI_DUBAI_BATTERY_STATS
	bool "Dubai battery stats (capacity_rm)"
	default n
	depends on HUAWEI_DUBAI
	help
	  This config is mainly for getting capacity_rm value of power_supply.
	  Please make sure there is POWER_SUPPLY_PROP_CAPACITY_RM.

config HUAWEI_DUBAI_GPU_STATS
	bool "Dubai gpu frequency stats"
	default n
	depends on HUAWEI_DUBAI && MTK_GPU_SUPPORT

config HUAWEI_DUBAI_DDR_STATS
	bool "Dubai ddr stats"
	default n
	depends on HUAWEI_DUBAI && MTK_SWPM

config HUAWEI_DUBAI_VCORE_STATS
	bool "Dubai vcore voltage stats"
	default n
	depends on HUAWEI_DUBAI && MTK_SWPM
```

## drivers/huawei_platform/power/hardware_ic/Kconfig
```kconfig
source "drivers/huawei_platform/power/hardware_ic/charger_ic/Kconfig"
source "drivers/huawei_platform/power/hardware_ic/switch_capacitor/Kconfig"
```

## drivers/huawei_platform/power/hardware_ic/charger_ic/Kconfig
```kconfig
#
# charger ic drivers
#

config RT9466_CHARGER
	bool "rt9466 charger"
	default n
	help
	  Say Y here to enable rt9466 charger driver.

config RT9471_CHARGER
	bool "rt9471 charger"
	default n
	help
	  Say Y here to enable rt9471 charger driver.

config ETA6937_CHARGER
        bool "eta6937 charger"
        default n

config SGM41511H_CHARGER
        bool "sgm41511h charger"
        default n
```

## drivers/huawei_platform/power/hardware_ic/switch_capacitor/Kconfig
```kconfig
#
# huawei switch capacitor for direct charge drivers
#

config SCHARGER_V600
	bool "scharger_v600_for_direct_charge"
	depends on SWITCHCAP
	default n
	help
	  Say Y here to enable scharge_v600 driver.
	  scharge_v600 is a fixed ratio high voltage high power switched capacitor
	  and low voltage loadswtich ic.

config HI6526_PRIMARY_CHARGER_SUPPORT
	bool "hi6526 primary charger support"
	depends on SCHARGER_V600
	default n
	help
	  Say Y here to enable hi6526(schargerV600) primary charger driver
```

## drivers/huawei_platform/power/wireless/Kconfig
```kconfig
config WIRELESS_CHARGER
       bool "wireless charger"
       default n
       help
         Say Y here to enable wireless charge driver.
         This driver provides a unified logic to the wireless charge.
         Currently supported wireless protocols as below:
         QI/WPC protocol.
```

## drivers/huawei_platform/scsi/ufs/Kconfig
```kconfig
#
# Copyright (C) 2020-2023 huawei Software Operations
# Description: Kernel configuration file for the UFS
#
# Author: sizhiying
# Create: 2020-08-13
#
config SCSI_UFS_ENHANCED_INLINE_CRYPTO
	bool "inline crypto"
	depends on SCSI_UFSHCD
```

## drivers/huawei_platform/sensor/Kconfig
```kconfig
menuconfig HUAWEI_SENSOR
    bool "Huawei sensors info"
    default n
    help
      Say yes if you want device detect driver.
      This is for device connected version. If unsure, say N here.
```

## drivers/huawei_platform/sensor2_0/Kconfig
```kconfig
#
# Sensors info
#

menuconfig HUAWEI_SENSORS_2_0
    bool "Huawei sensors2_0 info"
    default n
    help
      Say yes if you want device detect driver.
      This is for device connected version. If unsure, say N here.

source "drivers/huawei_platform/sensor2_0/sar/a96t346/Kconfig"
source "drivers/huawei_platform/sensor2_0/pos_hall/Kconfig"
source "drivers/huawei_platform/sensor2_0/step_motor/Kconfig"
```

## drivers/huawei_platform/sensor2_0/sar/a96t346/Kconfig
```kconfig
config MTK_ABOV_SAR
	bool "abov a96t346 for MediaTek package"
	default n
	help
	  It support different type sensor
	  in this platform. If this option
	  is set, it will support sar sensor A96T346.
```

## drivers/huawei_platform/sensor_ap/Kconfig
```kconfig
#sensor unification for differ platform
menuconfig HUAWEI_SENSORS_AP
	bool "huawei sensor ap"
	default n
	help
	Say yes here to support the huawei sensor input information.

source "drivers/huawei_platform/sensor_ap/hall/Kconfig"
source "drivers/huawei_platform/sensor_ap/color_sensor/Kconfig"
source "drivers/huawei_platform/sensor_ap/pmic/Kconfig"
```

## drivers/huawei_platform/sensor_ap/pmic/Kconfig
```kconfig
config HUAWEI_PMIC_RT5112
	bool "huawei pmic rt5112"
	default n
	help
	  Say Y here to enable power pmic driver.
	  This driver provides interfaces to get pmic operation
	  e.g. we use fan53880/rt5112.


config HUAWEI_PMIC_FAN53880
	bool "huawei pmic fan53880"
	default n
	help
	  Say Y here to enable power pmic driver.
	  This driver provides interfaces to get pmic operation
	  e.g. we use fan53880/rt5112.
```

## drivers/huawei_platform/sensors/Kconfig
```kconfig
#
# Sensors info
#

menuconfig HUAWEI_SENSORS
    bool "Huawei sensors info"
    default n
    help
      Say yes if you want device detect driver.
      This is for device connected version. If unsure, say N here.
```

## drivers/huawei_platform/tzdriver/tui/Kconfig
```kconfig
config TEE_TUI
	bool "Trusted User Interface Driver"
	default n
	depends on TZDRIVER
	help
	  Trusted user interface diver

config TEE_TUI_FP
	bool "Trusted User Interface Driver For FP"
	default n
	depends on TZDRIVER
	help
	  Trusted user interface diver

config TEE_TUI_MTK
	bool "Trusted User Interface Driver For MTK"
	default n
	depends on TZDRIVER
	help
	  Trusted user interface diver

config ITRUSTEE_TRUSTED_UI
    bool "ITRUSTEE Trusted User Interface"
    default n
    ---help---
     Enable ITRUSTEE Trusted User Interfac
     ITRUSTEE TUI features was based on ITRUSTEE TEE mechanism to protect
     Touch/Display inside TEE, to prevent malicious access of sensitive data
     used by APPs like Banking.
```

## drivers/huawei_platform/usb/Kconfig
```kconfig
source "drivers/huawei_platform/usb/pd/Kconfig"
source "drivers/huawei_platform/usb/switch/Kconfig"
```

## drivers/huawei_platform/usb/pd/Kconfig
```kconfig
config HUAWEI_PD
        bool "huawei_pd"
        default n

source "drivers/huawei_platform/usb/pd/fusb302b/Kconfig"
source "drivers/huawei_platform/usb/pd/hi6526_pd/Kconfig"
```

## drivers/huawei_platform/usb/pd/fusb302b/Kconfig
```kconfig
config TCPC_FUSB302
	bool "fusb302"
	default n
	help
	  Say Y
	  To enable fusb302b
	  Pd driver and
	  Typec driver
```

## drivers/huawei_platform/usb/pd/hi6526_pd/Kconfig
```kconfig
config TCPC_HI6526
	bool "Hi6526 TypeC Port Controller Device"
	help
	  Say Y to enable Hi6526 Typec Port Controller Driver

if TCPC_HI6526

config HI6526_TCPC_DEBUG
	bool "Hi6526 TypeC Driver verbose debug information."
	default n
	help
	  If unsure, say N.

config TYPEC_CAP_DBGACC_SNK_SUPPORT
	bool "DebugAccessory sink support"
	default n
	help
	  Debug Accessory sink support.

config TYPEC_CAP_CUSTOM_SRC_SUPPORT
	bool "Custom SRC support"
	default n
	help
	  Custom SRC support

config TCPC_VSAFE0V_DETECT_SUPPORT
	bool "TCPC Vsafe0V detect support"
	default n
	help
	  TCPC Vsafe0V detect support

config USB_POWER_DELIVERY_SUPPORT
	bool "Hi6526 Power Delivery Support"
	help
	  Support PD using hi6526 tcpc.

config USB_PD_ALT_MODE_SUPPORT
	bool "Alternate Mode support"
	default n
	help
	  Alternate Mode support

config USB_PD_ALT_MODE_DFP_SUPPORT
	bool "Alternate Mode DFP support"
	default n
	help
	  Alternate Mode DFP support

config USB_PD_UVDM_SUPPORT
	bool "USB PD Unstructed VDM support"
	default n
	help
	  USB PD Unstructed VDM support

config USB_PD_CUSTOM_DBGACC_SUPPORT
	bool "Custom Debug Accessory support"
	default n
	help
	  Custom Debug Accessory support

config USB_PD_REV30
	bool "PD REV30"
	depends on HI6526_TCPC
	depends on USB_POWER_DELIVERY_SUPPORT
	default n
	help
		PD REV30

config USB_PD_REV30_PPS_SINK
	bool "sink pps feature of PD REV30"
	depends on HI6526_TCPC
	depends on USB_POWER_DELIVERY_SUPPORT
	depends on USB_PD_REV30
	default n
	help
		sink pps feature of PD REV30

config HI6526_USB_TYPEC
        bool "Hi6526 USB Typei-C Driver"
        help
          Say Y to enable Hi6526 USB Typec Driver

config HI6526_USB_TYPEC_DBG
        bool "Hi6526 USB Type-C driver verbost debug infomation."
        depends on HI6526_USB_TYPEC
        help
          Say Y here if you want verbost debug infomation. If unsure, say N.

config HI6526_PD_DBG_INFO
	bool "PD debug information"
	depends on TCPC_CLASS
	default y
	help
	  Say Y to enable PD debug
	  information
	  Say N to disable

endif
```
