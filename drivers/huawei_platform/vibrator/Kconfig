## drivers/huawei_platform/vibrator/Kconfig
```kconfig
#
# Vibrator info
#

menuconfig HUAWEI_VIBRATOR
    bool "Huawei vibrator info"
    default n
    help
      Say yes if you want device detect driver.
      This is for device connected version. If unsure, say N here.

source "drivers/huawei_platform/vibrator/high_vib/Kconfig"
```

## drivers/huawei_platform/vibrator/high_vib/Kconfig
```kconfig
#
# high volt driver configuration
#
config HUAWEI_HIGH_VOLT_VIBRATOR
	bool "huawei high volt vibrator driver"
	default n
	help
	Say yes here to support for high volt vibrator.
```

## drivers/hw_page_tracker/Kconfig
```kconfig
config HW_PAGE_TRACKER
	bool "Page tracker on HUAWEI Plat."
	depends on PAGE_EXTENSION
	---help---
	  This function record the owner of a page, the module which allocs page and
	  the order of page on alloction. It will help to find bare alloc_page(s) leaks.
	  Even if you include this feature on your build, it is disabled in default.
```

## drivers/hwmanufac/Kconfig
```kconfig
menu "Huawei Manufac Drivers"
source "drivers/hwmanufac/dev_detect/Kconfig"
source "drivers/hwmanufac/runmode_type/Kconfig"
endmenu
```

## drivers/hwmanufac/runmode_type/Kconfig
```kconfig
#
# runmode type pares
#
config RUNMODE_TYPE_PARSE
	bool "cmdline parse"
	default y
```

## drivers/misc/mediatek/gpu/gpu_mali/mali_valhall/mali-r21p0/drivers/gpu/arm/midgard/platform/Kconfig
```kconfig
#
# (C) COPYRIGHT 2012-2013, 2017 ARM Limited. All rights reserved.
#
# This program is free software and is provided to you under the terms of the
# GNU General Public License version 2 as published by the Free Software
# Foundation, and any use by you of this program is subject to the terms
# of such GNU licence.
#
# This program is distributed in the hope that it will be useful,
# but WITHOUT ANY WARRANTY; without even the implied warranty of
# MERCHANTABILITY or FITNESS FOR A PARTICULAR PURPOSE. See the
# GNU General Public License for more details.
#
# You should have received a copy of the GNU General Public License
# along with this program; if not, you can access it online at
# http://www.gnu.org/licenses/gpl-2.0.html.
#
# SPDX-License-Identifier: GPL-2.0
#
#

config MALI_HUAWEI_CL_BOOST
	bool "Enable HUAWEI mali GPU CL Boost"
	default n
	help
	enable MALI GPU CL boost.

config HW_GPU_CORE_HOTPLUG
	bool "Enable gpu core hotplug if high temperature scenario"
	depends on MACH_MT6885
	default n
	help
	  enable some cores shutdown if the thermal need reduce gpu power consumption

# Add your platform specific Kconfig file here
#
# "drivers/gpu/arm/midgard/platform/xxx/Kconfig"
#
# Where xxx is the platform name is the name set in MALI_PLATFORM_NAME
#
```

## drivers/misc/mediatek/himntn_kernel/Kconfig
```kconfig
config HIMNTN_FEATURE_SUPPORT
	bool "himntn feature switch"
	default n
	help
	  himntn feature is used to control maintenance,
	  which can be correct partition value in kernel phase.
	  you should set in project configure file.
```

## drivers/misc/mediatek/imgsensor/src/dsm_camera/Kconfig
```kconfig
config HUAWEI_DSM_CAMERA
	bool "dsm camera"
	default n
	depends on HUAWEI_DSM
	help
	  Huawei Dsm Camera Function.
```

## drivers/misc/mediatek/nfc/Kconfig
```kconfig
config NFC_ST21NFC
	tristate "ST21NFC driver"
	depends on I2C
	help
	  ST21NFC driver.

config MTK_NFC_CLKBUF_ENABLE
	tristate "Enable clock buffer for NFC"
	help
	  Enable clock buffer from PMIC for NFC.

config NFC_CHIP_NXP
	tristate "PN547 NFC driver"
	depends on I2C
	help
	  NXP PN547 driver.

config NFC_CHIP_SUPPORT
	tristate "Enable clock buffer for NFC"
	help
	  Enable clock buffer from PMIC for NFC.
```

## drivers/misc/mediatek/tui/Kconfig
```kconfig
#
# ITRUSTEE TUI configuration
#

config ITRUSTEE_TRUSTED_UI
	bool "ITRUSTEE Trusted User Interface"
	default n
	---help---
	  Enable ITRUSTEE Trusted User Interface
	  ITRUSTEE TUI features was based on ITRUSTEE TEE mechanism to protect
	  Touch/Display inside TEE, to prevent malicious access of sensitive data
	  used by APPs like Banking.
```

## drivers/mmc/Kconfig
```kconfig
#
# MMC subsystem configuration
#

menuconfig MMC
	tristate "MMC/SD/SDIO card support"
	depends on HAS_IOMEM
	help
	  This selects MultiMediaCard, Secure Digital and Secure
	  Digital I/O support.

	  If you want MMC/SD/SDIO support, you should say Y here and
	  also to your specific host controller driver.
config HUAWEI_SDCARD_DSM
	bool "Listen sdcard kernel err"
	depends on MMC != n
	default n
	help
	   use huawei sdcard log radar

config HUAWEI_EMMC_DSM
	bool "Listen eMMC kernel err"
	depends on MMC != n
	default n
	help
	   use huawei emmc log radar

config MMC_DW_MUX_SDSIM
	tristate "MUX SDSIM support"
	default n
	help
	  This selects support for MMC_DW MUX_SDSIM.

config MSDC_SDSIM_DIRECT_CONNECT
	tristate "MUX SDSIM DIRECT CONNECT support"
	default n
	depends on MMC_DW_MUX_SDSIM
	help
	  This selects support for MSDC_SDSIM_DIRECT_CONNECT.

if MMC

source "drivers/mmc/core/Kconfig"

source "drivers/mmc/host/Kconfig"

endif # MMC
```

## drivers/oeminfo/Kconfig
```kconfig
# detect devices

menuconfig HUAWEI_OEMINFO
    bool "HUAWEI OEMINFO"
    default n
    help
      Say yes if you want i2c device detect driver.
      This is for i2c connected version. If unsure, say N here.

menuconfig OEMINFO_WP_FEATURE
    bool "OEMINFO_WP_FEATURE"
    default n
    help
      Say yes if you want i2c device detect driver.
      This is for i2c connected version. If unsure, say N here.
```

## drivers/perf_ctrl/Kconfig
```kconfig
menu "Huawei Performace Control"

config HUAWEI_PERF_CTRL
	tristate "Huawei Performance Control Drivers"
	default n
	help
	  Huawei Performance Control Drivers

config HUAWEI_DDR_PERF_CTRL
	bool "ddr perf ctrl"
	depends on HUAWEI_PERF_CTRL
	default n

config HUAWEI_THERMAL_PERF_CTRL
	bool "thermal perf ctrl"
	depends on HUAWEI_PERF_CTRL
	default n

config RENDER_RT
	bool "render realted thread"
	default n
	help
	  Render Related Thread

config RENDER_RT_DEBUG
	bool "render realted thread test"
	depends on RENDER_RT
	depends on DEBUG_FS
	default n
	help
	  Render Related Thread debug trace

endmenu
```

## drivers/perfhub/Kconfig
```kconfig
config HW_PERFHUB
       bool "huawei perfhub"
       default n

config HW_PERFHUB_TRACE
       bool "huawei perfhub tracepoint"
       default n
```

## drivers/thermal/hw/Kconfig
```kconfig
config HW_EXTERNAL_SENSOR_QCOM
	bool "distinguish IPA for Qcom or MTK"
	default n
	help
	  indicate IPA for Qcom

config HW_EXTERNAL_SENSOR
	tristate "Support external sensor driver instead of HW_THERMAL_TSENSOR in IPA"
	default n
	help
	  Support external sensor driver instead of HW_THERMAL_TSENSOR in IPA

config HW_IPA_THERMAL
	#tristate "Temperature sensor on ARM SoC based on HW_THERMAL_TSENSOR interface"
	tristate "Temperature sensor on ARM SoC"
	#depends on HW_THERMAL_TSENSOR
	depends on CPU_FREQ
	depends on OF
	select THERMAL_POWER_ACTOR_CPU
	help
	  Support for the HW thermal sensor driver in the Linux thermal
	  framework.

config HW_THERMAL_TSENSOR
	tristate "Hw thermal sensor driver"
	default n
	help
	  Enable this to plug the thermal sensor driver into the Linux
	  thermal framework

config HW_THERMAL_PERIPHERAL
	tristate "Hw peripheral thermal driver"
	default n
	help
	  Enable this to plug the peripheral thermal sensor driver into the Linux
	  thermal framework

config HW_THERMAL_PERIPHERAL_HIGHRESTEMP
	bool "High resolution thermal format for Hw peripheral thermal driver"
	depends on HW_THERMAL_PERIPHERAL
	default n
	help
	  Enable this to use hi-resolution temperature format for PERIPHERAL thermal.

config HW_THERMAL_CONTEXTHUB
	bool "Hw contexthub thermal driver"
	default n
	help
	  Enable Contexthub Thermal

config HW_THERMAL_SPM
	bool "Hw sustainable performance mode"
	depends on HW_IPA_THERMAL
	default n
	help
	  Enable sustainable performance mode

config HW_THERMAL_HOTPLUG
	bool "Hw thermal hotplug support"
	depends on HOTPLUG_CPU
	depends on HW_IPA_THERMAL
	default n
	help
	  Enable thermal hotplug

config HW_THERMAL_GPU_HOTPLUG
	bool "Hw thermal gpu hotplug support"
	depends on HW_IPA_THERMAL
	depends on HW_GPU_CORE_HOTPLUG
	default n
	help
	  Enable gpu thermal hotplug

config HW_GPU_HOTPLUG_EMULATION
	bool "Hw thermal gpu hotplug emulation support"
	depends on HW_THERMAL_GPU_HOTPLUG
	default n
	help
	  Enable thermal gpu hotplug emulation

config HW_THERMAL_NPU_HOTPLUG
	bool "Hw thermal npu hotplug support"
	depends on HW_IPA_THERMAL
	default n
	help
	  Enable npu thermal hotplug

config HW_NPU_HOTPLUG_EMULATION
	bool "Hw thermal npu hotplug emulation support"
	depends on HW_THERMAL_NPU_HOTPLUG
	default n
	help
	  Enable thermal npu hotplug emulation

config HW_HOTPLUG_EMULATION
	bool "Hw thermal hotplug emulation support"
	depends on HW_THERMAL_HOTPLUG
	default n
	help
	  Enable thermal hotplug emulation

config HW_THERMAL_TRIP
	bool "Hw trip point for thermal zone"
	depends on HW_THERMAL_TSENSOR
	depends on HW_THERMAL_PERIPHERAL
	depends on HW_BCI_BATTERY
	default n
	help
	  Enable trip point for thermal zone

config HW_THERMAL_SHELL
	bool "Hw shell temp calculation"
	#depends on HW_THERMAL_PERIPHERAL
	#depends on HW_COUL
	default n
	help
	  Enable shell temp calculation
config HW_SHELL_TEMP_DEBUG
	bool "Hw shell temp debug configuration"
	depends on HW_THERMAL_SHELL
	default n
	help
	  Enable debug node for shell temp calculation
```

## drivers/tzdriver/Kconfig
```kconfig
menu "TEE OS"

config TZDRIVER
	tristate "Secure Execution Communicator driver"
	default n
	help
	  Provides a communication interface between userspace and
	  TrustZone Operating Environment.

config HISI_SECBOOT_IMG
	bool "tzdriver split secboot img into modem and ap"
	default n
	depends on KERNEL_CLIENT
	help
	  Macro defined for splitting modem and ap img

config HISI_SECBOOT_IMG_V2
	bool "tzdriver split modem and ap for v2"
	default n
	depends on KERNEL_CLIENT
	help
	  Macro defined for splitting modem and ap img v2

config ASAN_DEBUG
	bool "hisi ASAN debug version"
	default n
	help
	  Macro defined for ASAN debug version

source  drivers/tzdriver/auth/Kconfig
source  drivers/tzdriver/core/Kconfig
source  drivers/tzdriver/ion/Kconfig
source  drivers/tzdriver/tlogger/Kconfig
source  drivers/tzdriver/tui/Kconfig
source  drivers/tzdriver/agent_rpmb/Kconfig

endmenu
```

## drivers/uni_drivers/Kconfig
```kconfig
#=============================================================================
#  add new config for devices check
#  add new config for factory cmdline parse
#  add new config for antenna board gpio match
#=============================================================================
menu "Huawei Platform UNI Drivers"
source "drivers/uni_drivers/file_encry/Kconfig"
source "drivers/uni_drivers/secmem/Kconfig"
source "drivers/uni_drivers/hkip/Kconfig"
source "drivers/uni_drivers/kdump/Kconfig"
source "drivers/uni_drivers/contexthub/Kconfig"
source "drivers/uni_drivers/power/Kconfig"
endmenu
```

## drivers/uni_drivers/contexthub/Kconfig
```kconfig
config CONTEXTHUB
	bool "Sensor CONTEXTHUB driver"
	default n
	help
	Sensor CONTEXTHUB driver.

config CONTEXTHUB_SHMEM
	bool "Sensor CONTEXTHUB SHMEM driver"
	depends on INPUTHUB || INPUTHUB_20
	default y
	help
	Say yes here if you want to configure contexthub share memory

config CONTEXTHUB_UNIFIED_TRANSFER
	bool "Sensor CONTEXTHUB unified transfer feature"
	default n
	help
	Say yes here if you want to use unified transfer feature

config HUAWEI_SOFTTIMER
	bool "HUAWEI SOFTTIMER support"
	depends on CONTEXTHUB
	default n
	---help---
	  Enable support for softtimer driver

source "drivers/uni_drivers/contexthub/flp/Kconfig"
source "drivers/uni_drivers/contexthub/ar/Kconfig"
```

## drivers/uni_drivers/contexthub/ar/Kconfig
```kconfig
#
# FLP driver configuration
#

menu "HUAWEI AR configuration"

config HUAWEI_AR
	bool "HUAWEI AR support"
	depends on HUAWEI_SOFTTIMER
	default n
	---help---
	  Enable support for AR driver

config CONTEXTHUB_UNIFORM_INTERVAL
	bool "HUAWEI CONTEXTHUB_UNIFORM_INTERVAL support"
	depends on HUAWEI_AR
	default n
	---help---
	  Enable support for CONTEXTHUB_UNIFORM_INTERVAL driver

endmenu
```

## drivers/uni_drivers/contexthub/flp/Kconfig
```kconfig
#
# FLP driver configuration
#

menu "HUAWEI FLP configuration"

config HUAWEI_FLP
	bool "HUAWEI FLP support"
	depends on HUAWEI_SOFTTIMER
	default n
	---help---
	  Enable support for FLP driver

config HUAWEI_FLP_GEOFENCE
	bool "HUAWEI FLP GEOFENCE support"
	depends on HUAWEI_FLP
	default n
	---help---
	  Enable support for GEOFENCE driver

config HUAWEI_FLP_CELLFENCE
	bool "HUAWEI FLP CELLFENCE support"
	depends on HUAWEI_FLP
	default n
	---help---
	  Enable support for CELLFENCE driver

config HUAWEI_FLP_WIFIFENCE
	bool "HUAWEI_FLP_WIFIFENCE support"
	depends on HUAWEI_FLP
	default n
	---help---
	  Enable support for WIFIFENCE driver

config HUAWEI_FLP_BATCHING
	bool "HUAWEI_FLP_BATCHING support"
	depends on HUAWEI_FLP
	default n
	---help---
	  Enable support for BATCHING driver

config HUAWEI_FLP_DIAG
	bool "HUAWEI_FLP_DIAG support"
	depends on HUAWEI_FLP
	default n
	---help---
	  Enable support for DIAG driver

endmenu
```

## drivers/uni_drivers/easy_shell/Kconfig
```kconfig
#
# huawei easy shell configuration
#

config HUAWEI_BB_ECALL
	bool "huawei blackbox ecall"
	default n
	depends on HUAWEI_KERNEL_DEBUG
	help
	  If you say yes here you get support for huawei blackbox ecall.
```

## drivers/uni_drivers/file_encry/Kconfig
```kconfig
config HUAWEI_FBE
	bool "HUAWEI FBE2 support"
	default n
	help
	  Say yes here to support the HUAWEI FBE2

config HUAWEI_FBE_DBG
	bool "HUAWEI FBE2 debug support"
	depends on HUAWEI_FBE
	default n
	help
	  Say yes here to support the HUAWEI FBE2 debug
```

## drivers/uni_drivers/hkip/Kconfig
```kconfig
config HUAWEI_HKIP
	bool "HUAWEI HKIP support"
	default n
	help
	  Say yes here to support the HUAWEI HKIP

config HKIP_MODULE_ALLOC
	bool "HKIP overload module_alloc"
	depends on HUAWEI_HKIP
	default n
	help
	  Say yes when overload is needed

config HUAWEI_HKIP_DEBUG
	bool "HUAWEI HKIP test support"
	depends on !UBSAN && !KCOV && !KASAN
	depends on HUAWEI_HKIP
	default n
	help
	  Say yes here to support the HKIP debug

config HKIP_PRMEM
	bool "Write protect critical data not requiring high write speed."
	default n
	help
	  Selected data can be tagged/allocated in such a way that it
	  becomes read-only, with the option of allowing for modifications
	  through specific API. Run-time allocation must also use such API.
	  Saying No here will revert to basic kernel vmalloc.

config HKIP_PRMEM_BYPASS
	bool "Let the allocator active, but do not protect the memory"
	depends on HKIP_PRMEM
	default n
	help
	  Useful for debugging or for testing existing code while it is
	  being converted to the prmem API.
	  Saying Yes here will not write protect the allocations.

config DEBUG_HKIP_PRMEM
	bool "Run self test for protected memory (prmem)"
	depends on HKIP_PRMEM
	default n
	help
	  Verifies that the protected memory interface works correctly.

config HKIP_USING_IPI
	bool "HKIP Using IPI interrupt"
	depends on HUAWEI_HKIP
	default n
	help
	  Say yes here to support using IPI not GIC
```

## drivers/uni_drivers/kdump/Kconfig
```kconfig
#
# huawei blackbox kdump configuration
#

config HUAWEI_BB
	bool "huawei blackbox kdump"
	default n
	help
	  If you say yes here you get support for huawei kernel dump.
```

## drivers/uni_drivers/power/Kconfig
```kconfig
config HW_PLAT_POWER
	bool "enable huaweiplatform power"
	default n
	help
	  Support huaweiplatform power.

source "drivers/uni_drivers/power/charge_time/Kconfig"
```
