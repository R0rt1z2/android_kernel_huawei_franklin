&huawei_wifi_info {
	compatible = "huawei,huawei_wifi_info";
	status = "okay";
	ini_type = "FRL";
	wifi_chiptype = "WIFI_MTK_6631";
	power_limit = "FT";
	antenna_types = "TCXO";
	wifi_cfg_type = "FRL5G_";
};
