/* feature : $enable $dl_mem $ul_mem $ref_mem $size */
&snd_audio_dsp {
	mtk_dsp_voip = <0x5 0x1 0xffffffff 0xffffffff 0x30000>;
	mtk_dsp_primary = <0x5 0x0 0xffffffff 0xffffffff 0x30000>;
	mtk_dsp_offload = <0x0 0x6 0xffffffff 0xffffffff 0x400000>;
	mtk_dsp_deep = <0x5 0x3 0xffffffff 0xffffffff 0x30000>;
	mtk_dsp_playback = <0x1 0x4 0x10 0x14 0x30000>;
	mtk_dsp_music = <0x1 0xffffffff 0xffffffff 0xffffffff 0x0>;
	mtk_dsp_capture1 = <0x0 0xffffffff 0xd 0x13 0x20000>;
	mtk_dsp_a2dp = <0x0 0xffffffff 0xffffffff 0xffffffff 0x40000>;
	mtk_dsp_dataprovider = <0x0 0xffffffff 0xf 0xffffffff 0x30000>;
	mtk_dsp_call_final = <0x5 0x0 0x10 0x14 0x18000>;
	mtk_dsp_fast = <0x5 0x2 0xffffffff 0xffffffff 0x5000>;
	mtk_dsp_ktv = <0x0 0x8 0x12 0xffffffff 0x10000>;
	mtk_dsp_ver = <0x1>;
	swdsp_smartpa_process_enable = <0x5>;
	mtk_dsp_mem_afe = <0x1 0x40000>; /* always enable */
};