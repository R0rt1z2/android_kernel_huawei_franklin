
&smartpakit {
	compatible = "huawei,smartpakit";
	/* 0 hisi, 1 qcom , 2 mtk*/
	soc_platform = <2>;
	/* algo running on: 0 codec_dsp, 1 soc_dsp, 2 smartpa_dsp, 3 simple pa(not smpartpa), 4 simple pa(with i2c) */
	algo_in = <1>;
	/* algo_in params need match out_device for smartpa.
	* Now, up to only support four pa, so out_device = <0 0 0 0>;
	* 1. This array is arranged in the following order:
	*    <0 1 2 3>
	*    <pril prir secl secr>
	* 2. This array element value is 0 or 1:
	*    smartpa: 0 speaker, 1 receiver
	*    simple pa: out_device not applicable, only set 0 to indicate pa_num
	* 3. The length of this array is variable, for example:
	*    single pa: out_device = <0>;
	*    two pa: out_device = <0 0>;
	*    four pa: out_device = <1 1 0 0>; */
	out_device = <0 0 0 0>;
	/* param_version: 1 mixed smartpa param support */
	param_version = <1>;
	status = "okay";
};