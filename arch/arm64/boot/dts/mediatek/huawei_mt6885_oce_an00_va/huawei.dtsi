#include "huawei-charger.dtsi"
#include "huawei-sim.dtsi"
#include "huawei-led.dtsi"
#include "huawei-lcd.dtsi"
#include "huawei-tp.dtsi"
#include "huawei-sensor.dtsi"
#include "huawei-camera.dtsi"
#include "huawei-nfc.dtsi"
#include "huawei-dp.dtsi"
#include "huawei-irda.dtsi"
#include "huawei-storage.dtsi"
#include "huawei-audio.dtsi"
#include "huawei-rf.dtsi"
#include "huawei-fingerprint.dtsi"
#include "huawei-reserved-tee-mem.dtsi"
#include "huawei-wifi.dtsi"
