/* Copyright (c) 2013, The Linux Foundation. All rights reserved.
 *
 * This program is free software; you can redistribute it and/or modify
 * it under the terms of the GNU General Public License version 2 and
 * only version 2 as published by the Free Software Foundation.
 *
 * This program is distributed in the hope that it will be useful,
 * but WITHOUT ANY WARRANTY; without even the implied warranty of
 * MERCHANTABILITY or FITNESS FOR A PARTICULAR PURPOSE.  See the
 * GNU General Public License for more details.
 */

/*-------------------------------------------------------------------------
 * This file is autogenerated file using gcdb parser. Please do not edit it.
 * Update input XML file to add a new entry or update variable in this file
 * VERSION = 1.1
 *-----------------------------------------------------------------------*/
&huawei_lcd_config {
	dsi_tsb_020_209_6p81: lcd_kit_tsb_020_209_6p81 {
		compatible = "020_209_6p81";
		lcd-kit,panel-name = "020_209 6.81' VIDEO 1080 x 2400";
		lcd-kit,panel-type = <0x01>;
		lcd-kit,panel-xres = <1080>;
		lcd-kit,panel-yres = <2400>;
		lcd-kit,panel-width = <71>;
		lcd-kit,panel-height = <158>;
		lcd-kit,panel-on-cmds = <0x15 0x01 0x00 0x00 0x0a 0x00 0x02 0xFF 0x10
		0x15 0x01 0x00 0x00 0x0a 0x00 0x02 0xFB 0x01
		0x15 0x01 0x00 0x00 0x0a 0x00 0x02 0xB0 0x01
		0x15 0x01 0x00 0x00 0x0a 0x00 0x02 0xFF 0x27
		0x15 0x01 0x00 0x00 0x0a 0x00 0x02 0x4D 0xFF
		0x15 0x01 0x00 0x00 0x0a 0x00 0x02 0x4E 0xFF
		0x15 0x01 0x00 0x00 0x0a 0x00 0x02 0xFF 0x10
		0x15 0x01 0x00 0x00 0x0a 0x00 0x02 0xFB 0x01
		0x15 0x01 0x00 0x00 0x0a 0x00 0x02 0x35 0x00
		0x39 0x01 0x00 0x00 0x0a 0x00 0x03 0x51 0xFF 0xFF
		0x15 0x01 0x00 0x00 0x0a 0x00 0x02 0x53 0x2C
		0x15 0x01 0x00 0x00 0x0a 0x00 0x02 0x55 0x00
		0x15 0x01 0x00 0x00 0x0a 0x00 0x02 0xFF 0x24
		0x15 0x01 0x00 0x00 0x0a 0x00 0x02 0xFB 0x01
		0x15 0x01 0x00 0x00 0x0a 0x00 0x02 0x4E 0x75
		0x15 0x01 0x00 0x00 0x0a 0x00 0x02 0x4F 0x75
		0x15 0x01 0x00 0x00 0x0a 0x00 0x02 0x53 0x75
		0x15 0x01 0x00 0x00 0x0a 0x00 0x02 0x7D 0x05
		0x15 0x01 0x00 0x00 0x0a 0x00 0x02 0x80 0x05
		0x15 0x01 0x00 0x00 0x0a 0x00 0x02 0x81 0x05
		0x15 0x01 0x00 0x00 0x0a 0x00 0x02 0xA4 0x05
		0x15 0x01 0x00 0x00 0x0a 0x00 0x02 0xA5 0x05
		0x15 0x01 0x00 0x00 0x0a 0x00 0x02 0xFF 0x26
		0x15 0x01 0x00 0x00 0x0a 0x00 0x02 0xFB 0x01
		0x15 0x01 0x00 0x00 0x0a 0x00 0x02 0x01 0xF8
		0x15 0x01 0x00 0x00 0x0a 0x00 0x02 0x04 0xF8
		0x15 0x01 0x00 0x00 0x0a 0x00 0x02 0x06 0x21
		0x15 0x01 0x00 0x00 0x0a 0x00 0x02 0x08 0x21
		0x15 0x01 0x00 0x00 0x0a 0x00 0x02 0x84 0x04
		0x15 0x01 0x00 0x00 0x0a 0x00 0x02 0x86 0x04
		0x15 0x01 0x00 0x00 0x0a 0x00 0x02 0x88 0x0E
		0x15 0x01 0x00 0x00 0x0a 0x00 0x02 0x9B 0x04
		0x15 0x01 0x00 0x00 0x0a 0x00 0x02 0xFF 0x2A
		0x15 0x01 0x00 0x00 0x0a 0x00 0x02 0xFB 0x01
		0x15 0x01 0x00 0x00 0x0a 0x00 0x02 0x0C 0x09
		0x15 0x01 0x00 0x00 0x0a 0x00 0x02 0x0F 0x00
		0x15 0x01 0x00 0x00 0x0a 0x00 0x02 0x11 0xF0
		0x15 0x01 0x00 0x00 0x0a 0x00 0x02 0x16 0x8D
		0x15 0x01 0x00 0x00 0x0a 0x00 0x02 0x19 0x0F
		0x15 0x01 0x00 0x00 0x0a 0x00 0x02 0x1A 0x61
		0x15 0x01 0x00 0x00 0x0a 0x00 0x02 0x1E 0x81
		0x15 0x01 0x00 0x00 0x0a 0x00 0x02 0x1F 0x81
		0x15 0x01 0x00 0x00 0x0a 0x00 0x02 0x20 0x81
		0x15 0x01 0x00 0x00 0x0a 0x00 0x02 0xFF 0xC0
		0x15 0x01 0x00 0x00 0x0a 0x00 0x02 0xFB 0x01
		0x15 0x01 0x00 0x00 0x0a 0x00 0x02 0xFF 0x10
		0x05 0x01 0x00 0x00 0x46 0x01 0x01 0x11
		0x05 0x01 0x00 0x00 0x01 0x01 0x01 0x29>;
		lcd-kit,panel-on-cmds-state = "dsi_lp_mode";
		lcd-kit,panel-off-cmds = <0x15 0x01 0x00 0x00 0x0a 0x00 0x02 0xFF 0x10
		0x15 0x01 0x00 0x00 0x0a 0x00 0x02 0xFB 0x01
		0x05 0x01 0x00 0x00 0x14 0x01 0x01 0x28
		0x05 0x01 0x00 0x00 0x46 0x01 0x01 0x10
		0x15 0x01 0x00 0x00 0x0a 0x01 0x02 0x4F 0x01>;
		lcd-kit,panel-off-cmds-state = "dsi_lp_mode";
		lcd-kit,tp-color-cmds = <0x06 0x01 0x00 0x00 0x0a 0x00 0x01 0xda>;
		lcd-kit,inversion-dot-cmds = <0x15 0x01 0x00 0x00 0x0a 0x00 0x02 0xFF 0x24
		0x15 0x01 0x00 0x00 0x0a 0x00 0x02 0xFB 0x01
		0x15 0x01 0x00 0x00 0x0a 0x00 0x02 0xCF 0x33
		0x15 0x01 0x00 0x00 0x0a 0x00 0x02 0xFF 0x10
		0x15 0x01 0x00 0x00 0x0a 0x00 0x02 0xFF 0x20
		0x15 0x01 0x00 0x00 0x0a 0x00 0x02 0xFB 0x01
		0x15 0x01 0x00 0x00 0x0a 0x00 0x02 0x30 0x0F
		0x15 0x01 0x00 0x00 0x0a 0x00 0x02 0xFF 0x10>;
		lcd-kit,inversion-column-cmds = <0x15 0x01 0x00 0x00 0x0a 0x00 0x02 0xFF 0x24
		0x15 0x01 0x00 0x00 0x0a 0x00 0x02 0xFB 0x01
		0x15 0x01 0x00 0x00 0x0a 0x00 0x02 0xCF 0xFF
		0x15 0x01 0x00 0x00 0x0a 0x00 0x02 0xFF 0x10
		0x15 0x01 0x00 0x00 0x0a 0x00 0x02 0xFF 0x20
		0x15 0x01 0x00 0x00 0x0a 0x00 0x02 0xFB 0x01
		0x15 0x01 0x00 0x00 0x0a 0x00 0x02 0x30 0x0F
		0x15 0x01 0x00 0x00 0x0a 0x00 0x02 0xFF 0x10>;
		lcd-kit,esd-reg-cmds = <0x06 0x01 0x00 0x00 0x0a 0x00 0x01 0x05
		0x06 0x01 0x00 0x00 0x0a 0x00 0x01 0x0a>;
		lcd-kit,esd-reg-cmds-state = "dsi_lp_mode";
		lcd-kit,esd-value = <0x00 0x9c>;
		lcd-kit,check-reg-cmds = <0x06 0x01 0x00 0x00 0x0a 0x00 0x01 0x0a>;
		lcd-kit,check-reg-cmds-state = "dsi_lp_mode";
		lcd-kit,check-reg-value = <0x9c>;
		lcd-kit,mipi-check-cmds = <0x06 0x01 0x00 0x00 0x0a 0x00 0x01 0x05>;
		lcd-kit,mipi-check-cmds-state = "dsi_lp_mode";
		lcd-kit,mipi-check-value = <0x00>;
		lcd-kit,barcode-2d-cmds = <0x15 0x01 0x00 0x00 0x0a 0x00 0x02 0xFF 0x21
		0x06 0x01 0x00 0x00 0x0a 0x00 0x05 0xF1 0x00 0x00 0x00 0x00
		0x15 0x01 0x00 0x00 0x0a 0x00 0x02 0xFA 0x05
		0x06 0x01 0x00 0x00 0x0a 0x00 0x05 0xF1 0x00 0x00 0x00 0x00
		0x15 0x01 0x00 0x00 0x0a 0x00 0x02 0xFA 0x0A
		0x06 0x01 0x00 0x00 0x0a 0x00 0x05 0xF1 0x00 0x00 0x00 0x00
		0x15 0x01 0x00 0x00 0x0a 0x00 0x02 0xFA 0x0F
		0x06 0x01 0x00 0x00 0x0a 0x00 0x01 0xF1
		0x15 0x01 0x00 0x00 0x0a 0x00 0x02 0xFA 0x00
		0x06 0x01 0x00 0x00 0x0a 0x00 0x05 0xF2 0x00 0x00 0x00 0x00
		0x15 0x01 0x00 0x00 0x0a 0x00 0x02 0xFF 0x10>;
		lcd-kit,project-id-cmds = <0x15 0x01 0x00 0x00 0x0a 0x00 0x02 0xFF 0x21
		0x06 0x01 0x00 0x00 0x0a 0x00 0x05 0xF7 0x00 0x00 0x00 0x00
		0x15 0x01 0x00 0x00 0x0a 0x00 0x02 0xFA 0x05
		0x06 0x01 0x00 0x00 0x0a 0x00 0x05 0xF7 0x00 0x00 0x00 0x00
		0x15 0x01 0x00 0x00 0x0a 0x00 0x02 0xFF 0x10>;
		lcd-kit,project-id-cmds-state = "dsi_lp_mode";
		lcd-kit,panel-bl-maxnit-command = <0x06 0x01 0x00 0x00 0x0a 0x00 0x01 0xdc>;
		lcd-kit,panel-bl-maxnit-command-state = "dsi_lp_mode";
		lcd-kit,lcd-btb-support = <0>;
		lcd-kit,lcd-btb-check-type = <0>;
		lcd-kit,lcd-btb-gpio = <73 76>;
		lcd-kit,panel-lcm-type = <2>;
		lcd-kit,panel-ldi-dsi-mode = <1>;
		lcd-kit,panel-dsi-switch-mode = <0>;
		lcd-kit,panel-dsi-switch-mode-en = <0>;
		lcd-kit,panel-ldi-trans-seq = <0>;
		lcd-kit,panel-ldi-data-padding = <0>;
		lcd-kit,panel-ldi-packet-size = <256>;
		lcd-kit,panel-ldi-ps = <2>;
		lcd-kit,panel-vfp-lp = <0>;
		lcd-kit,panel-fbk-div = <1>;
		lcd-kit,panel-orientation = <1>;
		lcd-kit,panel-bpp = <2>;
		lcd-kit,panel-bgr-fmt = <0>;
		lcd-kit,panel-cmd-type = <8>;
		lcd-kit,panel-pxl-clk = <0>;
		lcd-kit,panel-pxl-clk-div = <0>;
		lcd-kit,panel-data-rate = <1100>;
		lcd-kit,mipi-lane-nums = <4>;
		lcd-kit,h-back-porch = <48>;
		lcd-kit,h-front-porch = <48>;
		lcd-kit,h-pulse-width = <8>;
		lcd-kit,project-id-support = <1>;
		lcd-kit,default-project-id = "TSHB9V020";
		lcd-kit,v-back-porch = <12>;
		lcd-kit,v-front-porch = <24>;
		lcd-kit,v-pulse-width = <4>;
		lcd-kit,mipi-clk-post-adjust = <0>;
		lcd-kit,mipi-lp11-flag = <0>;
		lcd-kit,esd-support = <1>;
		lcd-kit,skip-poweron-esd-check = <0>;
		lcd-kit,tp-color-support = <0>;
		lcd-kit,lcd-vsp = <2 137 5500000>;
		lcd-kit,lcd-vsn = <2 138 5500000>;
		lcd-kit,lcd-reset = <2 86 0>;
		lcd-kit,power-on-stage = <3 1 3
				4 1 3
				11 1 10
				5 2 10
				5 1 3
				5 2 1
				5 1 10
				7 1 1
				6 1 0
				8 1 0>;
		lcd-kit,lp-on-stage = <0 0 0>;
		lcd-kit,hs-on-stage = <0 0 0>;
		lcd-kit,hs-off-stage = <0 0 0>;
		lcd-kit,lp-off-stage = <0 0 0>;
		lcd-kit,power-off-stage = <7 0 1
				8 0 20
				6 0 1
				4 0 2
				3 0 3>;
		lcd-kit,pt-support = <1>;
		lcd-kit,panel-density = <320>;
		lcd-kit,ssc-disable = <1>;
		lcd-kit,inversion-support = <1>;
		lcd-kit,check-reg-support = <1>;
		lcd-kit,panel-bl-min = <65>;
		lcd-kit,panel-bl-max = <10000>;
		lcd-kit,panel-bl-max-nit = <450>;
		lcd-kit,panel-bl-boot = <255>;
		lcd-kit,mipi-non-continue-enable = <1>;
		lcd-kit,panel-getblmaxnit-type = <1>;
		lcd-kit,panel-bl-ic-ctrl-type = <6>;
		lcd-kit,panel-bias-ic-ctrl-type = <3>;
		lcd-kit,oem-info-support = <1>;
		lcd-kit,oem-barcode-2d-support = <1>;
		lcd-kit,oem-barcode-2d-num-offset = <0>;
		lcd-kit,panel-on-always-reset = <1>;
		lcd-kit,panel-gpio-offset = <300>;
		lcd-kit,backlight-order = <0>;
		lcd-kit,dsc-enable = <0>;
		lcd-kit,dsc-ver = <17>;
		lcd-kit,dsc-slice-mode = <1>;
		lcd-kit,dsc-rgb-swap = <0>;
		lcd-kit,dsc-cfg = <34>;
		lcd-kit,dsc-rct-on = <1>;
		lcd-kit,dsc-bit-per-channel = <8>;
		lcd-kit,dsc-line-buf-depth = <9>;
		lcd-kit,dsc-bp-enable = <1>;
		lcd-kit,dsc-bit-per-pixel = <128>;
		lcd-kit,dsc-pic-height = <2400>;
		lcd-kit,dsc-pic-width = <1080>;
		lcd-kit,dsc-slice-height = <20>;
		lcd-kit,dsc-slice-width = <540>;
		lcd-kit,dsc-chunk-size = <540>;
		lcd-kit,dsc-xmit-delay = <512>;
		lcd-kit,dsc-dec-delay = <526>;
		lcd-kit,dsc-scale-value = <32>;
		lcd-kit,dsc-increment-interval = <488>;
		lcd-kit,dsc-decrement-interval = <7>;
		lcd-kit,dsc-line-bpg-offset = <12>;
		lcd-kit,dsc-nfl-bpg-offset = <1294>;
		lcd-kit,dsc-slice-bpg-offset = <1302>;
		lcd-kit,dsc-initial-offset = <6144>;
		lcd-kit,dsc-final-offset = <4336>;
		lcd-kit,dsc-flatness-minqp = <3>;
		lcd-kit,dsc-flatness-maxqp = <12>;
		lcd-kit,dsc-rc-model-size = <8192>;
		lcd-kit,dsc-rc-edge-factor = <6>;
		lcd-kit,dsc-rc-quant-incr-limit0 = <11>;
		lcd-kit,dsc-rc-quant-incr-limit1 = <11>;
		lcd-kit,dsc-rc-tgt-offset-hi = <3>;
		lcd-kit,dsc-rc-tgt-offset-lo = <3>;
		lcd-kit,vetical-refresh = <60>;
		lcd-kit,inversion-column-cmds-state = "dsi_lp_mode";
		lcd-kit,inversion-dot-cmds-state = "dsi_lp_mode";
		lcd-kit,quickly-sleep-out-support = <1>;
		lcd-kit,quickly-sleep-out-interval = <35>;
		lcd-kit,mipi-hop-h-back-porch = <10>;
		lcd-kit,mipi-hop-h-front-porch = <32>;
		lcd-kit,mipi-hop-h-pulse-width = <10>;
		lcd-kit,mipi-hop-v-back-porch = <60>;
		lcd-kit,mipi-hop-v-front-porch = <14>;
		lcd-kit,mipi-hop-v-pulse-width = <30>;
		lcd-kit,mipi-hop-lp-v-front-porch = <14>;
		lcd-kit,Does-lcd-poweron-tp = <1>;
		lcd-kit,mipi-hop-support = <0>;
		lcd-kit,mipi-read-gerneric = <1>;
		lcd-kit,rgbw-support = <0>;
		lcd-kit,imax-lcd-luminance = <500>;
		lcd-kit,imin-lcd-luminance = <3>;
		lcd-kit,panel-blmaxnit-min-value = <400>;
		lcd-kit,mtk-high-left-time-th-us = <5000>;
		lcd-kit,mtk-high-right-time-th-us = <9000>;
		lcd-kit,mtk-high-te-inerval-time-us = <11111>;
		lcd-kit,mtk-low-left-time-th-us = <9000>;
		lcd-kit,mtk-low-right-time-th-us = <15000>;
		lcd-kit,mtk-low-te-inerval-time-us = <16667>;
		lcd-kit,sn-code-support = <0>;
		lcd-kit,panel-round-corner-enable = <0>;
		lcd-kit,panel-round-corner-full-content = <0>;
		lcd-kit,panel-round-corner-h = <0>;
		lcd-kit,panel-round-corner-h-bot = <0>;
    };
};