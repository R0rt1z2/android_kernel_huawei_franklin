/*---------------------------------------------------------------------------
 * This file is autogenerated file using huawei LCD parser. Please do not edit it.
 * Update input XML file to add a new entry or update variable in this file
 * Parser location: vendor/huawei/chipset_common/devkit/lcdkit/tools 
 *---------------------------------------------------------------------------*/


#include "pku_250_a03_6p5.dtsi"
#include "pku_320_a03_6p5.dtsi"
#include "pku_330_a03_6p5.dtsi"
#include "pku_auo_otm1901a_5p2_1080p_video_default.dtsi"