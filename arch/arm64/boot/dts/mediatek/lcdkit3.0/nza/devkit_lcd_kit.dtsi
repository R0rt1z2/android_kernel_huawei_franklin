/*---------------------------------------------------------------------------
 * This file is autogenerated file using huawei LCD parser. Please do not edit it.
 * Update input XML file to add a new entry or update variable in this file
 * Parser location: vendor/huawei/chipset_common/devkit/lcdkit/tools 
 *---------------------------------------------------------------------------*/


#include "nza_120_a02_6p59.dtsi"
#include "nza_190_a02_6p59.dtsi"
#include "nza_250_a02_6p59.dtsi"
#include "nza_auo_otm1901a_5p2_1080p_video_default.dtsi"