/* Copyright (c) 2013, The Linux Foundation. All rights reserved.
 *
 * This program is free software; you can redistribute it and/or modify
 * it under the terms of the GNU General Public License version 2 and
 * only version 2 as published by the Free Software Foundation.
 *
 * This program is distributed in the hope that it will be useful,
 * but WITHOUT ANY WARRANTY; without even the implied warranty of
 * MERCHANTABILITY or FITNESS FOR A PARTICULAR PURPOSE.  See the
 * GNU General Public License for more details.
 */

/*-------------------------------------------------------------------------
 * This file is autogenerated file using gcdb parser. Please do not edit it.
 * Update input XML file to add a new entry or update variable in this file
 * VERSION = 1.1
 *-----------------------------------------------------------------------*/
&huawei_lcd_config {
	dsi_ang_191_207_6p57: lcd_kit_ang_191_207_6p57 {
		compatible = "191_207_6p57";
		lcd-kit,panel-name = "191_207 6.57' 1080 x 2340";
		lcd-kit,panel-type = <0x02>;
		lcd-kit,panel-xres = <1080>;
		lcd-kit,panel-yres = <2340>;
		lcd-kit,panel-width = <70>;
		lcd-kit,panel-height = <152>;
		lcd-kit,panel-enter-aod-cmds = <0x15 0x01 0x00 0x00 0x0a 0x00 0x02 0x2F 0x01
			0x15 0x01 0x00 0x00 0x02 0x01 0x02 0x26 0x01
			0x39 0x01 0x00 0x00 0x0a 0x00 0x06 0xF0 0x55 0xAA 0x52 0x08 0x00
			0x15 0x01 0x00 0x00 0x0a 0x00 0x02 0x6F 0x02
			0x15 0x01 0x00 0x00 0x0a 0x00 0x02 0xB5 0x16
			0x39 0x01 0x00 0x00 0x0a 0x00 0x03 0x51 0x00 0x00
			0x05 0x01 0x00 0x00 0x0a 0x00 0x01 0x39>;
		lcd-kit,panel-exit-aod-cmds = <0x39 0x01 0x00 0x00 0x0a 0x00 0x06 0xF0 0x55 0xAA 0x52 0x08 0x00
			0x15 0x01 0x00 0x00 0x0a 0x00 0x02 0x6F 0x02
			0x15 0x01 0x00 0x00 0x0a 0x00 0x02 0xB5 0x26
			0x39 0x01 0x00 0x00 0x0a 0x00 0x03 0x51 0x00 0x00
			0x05 0x01 0x00 0x00 0x0a 0x00 0x01 0x38>;
		lcd-kit,panel-aod-high-brightness-cmds = <0x39 0x01 0x00 0x00 0x0a 0x00 0x05 0x51 0x00 0x00 0x0E 0xFE>;
		lcd-kit,panel-aod-low-brightness-cmds = <0x39 0x01 0x00 0x00 0x0a 0x00 0x05 0x51 0x00 0x00 0x07 0x5F>;
		lcd-kit,panel-aod-middle-brightness-cmds = <0x39 0x01 0x00 0x00 0x0a 0x00 0x05 0x51 0x00 0x00 0x0B 0xFE>;
		lcd-kit,panel-aod-level1-bl-cmds = <0x39 0x01 0x00 0x00 0x0a 0x00 0x05 0x51 0x00 0x00 0x07 0x5F>;
		lcd-kit,panel-aod-level2-bl-cmds = <0x39 0x01 0x00 0x00 0x0a 0x00 0x05 0x51 0x00 0x00 0x0B 0xFE>;
		lcd-kit,panel-aod-level3-bl-cmds = <0x39 0x01 0x00 0x00 0x0a 0x00 0x05 0x51 0x00 0x00 0x0E 0xFE>;
		lcd-kit,panel-on-cmds = <0x39 0x01 0x00 0x00 0x0a 0x00 0x06 0xF0 0x55 0xAA 0x52 0x08 0x00
			0x39 0x01 0x00 0x00 0x0a 0x00 0x03 0xC0 0x66 0xF3
			0x15 0x01 0x00 0x00 0x0a 0x00 0x02 0xCA 0x12
			0x39 0x01 0x00 0x00 0x0a 0x00 0x05 0xBE 0x0E 0x09 0x14 0x13
			0x39 0x01 0x00 0x00 0x0a 0x00 0x06 0xF0 0x55 0xAA 0x52 0x08 0x01
			0x39 0x01 0x00 0x00 0x0a 0x00 0x03 0xCD 0x05 0x31
			0x39 0x01 0x00 0x00 0x0a 0x00 0x04 0xD1 0x07 0x02 0x18
			0x39 0x01 0x00 0x00 0x0a 0x00 0x04 0xD2 0x00 0x40 0x11
			0x39 0x01 0x00 0x00 0x0a 0x00 0x06 0xF0 0x55 0xAA 0x52 0x08 0x05
			0x39 0x01 0x00 0x00 0x0a 0x00 0x03 0xB5 0x85 0x81
			0x39 0x01 0x00 0x00 0x0a 0x00 0x05 0xB7 0x85 0x00 0x00 0x81
			0x39 0x01 0x00 0x00 0x0a 0x00 0x05 0xB8 0x05 0x00 0x00 0x81
			0x39 0x01 0x00 0x00 0x0a 0x00 0x06 0xF0 0x55 0xAA 0x52 0x08 0x07
			0x15 0x01 0x00 0x00 0x0a 0x00 0x02 0xC0 0x00
			0x15 0x01 0x00 0x00 0x0a 0x00 0x02 0x35 0x00
			0x15 0x01 0x00 0x00 0x0a 0x00 0x02 0x53 0x20
			0x15 0x01 0x00 0x00 0x0a 0x00 0x02 0x82 0xAC
			0x39 0x01 0x00 0x00 0x0a 0x00 0x05 0x2A 0x00 0x00 0x04 0x37
			0x39 0x01 0x00 0x00 0x0a 0x00 0x05 0x2B 0x00 0x00 0x09 0x23
			0x15 0x01 0x00 0x00 0x0a 0x00 0x02 0x03 0x01
			0x15 0x01 0x00 0x00 0x0a 0x00 0x02 0x90 0x01
			0x39 0x01 0x00 0x00 0x13 0x00 0x13 0x91 0x89 0x28 0x00 0x14 0xC2 0x00 0x03 0x1C 0x02 0x8C 0x00 0x0F 0x05 0x0E 0x02 0x8B 0x10 0xF0
			0x39 0x01 0x00 0x00 0x0a 0x00 0x03 0x44 0x09 0x14
			0x39 0x01 0x00 0x00 0x0a 0x00 0x06 0xF0 0x55 0xAA 0x52 0x08 0x00
			0x39 0x01 0x00 0x00 0x0a 0x00 0x03 0xBA 0x02 0x50
			0x15 0x01 0x00 0x00 0x0a 0x00 0x02 0x6F 0x08
			0x39 0x01 0x00 0x00 0x0a 0x00 0x03 0xBA 0x02 0x50
			0x05 0x01 0x00 0x00 0x46 0x01 0x01 0x11
			0x05 0x01 0x00 0x00 0x0a 0x00 0x01 0x29>;
		lcd-kit,panel-on-cmds-state = "dsi_lp_mode";
		lcd-kit,panel-off-cmds = <0x05 0x01 0x00 0x00 0x22 0x01 0x01 0x22
			0x05 0x01 0x00 0x00 0x0a 0x01 0x01 0x28
			0x05 0x01 0x00 0x00 0x78 0x01 0x01 0x10>;
		lcd-kit,panel-off-cmds-state = "dsi_lp_mode";
		lcd-kit,panel-aod-on-cmds-state = "dsi_lp_mode";
		lcd-kit,panel-aod-high-brightness-cmds-state = "dsi_lp_mode";
		lcd-kit,panel-aod-low-brightness-cmds-state = "dsi_lp_mode";
		lcd-kit,panel-aod-middle-brightness-cmds-state = "dsi_lp_mode";
		lcd-kit,panel-aod-off-cmds-state = "dsi_lp_mode";
		lcd-kit,backlight-cmds = <0x39 0x01 0x00 0x00 0x00 0x00 0x03 0x51 0x00 0x00>;
		lcd-kit,tp-color-cmds = <0x39 0x01 0x00 0x00 0x0a 0x00 0x06 0xF0 0x55 0xAA 0x52 0x08 0x01
			0x06 0x01 0x00 0x00 0x0a 0x00 0x01 0xBE>;
		lcd-kit,esd-reg-cmds = <0x06 0x01 0x00 0x00 0x0a 0x00 0x01 0x0a
			0x06 0x01 0x00 0x00 0x0a 0x00 0x01 0x0d
			0x39 0x01 0x00 0x00 0x0a 0x00 0x05 0xFF 0xAA 0x55 0xA5 0x81
			0x15 0x01 0x00 0x00 0x0a 0x00 0x02 0x6F 0x0F
			0x06 0x01 0x00 0x00 0x0a 0x00 0x01 0xFA>;
		lcd-kit,esd-reg-cmds-state = "dsi_lp_mode";
		lcd-kit,esd-value = <0x9c 0x00 0x00>;
		lcd-kit,check-reg-cmds = <0x06 0x01 0x00 0x00 0x0a 0x00 0x01 0x0a>;
		lcd-kit,pcd-check-reg-cmds = <0xcb>;
		lcd-kit,check-reg-cmds-state = "dsi_lp_mode";
		lcd-kit,check-reg-value = <0x9c>;
		lcd-kit,barcode-2d-cmds-state = "dsi_lp_mode";
		lcd-kit,pcd-check-reg-value = <0xcb>;
		lcd-kit,barcode-2d-cmds = <0x39 0x01 0x00 0x00 0x0a 0x00 0x06 0xF0 0x55 0xAA 0x52 0x08 0x01
			0x06 0x01 0x00 0x00 0x0a 0x00 0x08 0xD6 0x00 0x00 0x00 0x00 0x00 0x00 0x00
			0x06 0x01 0x00 0x00 0x0a 0x00 0x07 0xD7 0x00 0x00 0x00 0x00 0x00 0x00
			0x06 0x01 0x00 0x00 0x0a 0x00 0x06 0xBF 0x00 0x00 0x00 0x00 0x00>;
		lcd-kit,panel-bl-maxnit-command = <0x06 0x01 0x00 0x00 0x0a 0x00 0x01 0xdb>;
		lcd-kit,panel-bl-maxnit-command-state = "dsi_lp_mode";
		lcd-kit,lcd-btb-support = <0>;
		lcd-kit,lcd-btb-check-type = <0>;
		lcd-kit,lcd-btb-gpio = <73 76>;
		lcd-kit,dirty-region-cmds = <0x39 0x01 0x00 0x00 0x05 0x00 0x05 0x2A 0x00 0x00 0x04 0x37
				0x39 0x01 0x00 0x00 0x05 0x00 0x05 0x2B 0x00 0x00 0x09 0x23>;
		lcd-kit,fps-to-60-cmds = <0x15 0x01 0x00 0x00 0x0a 0x00 0x02 0x2F 0x01
			0x15 0x01 0x00 0x00 0x02 0x01 0x02 0x26 0x01>;
		lcd-kit,fps-to-high-60-cmds = <0x15 0x01 0x00 0x00 0x0a 0x00 0x02 0x2F 0x01
			0x15 0x01 0x00 0x00 0x0B 0x01 0x02 0x26 0x01>;
		lcd-kit,fps-to-90-cmds = <0x15 0x01 0x00 0x00 0x0a 0x00 0x02 0x2F 0x02>;
		lcd-kit,fps-to-60-cmds-state  = "dsi_lp_mode";
		lcd-kit,fps-to-high-60-cmds-state  = "dsi_hs_mode";
		lcd-kit,fps-to-90-cmds-state  = "dsi_lp_mode";
		lcd-kit,hbm-enter-cmds = <0x39 0x01 0x00 0x00 0x0a 0x00 0x03 0x51 0x0F 0xFF>;
		lcd-kit,fp-enter-extern-cmds = <0x39 0x01 0x00 0x00 0x0a 0x00 0x03 0x51 0x0F 0xFF>;
		lcd-kit,hbm-cmds = <0x39 0x01 0x00 0x00 0x0a 0x00 0x03 0x51 0x00 0x00>;
		lcd-kit,hbm-exit-cmds = <0x39 0x01 0x00 0x00 0x0a 0x00 0x03 0x51 0x00 0x00>;
		lcd-kit,hor-line-cmds = <0x39 0x01 0x00 0x00 0x0a 0x00 0x06 0xF0 0x55 0xAA 0x52 0x08 0x00
			0x15 0x01 0x00 0x00 0x0a 0x00 0x02 0x6F 0x06
			0x15 0x01 0x00 0x00 0x0a 0x00 0x02 0xB5 0x4E
			0x39 0x01 0x00 0x00 0x0a 0x00 0x06 0xF0 0x55 0xAA 0x52 0x08 0x01
			0x39 0x01 0x00 0x00 0x0a 0x00 0x03 0xB5 0x00 0x98
			0x39 0x01 0x00 0x00 0x0a 0x00 0x03 0xB6 0x01 0x60
			0x15 0x01 0x00 0x00 0x0a 0x00 0x02 0xCF 0x00
			0x39 0x01 0x00 0x00 0x0a 0x00 0x06 0xF0 0x55 0xAA 0x52 0x08 0x00
			0x15 0x01 0x00 0x00 0x0a 0x00 0x02 0xC5 0x01
			0x39 0x01 0x00 0x00 0x0a 0x00 0x06 0xF0 0x55 0xAA 0x52 0x08 0x05
			0x15 0x01 0x00 0x00 0x0a 0x00 0x02 0xEC 0x01
			0x39 0x01 0x00 0x00 0x0a 0x00 0x05 0x51 0x0F 0xFF 0x04 0xFF
			0x15 0x01 0x00 0x00 0x0a 0x00 0x02 0x53 0x20
			0x05 0x01 0x00 0x00 0x0a 0x00 0x01 0x35
			0x15 0x01 0x00 0x00 0x0a 0x00 0x02 0x2F 0x02
			0x39 0x01 0x00 0x00 0x0a 0x00 0x06 0xF0 0x55 0xAA 0x52 0x08 0x06
			0x39 0x01 0x00 0x00 0x0a 0x00 0x06 0xB0 0x31 0x31 0x13 0x13 0x12
			0x39 0x01 0x00 0x00 0x0a 0x00 0x06 0xB1 0x12 0x32 0x32 0x00 0x00
			0x39 0x01 0x00 0x00 0x0a 0x00 0x06 0xB2 0x0F 0x0F 0x0E 0x0E 0x32
			0x15 0x01 0x00 0x00 0x0a 0x00 0x02 0xB3 0x32
			0x39 0x01 0x00 0x00 0x0a 0x00 0x06 0xB6 0x31 0x31 0x13 0x13 0x12
			0x39 0x01 0x00 0x00 0x0a 0x00 0x06 0xB7 0x12 0x32 0x32 0x00 0x00
			0x39 0x01 0x00 0x00 0x0a 0x00 0x06 0xB8 0x0F 0x0F 0x0E 0x0E 0x32
			0x15 0x01 0x00 0x00 0x0a 0x00 0x02 0xB9 0x32
			0x39 0x01 0x00 0x00 0x0a 0x00 0x06 0xF0 0x55 0xAA 0x52 0x08 0x01
			0x39 0x01 0x00 0x00 0x0a 0x00 0x03 0xB0 0x0D 0x0D
			0x39 0x01 0x00 0x00 0x0a 0x00 0x03 0xB1 0x08 0x08
			0x39 0x01 0x00 0x00 0x0a 0x00 0x03 0xB3 0x25 0x25
			0x39 0x01 0x00 0x00 0x0a 0x00 0x07 0xB7 0x5A 0x5A 0x5A 0x5A 0x5A 0x5A
			0x39 0x01 0x00 0x00 0x0a 0x00 0x06 0xF0 0x55 0xAA 0x52 0x08 0x01
			0x39 0x01 0x00 0x00 0x0a 0x00 0x03 0xB4 0x25 0x25
			0x39 0x01 0x00 0x00 0x0a 0x00 0x05 0xB8 0x5F 0x5F 0x5F 0x5F
			0x05 0x01 0x00 0x00 0x0a 0x00 0x01 0x11>;
		lcd-kit,hor-line-cmds-state = "dsi_lp_mode";
		lcd-kit,start-pcd-check-cmds = <0x39 0x01 0x00 0x00 0x0a 0x00 0x06 0xF0 0x55 0xAA 0x52 0x08 0x01
			0x39 0x01 0x00 0x00 0x0a 0x00 0x05 0xD0 0x00 0x31 0x00 0x00>;
		lcd-kit,pcd-read-cmds = <0x39 0x01 0x00 0x00 0x0a 0x00 0x06 0xF0 0x55 0xAA 0x52 0x08 0x01
			0x15 0x01 0x00 0x00 0x0a 0x00 0x02 0x6F 0x02
			0x06 0x01 0x00 0x00 0x0a 0x00 0x01 0xD0>;
		lcd-kit,pcd-read-cmds-state  = "dsi_lp_mode";
		lcd-kit,vtc-line-cmds = <0x39 0x01 0x00 0x00 0x0a 0x00 0x06 0xF0 0x55 0xAA 0x52 0x08 0x00
			0x15 0x01 0x00 0x00 0x0a 0x00 0x02 0x6F 0x06
			0x15 0x01 0x00 0x00 0x0a 0x00 0x02 0xB5 0x4E
			0x39 0x01 0x00 0x00 0x0a 0x00 0x06 0xF0 0x55 0xAA 0x52 0x08 0x01
			0x39 0x01 0x00 0x00 0x0a 0x00 0x03 0xB5 0x00 0x98
			0x39 0x01 0x00 0x00 0x0a 0x00 0x03 0xB6 0x01 0x60
			0x15 0x01 0x00 0x00 0x0a 0x00 0x02 0xCF 0x00
			0x39 0x01 0x00 0x00 0x0a 0x00 0x06 0xF0 0x55 0xAA 0x52 0x08 0x00
			0x15 0x01 0x00 0x00 0x0a 0x00 0x02 0xC5 0x01
			0x39 0x01 0x00 0x00 0x0a 0x00 0x06 0xF0 0x55 0xAA 0x52 0x08 0x05
			0x15 0x01 0x00 0x00 0x0a 0x00 0x02 0xEC 0x01
			0x39 0x01 0x00 0x00 0x0a 0x00 0x05 0x51 0x0F 0xFF 0x04 0xFF
			0x15 0x01 0x00 0x00 0x0a 0x00 0x02 0x53 0x20
			0x05 0x01 0x00 0x00 0x0a 0x00 0x01 0x35
			0x15 0x01 0x00 0x00 0x0a 0x00 0x02 0x2F 0x01
			0x39 0x01 0x00 0x00 0x0a 0x00 0x06 0xF0 0x55 0xAA 0x52 0x08 0x06
			0x39 0x01 0x00 0x00 0x0a 0x00 0x06 0xB0 0x31 0x31 0x31 0x31 0x31
			0x39 0x01 0x00 0x00 0x0a 0x00 0x06 0xB1 0x31 0x32 0x32 0x00 0x00
			0x39 0x01 0x00 0x00 0x0a 0x00 0x06 0xB2 0x31 0x31 0x31 0x31 0x32
			0x15 0x01 0x00 0x00 0x0a 0x00 0x02 0xB3 0x32
			0x39 0x01 0x00 0x00 0x0a 0x00 0x06 0xB6 0x31 0x31 0x31 0x31 0x31
			0x39 0x01 0x00 0x00 0x0a 0x00 0x06 0xB7 0x31 0x32 0x32 0x00 0x00
			0x39 0x01 0x00 0x00 0x0a 0x00 0x06 0xB8 0x31 0x31 0x31 0x31 0x32
			0x15 0x01 0x00 0x00 0x0a 0x00 0x02 0xB9 0x32
			0x05 0x01 0x00 0x00 0xc8 0x01 0x01 0x11
			0x05 0x01 0x00 0x00 0x0a 0x00 0x01 0x29
			0x39 0x01 0x00 0x00 0x0a 0x00 0x06 0xF0 0x55 0xAA 0x52 0x08 0x02
			0x15 0x01 0x00 0x00 0x0a 0x00 0x02 0xBF 0x44
			0x39 0x01 0x00 0x00 0x0a 0x00 0x19 0xB0 0x0F 0xFF 0x0F 0xFF 0x0F 0xFF 0x0F 0xFF 0x0F 0xFF 0x0F 0xFF 0x0F 0xFF 0x0F 0xFF 0x0F 0xFF 0x0F 0xFF 0x0F 0xFF 0x0F 0xFF
			0x39 0x01 0x00 0x00 0x0a 0x00 0x19 0xB1 0x0F 0xFF 0x0F 0xFF 0x0F 0xFF 0x0F 0xFF 0x0F 0xFF 0x0F 0xFF 0x0F 0xFF 0x0F 0xFF 0x0F 0xFF 0x0F 0xFF 0x0F 0xFF 0x0F 0xFF
			0x39 0x01 0x00 0x00 0x0a 0x00 0x17 0xB2 0x0F 0xFF 0x0F 0xFF 0x0F 0xFF 0x0F 0xFF 0x0F 0xFF 0x0F 0xFF 0x0F 0xFF 0x0F 0xFF 0x0F 0xFF 0x0F 0xFF 0x0F 0xFF
			0x39 0x01 0x00 0x00 0x0a 0x00 0x19 0xB3 0x0F 0xFF 0x0F 0xFF 0x0F 0xFF 0x0F 0xFF 0x0F 0xFF 0x0F 0xFF 0x0F 0xFF 0x0F 0xFF 0x0F 0xFF 0x0F 0xFF 0x0F 0xFF 0x0F 0xFF
			0x39 0x01 0x00 0x00 0x0a 0x00 0x19 0xB4 0x0F 0xFF 0x0F 0xFF 0x0F 0xFF 0x0F 0xFF 0x0F 0xFF 0x0F 0xFF 0x0F 0xFF 0x0F 0xFF 0x0F 0xFF 0x0F 0xFF 0x0F 0xFF 0x0F 0xFF
			0x39 0x01 0x00 0x00 0x0a 0x00 0x17 0xB5 0x0F 0xFF 0x0F 0xFF 0x0F 0xFF 0x0F 0xFF 0x0F 0xFF 0x0F 0xFF 0x0F 0xFF 0x0F 0xFF 0x0F 0xFF 0x0F 0xFF 0x0F 0xFF
			0x39 0x01 0x00 0x00 0x0a 0x00 0x19 0xB6 0x0F 0xFF 0x0F 0xFF 0x0F 0xFF 0x0F 0xFF 0x0F 0xFF 0x0F 0xFF 0x0F 0xFF 0x0F 0xFF 0x0F 0xFF 0x0F 0xFF 0x0F 0xFF 0x0F 0xFF
			0x39 0x01 0x00 0x00 0x0a 0x00 0x19 0xB7 0x0F 0xFF 0x0F 0xFF 0x0F 0xFF 0x0F 0xFF 0x0F 0xFF 0x0F 0xFF 0x0F 0xFF 0x0F 0xFF 0x0F 0xFF 0x0F 0xFF 0x0F 0xFF 0x0F 0xFF
			0x39 0x01 0x00 0x00 0x0a 0x00 0x17 0xB8 0x0F 0xFF 0x0F 0xFF 0x0F 0xFF 0x0F 0xFF 0x0F 0xFF 0x0F 0xFF 0x0F 0xFF 0x0F 0xFF 0x0F 0xFF 0x0F 0xFF 0x0F 0xFF>;
		lcd-kit,vtc-line-cmds-state  = "dsi_lp_mode";
		lcd-kit,ddic-lv-det-enter1-cmds = <0x39 0x01 0x00 0x00 0x0a 0x00 0x06 0xF0 0x55 0xAA 0x52 0x08 0x01
			0x39 0x01 0x00 0x00 0x14 0x01 0x05 0xC7 0x68 0x24 0x30 0x0A>;
		lcd-kit,ddic-lv-det-enter1-cmds-state  = "dsi_lp_mode";
		lcd-kit,ddic-lv-det-enter2-cmds = <0x39 0x01 0x00 0x00 0x0a 0x00 0x06 0xF0 0x55 0xAA 0x52 0x08 0x01
			0x39 0x01 0x00 0x00 0x14 0x01 0x05 0xC7 0x68 0x24 0x30 0x0A>;
		lcd-kit,ddic-lv-det-enter2-cmds-state  = "dsi_lp_mode";
		lcd-kit,ddic-lv-det-enter3-cmds = <0x39 0x01 0x00 0x00 0x0a 0x00 0x06 0xF0 0x55 0xAA 0x52 0x08 0x01
			0x39 0x01 0x00 0x00 0x14 0x01 0x05 0xC7 0x68 0x24 0x30 0x0A>;
		lcd-kit,ddic-lv-det-enter3-cmds-state  = "dsi_lp_mode";
		lcd-kit,ddic-lv-det-enter4-cmds = <0x39 0x01 0x00 0x00 0x0a 0x00 0x06 0xF0 0x55 0xAA 0x52 0x08 0x01
			0x39 0x01 0x00 0x00 0x14 0x01 0x05 0xC7 0x68 0x24 0x30 0x0A>;
		lcd-kit,ddic-lv-det-enter4-cmds-state  = "dsi_lp_mode";
		lcd-kit,ddic-lv-det-rd1-cmds = <0x06 0x01 0x00 0x00 0x0a 0x00 0x01 0x0a>;
		lcd-kit,ddic-lv-det-rd1-cmds-state  = "dsi_lp_mode";
		lcd-kit,ddic-lv-det-rd2-cmds = <0x06 0x01 0x00 0x00 0x0a 0x00 0x01 0x0a>;
		lcd-kit,ddic-lv-det-rd2-cmds-state  = "dsi_lp_mode";
		lcd-kit,ddic-lv-det-rd3-cmds = <0x06 0x01 0x00 0x00 0x0a 0x00 0x01 0x0a>;
		lcd-kit,ddic-lv-det-rd3-cmds-state  = "dsi_lp_mode";
		lcd-kit,ddic-lv-det-rd4-cmds = <0x06 0x01 0x00 0x00 0x0a 0x00 0x01 0x0a>;
		lcd-kit,ddic-lv-det-rd4-cmds-state  = "dsi_lp_mode";
		lcd-kit,ddic-lv-det-value1 = <0x9c>;
		lcd-kit,ddic-lv-det-value2 = <0x9c>;
		lcd-kit,ddic-lv-det-value3 = <0x9c>;
		lcd-kit,ddic-lv-det-value4 = <0x9c>;
		lcd-kit,ap-aod-support = <1>;
		lcd-kit,hbm-support = <1>;
		lcd-kit,hbm-level-max = <1>;
		lcd-kit,vtc-line-support = <1>;
		lcd-kit,ddic-lv-det-support = <1>;
		lcd-kit,hor-line-support = <1>;
		lcd-kit,hor-line-duration = <600>;
		lcd-kit,panel-lcm-type = <2>;
		lcd-kit,panel-ldi-dsi-mode = <0>;
		lcd-kit,panel-dsi-switch-mode = <0>;
		lcd-kit,panel-dsi-switch-mode-en = <0>;
		lcd-kit,panel-ldi-trans-seq = <0>;
		lcd-kit,panel-ldi-data-padding = <0>;
		lcd-kit,panel-ldi-packet-size = <256>;
		lcd-kit,panel-ldi-ps = <2>;
		lcd-kit,panel-vfp-lp = <0>;
		lcd-kit,panel-fbk-div = <1>;
		lcd-kit,panel-orientation = <1>;
		lcd-kit,panel-bpp = <2>;
		lcd-kit,panel-bgr-fmt = <0>;
		lcd-kit,panel-cmd-type = <16>;
		lcd-kit,panel-pxl-clk = <0>;
		lcd-kit,panel-pxl-clk-div = <0>;
		lcd-kit,panel-data-rate = <356>;
		lcd-kit,mipi-lane-nums = <4>;
		lcd-kit,h-back-porch = <20>;
		lcd-kit,h-front-porch = <530>;
		lcd-kit,h-pulse-width = <20>;
		lcd-kit,project-id-support = <0>;
		lcd-kit,v-back-porch = <60>;
		lcd-kit,v-front-porch = <80>;
		lcd-kit,v-pulse-width = <40>;
		lcd-kit,mipi-clk-post-adjust = <0>;
		lcd-kit,mipi-lp11-flag = <0>;
		lcd-kit,esd-support = <1>;
		lcd-kit,skip-poweron-esd-check = <1>;
		lcd-kit,esd-recovery-bl-support = <1>;
		lcd-kit,tp-color-support = <1>;
		lcd-kit,vci-name = "VFP";
		lcd-kit,lcd-vci = <1 1 3100000>;
		lcd-kit,lcd-iovcc = <2 136 1800000>;
		lcd-kit,lcd-vdd = <2 91 1200000>;
		lcd-kit,lcd-vsp = <0 0 0>;
		lcd-kit,lcd-vsn = <0 0 0>;
		lcd-kit,lcd-reset = <2 86 0>;
		lcd-kit,power-on-stage = <2 1 2
				9 1 1
				1 1 12
				5 1 5
				5 2 1
				5 1 15
				7 1 0
				6 1 0
				8 1 0>;
		lcd-kit,lp-on-stage = <0 0 0>;
		lcd-kit,hs-on-stage = <0 0 0>;
		lcd-kit,hs-off-stage = <0 0 0>;
		lcd-kit,lp-off-stage = <0 0 0>;
		lcd-kit,power-off-stage = <7 0 0
				6 0 0
				8 0 0
				5 0 1
				1 0 1
				9 0 2
				2 0 1>;
		lcd-kit,pt-support = <1>;
		lcd-kit,panel-density = <320>;
		lcd-kit,ssc-disable = <1>;
		lcd-kit,inversion-support = <0>;
		lcd-kit,check-reg-support = <0>;
		lcd-kit,panel-bl-min = <24>;
		lcd-kit,panel-bl-max = <4095>;
		lcd-kit,panel-bl-max-nit = <1000>;
		lcd-kit,panel-bl-boot = <90>;
		lcd-kit,mipi-non-continue-enable = <1>;
		lcd-kit,panel-getblmaxnit-type = <1>;
		lcd-kit,panel-bl-ic-ctrl-type = <7>;
		lcd-kit,panel-bias-ic-ctrl-type = <0>;
		lcd-kit,oem-info-support = <1>;
		lcd-kit,oem-barcode-2d-support = <1>;
		lcd-kit,oem-barcode-2d-num-offset = <0>;
		lcd-kit,panel-on-always-reset = <1>;
		lcd-kit,panel-gpio-offset = <300>;
		lcd-kit,backlight-order = <0>;
		lcd-kit,fps-support = <1>;
		lcd-kit,fps-high-60-dsi-timming = <530 20 20 80 60 40 60 356 0 0>;
		lcd-kit,fps-90-dsi-timming = <530 20 20 80 60 40 90 570 0 32>;
		lcd-kit,panel-support-fps-list = <1 2>;
		lcd-kit,dsc-enable = <1>;
		lcd-kit,dsc-ver = <17>;
		lcd-kit,dsc-slice-mode = <0>;
		lcd-kit,dsc-rgb-swap = <0>;
		lcd-kit,dsc-cfg = <34>;
		lcd-kit,dsc-rct-on = <1>;
		lcd-kit,dsc-bit-per-channel = <8>;
		lcd-kit,dsc-line-buf-depth = <9>;
		lcd-kit,dsc-bp-enable = <1>;
		lcd-kit,dsc-bit-per-pixel = <128>;
		lcd-kit,dsc-pic-height = <2340>;
		lcd-kit,dsc-pic-width = <1080>;
		lcd-kit,dsc-slice-height = <20>;
		lcd-kit,dsc-slice-width = <1080>;
		lcd-kit,dsc-chunk-size = <1080>;
		lcd-kit,dsc-xmit-delay = <512>;
		lcd-kit,dsc-dec-delay = <796>;
		lcd-kit,dsc-scale-value = <32>;
		lcd-kit,dsc-increment-interval = <652>;
		lcd-kit,dsc-decrement-interval = <15>;
		lcd-kit,dsc-line-bpg-offset = <12>;
		lcd-kit,dsc-nfl-bpg-offset = <1294>;
		lcd-kit,dsc-slice-bpg-offset = <651>;
		lcd-kit,dsc-initial-offset = <6144>;
		lcd-kit,dsc-final-offset = <4336>;
		lcd-kit,dsc-flatness-minqp = <3>;
		lcd-kit,dsc-flatness-maxqp = <12>;
		lcd-kit,dsc-rc-model-size = <8192>;
		lcd-kit,dsc-rc-edge-factor = <6>;
		lcd-kit,dsc-rc-quant-incr-limit0 = <11>;
		lcd-kit,dsc-rc-quant-incr-limit1 = <11>;
		lcd-kit,dsc-rc-tgt-offset-hi = <3>;
		lcd-kit,dsc-rc-tgt-offset-lo = <3>;
		lcd-kit,vetical-refresh = <60>;
		lcd-kit,quickly-sleep-out-support = <0>;
		lcd-kit,quickly-sleep-out-interval = <0>;
		lcd-kit,mipi-hop-h-back-porch = <10>;
		lcd-kit,mipi-hop-h-front-porch = <32>;
		lcd-kit,mipi-hop-h-pulse-width = <10>;
		lcd-kit,mipi-hop-v-back-porch = <60>;
		lcd-kit,mipi-hop-v-front-porch = <14>;
		lcd-kit,mipi-hop-v-pulse-width = <30>;
		lcd-kit,mipi-hop-lp-v-front-porch = <14>;
		lcd-kit,Does-lcd-poweron-tp = <0>;
		lcd-kit,mipi-hop-support = <0>;
		lcd-kit,mipi-read-gerneric = <1>;
		lcd-kit,rgbw-support = <0>;
		lcd-kit,imax-lcd-luminance = <500>;
		lcd-kit,imin-lcd-luminance = <3>;
		lcd-kit,panel-blmaxnit-min-value = <400>;
		lcd-kit,hbm-en-times = <0>;
		lcd-kit,hbm-dis-times = <0>;
		lcd-kit,mtk-high-left-time-th-us = <5000>;
		lcd-kit,mtk-high-right-time-th-us = <9000>;
		lcd-kit,mtk-high-te-inerval-time-us = <11111>;
		lcd-kit,mtk-low-left-time-th-us = <9000>;
		lcd-kit,mtk-low-right-time-th-us = <15000>;
		lcd-kit,mtk-low-te-inerval-time-us = <16667>;
		lcd-kit,sn-code-support = <1>;
		lcd-kit,panel-round-corner-enable = <0>;
		lcd-kit,panel-round-corner-full-content = <0>;
		lcd-kit,panel-round-corner-h = <0>;
		lcd-kit,panel-round-corner-h-bot = <0>;
    };
};