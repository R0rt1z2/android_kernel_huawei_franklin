## arch/arm64/configs/k6889v1_64_debug_defconfig
```kconfig
CONFIG_CROSS_COMPILE="aarch64-linux-android-"
# CONFIG_LOCALVERSION_AUTO is not set
# CONFIG_FHANDLE is not set
CONFIG_LOG_BUF_SHIFT=20
CONFIG_UCLAMP_TASK=y
CONFIG_UCLAMP_GROUPS_COUNT=32
CONFIG_UCLAMP_MAP_OPP=y
CONFIG_NONLINEAR_FREQ_CTL=y
CONFIG_UCLAMP_TASK_GROUP=y
CONFIG_MAS_BLK=y
CONFIG_MAS_BUFFERED_READAHEAD=y
CONFIG_MAS_BLK_BW_OPTIMIZE=y
CONFIG_MAS_DEBUG_FS=y
CONFIG_MAS_BKOPS=y
CONFIG_MAS_MQ_USING_CP=y
CONFIG_MAS_ORDER_PRESERVE=y
CONFIG_MAS_UFS_MANUAL_BKOPS=y
CONFIG_MAS_SCSI_UFS_VCMD=y
CONFIG_MAS_BOOTDEVICE=y
CONFIG_MAS_UFSTT=y
CONFIG_FSCK_BOOST=y
CONFIG_CPUSETS=y
CONFIG_SCHED_TUNE=y
CONFIG_DEFAULT_USE_ENERGY_AWARE=y
CONFIG_HUAWEI_OEMINFO=y
CONFIG_OEMINFO_WP_FEATURE=y
# CONFIG_RD_BZIP2 is not set
# CONFIG_RD_LZMA is not set
# CONFIG_RD_XZ is not set
# CONFIG_RD_LZO is not set
# CONFIG_RD_LZ4 is not set
CONFIG_CRYPTO_LZ4K=y
CONFIG_LZ4K_COMPRESS=y
CONFIG_LZ4K_DECOMPRESS=y
CONFIG_SYSCTL_SYSCALL=y
# CONFIG_KALLSYMS_BASE_RELATIVE is not set
CONFIG_CC_STACKPROTECTOR_STRONG=y
CONFIG_MODULE_SRCVERSION_ALL=y
# CONFIG_BLK_DEV_BSG is not set
CONFIG_MACH_MT6885=y
CONFIG_SCHED_MC=y
CONFIG_NR_CPUS=8
CONFIG_PREEMPT=y
CONFIG_HYPERHOLD=y
CONFIG_HYPERHOLD_FILE_LRU=y
CONFIG_HYPERHOLD_ZSWAPD=y
CONFIG_HYPERHOLD_DEBUG=y
# CONFIG_BOUNCE is not set
CONFIG_ZSMALLOC=y
CONFIG_PROCESS_RECLAIM=y
CONFIG_HW_XRECLAIMER=y
CONFIG_ZS_MALLOC_EXT=y
CONFIG_RANDOMIZE_BASE=y
CONFIG_CMDLINE="console=tty0 console=ttyMT3,921600n1 root=/dev/ram vmalloc=496M slub_max_order=0 slub_debug=O "
# CONFIG_EFI is not set
CONFIG_BUILD_ARM64_APPENDED_DTB_IMAGE=y
CONFIG_BUILD_ARM64_DTB_OVERLAY_IMAGE=y
CONFIG_BUILD_ARM64_APPENDED_DTB_IMAGE_NAMES="mediatek/mt6885"
CONFIG_BUILD_ARM64_DTB_OVERLAY_IMAGE_NAMES="mediatek/k6889v1_64 mediatek/huawei_mt6885_ang_an00_va mediatek/huawei_mt6885_oce_an00_va mediatek/huawei_mt6885_yor_an10_va mediatek/huawei_mt6885_yor_an10_vb mediatek/huawei_mt6885_yor_an00_va mediatek/huawei_mt6885_mrr_z00_va mediatek/huawei_mt6885_mrr_z00_vb mediatek/huawei_mt6885_mrr_w09_va mediatek/huawei_mt6885_mrr_w19_va mediatek/huawei_mt6885_mrr_an19_va mediatek/huawei_mt6885_oce_an00_vb mediatek/huawei_mt6885_oce_an00_vc mediatek/huawei_mt6885_mrr_w00_vc mediatek/huawei_mt6885_mrr_z00_vd mediatek/huawei_mt6885_abr_nx9_va mediatek/huawei_mt6885_abr_an00_va mediatek/huawei_mt6885_abr_an00_vb mediatek/huawei_mt6885_abr_an00_vc"
# CONFIG_CORE_DUMP_DEFAULT_ELF_HEADERS is not set
CONFIG_COMPAT=y
CONFIG_PM_DEBUG=y
CONFIG_WQ_POWER_EFFICIENT_DEFAULT=y
CONFIG_CPU_FREQ=y
CONFIG_CPU_FREQ_STAT=y
CONFIG_CPU_FREQ_DEFAULT_GOV_PERFORMANCE=y
CONFIG_CPU_FREQ_GOV_POWERSAVE=y
CONFIG_CPU_FREQ_GOV_USERSPACE=y
CONFIG_CPU_FREQ_GOV_ONDEMAND=y
CONFIG_CPU_FREQ_GOV_SCHEDUTIL=y
CONFIG_XFRM_MIGRATE=y
CONFIG_SYN_COOKIES=y
CONFIG_BRIDGE=y
CONFIG_VLAN_8021Q=y
CONFIG_CLS_U32_PERF=y
CONFIG_CLS_U32_MARK=y
CONFIG_BT=y
CONFIG_CFG80211=y
CONFIG_NL80211_TESTMODE=y
CONFIG_CFG80211_DEVELOPER_WARNINGS=y
CONFIG_HW_WIFI=y
CONFIG_HW_WIFIPRO=y
CONFIG_HW_WIFIPRO_PROC=y
CONFIG_HW_DC_MODULE=y
# CONFIG_CFG80211_DEFAULT_PS is not set
CONFIG_CFG80211_DEBUGFS=y
CONFIG_CFG80211_INTERNAL_REGDB=y
CONFIG_MTK_NET_LOGGING=y
CONFIG_EXTRA_FIRMWARE="valhall-1691526.wa"
CONFIG_EXTRA_FIRMWARE_DIR="firmware"
CONFIG_HISI_NVE=y
#CONFIG_HISI_NVE_WHITELIST=y
CONFIG_MTD=y
CONFIG_MTD_BLOCK=y
CONFIG_TCP_AUTOTUNING=y
CONFIG_ZRAM=y
CONFIG_ZRAM_DEDUP=y
CONFIG_ZRAM_NON_COMPRESS=y
CONFIG_ZRAM_WRITEBACK=y
CONFIG_BUCKBOOST=y
CONFIG_BUCKBOOST_TPS63810=y
CONFIG_HYPERHOLD_CORE=y
CONFIG_HYPERHOLD_DEBUG_FS=y
CONFIG_BLK_DEV_LOOP=y
CONFIG_BLK_DEV_LOOP_MIN_COUNT=16
CONFIG_MEDIATEK_SOLUTION=y
CONFIG_MTK_PLATFORM="mt6885"
CONFIG_ARCH_MTK_PROJECT="k6889v1_64"
CONFIG_HW_SD_HEALTH_DETECT=y
CONFIG_MTK_ENG_BUILD=y
CONFIG_MTK_GPT_SCHEME_SUPPORT=y
CONFIG_MTK_PMIC_NEW_ARCH=y
CONFIG_MTK_PMIC_COMMON=y
CONFIG_MTK_PMIC_CHIP_MT6359P=y
CONFIG_MTK_EXTBUCK=y
CONFIG_REGULATOR_MT6691=y
CONFIG_MTK_EXTERNAL_CHARGER_TYPE_DETECT=y
CONFIG_MFD_MT6360_PMU=y
CONFIG_MT6360_PMU_CHARGER=y
CONFIG_MT6360_PMU_FLED=y
CONFIG_MT6360_PMIC=y
CONFIG_MT6360_LDO=y
CONFIG_MT6360_PMU_CHARGER_TYPE_DETECT=y
CONFIG_VBUS_CHANNEL=y
CONFIG_VBUS_CHANNEL_BOOST_GPIO=y
CONFIG_MTK_APUSYS_SUPPORT=y
CONFIG_MTK_APUSYS_DEBUG=y
CONFIG_MTK_APUSYS_RT_SUPPORT=y
CONFIG_MTK_APUSYS_MDLA_SUPPORT=y
CONFIG_MTK_APUSYS_EDMA_SUPPORT=y
CONFIG_MTK_APUSYS_VPU_DEBUG=y
CONFIG_MTK_CPU_FREQ=y
CONFIG_MTK_PTPOD=y
CONFIG_MTK_PTPOD_GPU=y
CONFIG_MTK_STATIC_POWER=y
CONFIG_MTK_UNIFY_POWER=y
CONFIG_MTK_SLBC_MMSRAM=y
CONFIG_MTK_CM_MGR=y
CONFIG_MTK_THERMAL_PA_VIA_ATCMD=y
CONFIG_MTK_SPMTWAM=y
CONFIG_CUSTOM_KERNEL_IMGSENSOR="ov48b2q_luxvisions hi846_ofilm gc2375_byd hi846_sunny ov8856_foxconn ov16a1q_ofilm s5k3p9_sunny ov02a10_sunwin"
CONFIG_CUSTOM_KERNEL_CAM_CAL_DRV="BRCB032GWZ_3 GT24c32a cat24c16"
CONFIG_MTK_CAMERA_ISP_RSC_SUPPORT=y
CONFIG_MTK_CAMERA_ISP_DPE_SUPPORT=y
CONFIG_MTK_CAMERA_ISP_TSF_SUPPORT=y
CONFIG_MTK_CAMERA_ISP_FD_SUPPORT=y
CONFIG_MTK_CAMERA_ISP_WPE_SUPPORT=y
CONFIG_MTK_CAMERA_ISP_OWE_SUPPORT=y
CONFIG_MTK_CAMERA_ISP_MFB_SUPPORT=y
CONFIG_MTK_CAM_CAL=y
CONFIG_MTK_CMDQ=y
CONFIG_MTK_CMDQ_MBOX_EXT=y
CONFIG_MTK_IMGSENSOR=y
CONFIG_HUAWEI_DSM_CAMERA=y
CONFIG_MTK_JPEG=y
CONFIG_MTK_SMI_EXT=y
CONFIG_CUSTOM_KERNEL_LCM="td4330_fhdp_dsi_cmd_auo_rt5081"
CONFIG_MTK_LCM_PHYSICAL_ROTATION="0"
CONFIG_LCM_HEIGHT="2280"
CONFIG_MTK_AAL_SUPPORT=y
CONFIG_MTK_HDR_VIDEO_SUPPORT=y
CONFIG_MTK_SCLTM_SUPPORT=y
CONFIG_MTK_PQ_COLOR_MODE="DISP"
CONFIG_MTK_DRE30_SUPPORT=y
CONFIG_MTK_CCU=y
CONFIG_HUAWEI_FINGERPRINT_SUPPORT=y
CONFIG_HUAWEI_SENSORS_AP=y
CONFIG_HUAWEI_HALL_INPUTHUB=y
CONFIG_SENSORS_COLOR_AP=y
CONFIG_MTK_SENSOR_ARCHITECTURE="2.0"
CONFIG_CUSTOM_KERNEL_ACCELEROMETER=y
CONFIG_MTK_ACCELHUB=y
CONFIG_CUSTOM_KERNEL_ALSPS=y
CONFIG_MTK_ALSPSHUB=y
CONFIG_CUSTOM_KERNEL_GYROSCOPE=y
CONFIG_MTK_GYROHUB=y
CONFIG_CUSTOM_KERNEL_MAGNETOMETER=y
CONFIG_MTK_MAGHUB=y
CONFIG_MTK_HWMON=y
CONFIG_MTK_LASER=y
# CONFIG_CUSTOM_KERNEL_BAROMETER is not set
CONFIG_MTK_BAROHUB=y
CONFIG_CUSTOM_KERNEL_SENSOR_FUSION=y
CONFIG_CUSTOM_KERNEL_GRV_SENSOR=y
CONFIG_CUSTOM_KERNEL_GMRV_SENSOR=y
CONFIG_CUSTOM_KERNEL_RV_SENSOR=y
# CONFIG_CUSTOM_KERNEL_LINEARACCEL_SENSOR is not set
# CONFIG_CUSTOM_KERNEL_GRAVITY_SENSOR is not set
CONFIG_CUSTOM_KERNEL_ORIENTATION_SENSOR=y
CONFIG_CUSTOM_KERNEL_UNCALI_ACC_SENSOR=y
CONFIG_CUSTOM_KERNEL_UNCALI_GYRO_SENSOR=y
# CONFIG_CUSTOM_KERNEL_UNCALI_MAG_SENSOR is not set
CONFIG_CUSTOM_KERNEL_STEP_COUNTER=y
CONFIG_MTK_STEPSIGNHUB=y
CONFIG_CUSTOM_KERNEL_SITUATION=y
CONFIG_MTK_STATHUB=y
CONFIG_MTK_WAKEHUB=y
CONFIG_MTK_GLGHUB=y
CONFIG_MTK_PICKUPHUB=y
CONFIG_MTK_DEVICE_ORIENTATION_HUB=y
CONFIG_MTK_MOTION_DETECT_HUB=y
CONFIG_MTK_TILTDETECTHUB=y
CONFIG_CUSTOM_KERNEL_SENSORHUB=y
CONFIG_NANOHUB=y
CONFIG_NANOHUB_MTK_IPI=y
CONFIG_MTK_COMBO=y
CONFIG_MTK_COMBO_CHIP_CONSYS_6885=y
CONFIG_MTK_COMBO_BT=y
CONFIG_MTK_COMBO_WIFI=y
CONFIG_HW_NETWORK_AWARE=y
CONFIG_HW_WIFI=y
CONFIG_HUAWEI_WIFI=y
CONFIG_HW_WIFIPRO=y
CONFIG_HW_WIFIPRO_PROC=y
CONFIG_HW_CHR_TCP_SMALL_WIN_MONITOR=y
CONFIG_CHR_NETLINK_MODULE=y
CONFIG_CHR_MTK_NETLINK=y
CONFIG_HW_WIFI_TEMP=y
CONFIG_MTK_DHCPV6C_WIFI=y
CONFIG_MTK_GPS_SUPPORT=y
CONFIG_MTK_FMRADIO=y
CONFIG_MTK_FM_CHIP="MT6635_FM"
CONFIG_MTK_CONNSYS_DEDICATED_LOG_PATH=y
CONFIG_MTK_MD1_SUPPORT=24
CONFIG_MTK_ECCCI_DRIVER=y
CONFIG_MTK_ECCCI_C2K=y
CONFIG_MTK_BTIF=y
CONFIG_MTK_SECURITY_SW_SUPPORT=y
CONFIG_MTK_ACCDET=y
CONFIG_ACCDET_EINT_IRQ=y
CONFIG_ACCDET_SUPPORT_EINT0=y
# CONFIG_MTK_M4U is not set
CONFIG_MTK_PSEUDO_M4U=y
CONFIG_MTK_LENS=y
CONFIG_MTK_FLASHLIGHT=y
CONFIG_MTK_FLASHLIGHT_MT6360=y
CONFIG_MTK_FLASHLIGHT_LM3642=y
CONFIG_MTK_FLASHLIGHT_AW3642=y
CONFIG_MTK_FLASHLIGHT_MP3331=y
CONFIG_MTK_FLASHLIGHT_SY7804=y
CONFIG_MTK_FLASHLIGHT_PT_STRICT=y
CONFIG_MTK_FLASHLIGHT_DLPT=y
CONFIG_MTK_TINYSYS_SCP_SUPPORT=y
CONFIG_MTK_LEDS=y
CONFIG_LEDS_MTK_DISP=y
CONFIG_LEDS_MTK_PWM=y
CONFIG_MTK_PWM=y
CONFIG_MTK_CHIP=y
CONFIG_MTK_IDLE_BALANCE_ENHANCEMENT=y
CONFIG_MTK_SCHED_EAS_POWER_SUPPORT=y
CONFIG_SCHED_HMP=y
CONFIG_SCHED_HMP_PLUS=y
CONFIG_MTK_SCHED_BOOST=y
CONFIG_MTK_SCHED_RQAVG_KS=y
CONFIG_MTK_SCHED_RQAVG_US=y
CONFIG_MTK_SCHED_CPULOAD=y
CONFIG_MTK_RT_THROTTLE_MON=y
# CONFIG_MTK_AURISYS_PHONE_CALL_SUPPORT is not set
CONFIG_MTK_AUDIODSP_SUPPORT=y
CONFIG_MTK_AURISYS_PHONE_CALL_SUPPORT=y
CONFIG_MTK_RAM_CONSOLE=y
CONFIG_MTK_AEE_FEATURE=y
CONFIG_MTK_SIB_USB_SWITCH=y
CONFIG_USB_MU3D_DRV_36BIT=y
CONFIG_MTK_RTC=y
CONFIG_MTK_USB_TYPEC_DP_MUX=y
CONFIG_TCPC_MT6360=y
# CONFIG_MTK_TYPEC_WATER_DETECT is not set
# CONFIG_MTK_TYPEC_WATER_DETECT_BY_PCB is not set
CONFIG_TCPC_CLASS=y
CONFIG_USB_POWER_DELIVERY=y
CONFIG_MTK_LOAD_TRACKER=y
CONFIG_MTK_CPU_CTRL_CFP=y
CONFIG_MTK_PERF_OBSERVER=y
CONFIG_MTK_RESYM=y
# CONFIG_MTK_FPSGO_V3=y
CONFIG_MTK_EARA_THERMAL=y
CONFIG_MTK_EARA_AI=y
CONFIG_MTK_PERF_TRACKER=y
CONFIG_MTK_LOWMEM_HINT=y
CONFIG_MTK_SKB_OWNER=y
# CONFIG_MTK_TASK_TURBO is not set
CONFIG_MTPROF=y
CONFIG_MTK_SCHED_MONITOR=y
CONFIG_MTK_WQ_DEBUG=y
CONFIG_MTK_IRQ_COUNT_TRACER=y
CONFIG_MTK_IRQ_OFF_TRACER=y
CONFIG_MTK_PREEMPT_TRACER=y
CONFIG_ANDROID_DEFAULT_SETTING=y
CONFIG_MTK_ANDROID_DEFAULT_SETTING=y
CONFIG_MTK_TIMER_TIMESYNC=y
CONFIG_MTK_FREQ_HOPPING=y
CONFIG_MTK_TINYSYS_SSPM_SUPPORT=y
CONFIG_MTK_GPU_SUPPORT=y
CONFIG_MTK_GPU_VERSION="mali valhall r21p0"
CONFIG_MTK_GPU_COMMON_DVFS_SUPPORT=y
CONFIG_MTK_GPU_SWPM_SUPPORT=y
CONFIG_MTK_VIBRATOR=y
CONFIG_HUAWEI_VIBRATOR=y
CONFIG_MTK_SYNC=y
CONFIG_MTK_VPU_SUPPORT=y
CONFIG_MTK_VPU_SUPPORT_DEBUG=y
CONFIG_MTK_DRAM_LOG_STORE=y
CONFIG_MTK_DRAM_LOG_STORE_ADDR=0x0011DF00
CONFIG_MTK_DRAM_LOG_STORE_SIZE=0x100
CONFIG_MTK_CACHE_CONTROL=y
CONFIG_MTK_TINYSYS_MCUPM_SUPPORT=y
CONFIG_MTK_HDMI_SUPPORT=y
CONFIG_HUAWEI_DP=y
CONFIG_DP_AUX_SWITCH=y
CONFIG_SCSI=y
CONFIG_BLK_DEV_SD=y
CONFIG_SCSI_SCAN_ASYNC=y
CONFIG_SCSI_UFSHCD=y
CONFIG_HUAWEI_UFS_DSM=y
CONFIG_SCSI_UFSHCD_PLATFORM=y
CONFIG_MTK_UFS_SUPPORT=y
CONFIG_UFSFEATURE=y
CONFIG_UFSHPB=y
CONFIG_UFSTW=y
CONFIG_UFSTW_IGNORE_GUARANTEE_BIT=y
CONFIG_SCSI_UFS_ENHANCED_INLINE_CRYPTO=y
CONFIG_SCSI_SKHPB=y
CONFIG_HUAWEI_SDCARD_DSM=y
CONFIG_HUAWEI_EMMC_DSM=y
CONFIG_MD=y
CONFIG_BLK_DEV_DM=y
CONFIG_DM_DEBUG=y
CONFIG_DM_CRYPT=y
CONFIG_DM_UEVENT=y
CONFIG_DM_VERITY=y
CONFIG_DM_VERITY_FEC=y
CONFIG_DM_VERITY_AVB=y
CONFIG_DM_SNAPSHOT=y
CONFIG_DM_HUAWEI_USE_OPT_PARAMETER=y
CONFIG_CGROUPS=y
CONFIG_BLK_CGROUP=y
CONFIG_BLK_DEV_THROTTLING=y
# CONFIG_BLK_CGROUP_IOSMART is not set
CONFIG_CGROUP_IOLIMIT=y
CONFIG_BLK_WBT=y
CONFIG_BLK_WBT_SQ=y
CONFIG_BLK_WBT_MQ=y
CONFIG_IFB=y
# CONFIG_ETHERNET is not set
CONFIG_PPP_FILTER=y
CONFIG_PPP_MULTILINK=y
CONFIG_PPPOE=y
CONFIG_PPP_ASYNC=y
CONFIG_PPP_SYNC_TTY=y
CONFIG_INPUT_EVDEV=y
# CONFIG_KEYBOARD_ATKBD is not set
CONFIG_KEYBOARD_MTK=y
CONFIG_HW_COMB_KEY=y
CONFIG_TWOKEY_REBOOT_NORMAL_MODE=y
CONFIG_KPD_PMIC_LPRST_TD=1
CONFIG_KPD_PWRKEY_USE_PMIC=y
# CONFIG_INPUT_MOUSE is not set
# CONFIG_INPUT_TOUCHSCREEN is not set
# CONFIG_TOUCHSCREEN_MTK_TOUCH is not set
CONFIG_HUAWEI_TS_KIT_3_0=y
CONFIG_HUAWEI_DEVKIT_MTK_3_0=y
CONFIG_HUAWEI_TP_KIT_COLOR_INFO_3_0=y
CONFIG_HUAWEI_THP=y
CONFIG_HUAWEI_THP_SYNAPTICS=y
CONFIG_HUAWEI_THP_GOODIX=y
CONFIG_HUAWEI_THP_MTK=y
CONFIG_HUAWEI_HOST_TS_KIT=y
CONFIG_HUAWEI_TS_KIT_COMMON_3_0=y
CONFIG_HUAWEI_TS_KIT_TEST_3_0=y
CONFIG_GOODIX_GTX8_TS_KIT=y
CONFIG_INPUT_MISC=y
CONFIG_INPUT_UINPUT=y
# CONFIG_SERIO is not set
# CONFIG_VT is not set
CONFIG_LEGACY_PTY_COUNT=16
# CONFIG_DEVMEM is not set
CONFIG_SERIAL_8250=y
CONFIG_SERIAL_8250_CONSOLE=y
CONFIG_SERIAL_8250_NR_UARTS=2
CONFIG_SERIAL_8250_RUNTIME_UARTS=2
CONFIG_SERIAL_8250_MT6577=y
CONFIG_I2C_MTK=y
CONFIG_SPI=y
CONFIG_SPI_MT65XX=y
CONFIG_SPMI=y
CONFIG_MTK_PMIF=y
CONFIG_MTK_GAUGE_VERSION=30
CONFIG_MTK_CHARGER=y
CONFIG_MTK_KERNEL_POWER_OFF_CHARGING=y
# CONFIG_HWMON is not set
CONFIG_THERMAL=y
CONFIG_THERMAL_DEFAULT_GOV_BACKWARD_COMPATIBLE=y
CONFIG_THERMAL_OF=y
CONFIG_THERMAL_WRITABLE_TRIPS=y
CONFIG_THERMAL_GOV_POWER_ALLOCATOR=y
CONFIG_CPU_THERMAL=y
CONFIG_DEVFREQ_THERMAL=y
#
# Huawei thermal drivers
#
CONFIG_HW_EXTERNAL_SENSOR=y
CONFIG_HW_IPA_THERMAL=y
CONFIG_HW_THERMAL_SPM=y
CONFIG_HW_THERMAL_SHELL=y
CONFIG_HW_SHELL_TEMP_DEBUG=y
CONFIG_HW_THERMAL_HOTPLUG=y
CONFIG_HW_THERMAL_GPU_HOTPLUG=n
CONFIG_THERMAL_EMULATION=y
CONFIG_HW_HOTPLUG_EMULATION=y
CONFIG_HW_GPU_HOTPLUG_EMULATION=n
CONFIG_WATCHDOG=y
CONFIG_MTK_WATCHDOG_COMMON=y
CONFIG_MTK_WATCHDOG_COMMON_V2=y
CONFIG_MFD_MT6358=y
CONFIG_MT6358_MISC=y
CONFIG_MTK_MFD_SPMI_PMIC=y
CONFIG_REGULATOR=y
CONFIG_REGULATOR_MT6315=y
CONFIG_REGULATOR_MT6359P=y
CONFIG_MEDIA_SUPPORT=y
CONFIG_MEDIA_CAMERA_SUPPORT=y
CONFIG_V4L_PLATFORM_DRIVERS=y
CONFIG_V4L_MEM2MEM_DRIVERS=y
CONFIG_VIDEO_MEDIATEK_JPEG=y
CONFIG_VIDEO_MEDIATEK_VCU_WO_FUSE=y
CONFIG_VIDEO_MEDIATEK_VCODEC=y
CONFIG_DRM=y
CONFIG_DRM_PANEL_TRULY_TD4330_CMD=y
CONFIG_DRM_MEDIATEK=y
CONFIG_FB_MODE_HELPERS=y
CONFIG_FB_TILEBLITTING=y
CONFIG_BACKLIGHT_LCD_SUPPORT=y
CONFIG_BACKLIGHT_CLASS_DEVICE=y
CONFIG_LOGO=y
CONFIG_SOUND=y
CONFIG_SND=y
CONFIG_SND_HRTIMER=y
CONFIG_SND_DYNAMIC_MINORS=y
CONFIG_SND_VERBOSE_PRINTK=y
CONFIG_SND_DEBUG=y
CONFIG_SND_DEBUG_VERBOSE=y
CONFIG_SND_PCM_XRUN_DEBUG=y
CONFIG_SND_SEQUENCER=y
CONFIG_SND_SEQ_DUMMY=y
# CONFIG_SND_SPI is not set
CONFIG_SND_USB_AUDIO=y
CONFIG_MTK_UAC_POWER_SAVING=y
CONFIG_SND_SOC=y
CONFIG_SND_SOC_MT6885_MT6359=y
CONFIG_SND_SOC_MTK_BTCVSD=y
CONFIG_SND_SOC_MTK_AUDIO_DSP=y
CONFIG_HIDRAW=y
CONFIG_UHID=y
CONFIG_HID_A4TECH=y
CONFIG_HID_APPLE=y
CONFIG_HID_BELKIN=y
CONFIG_HID_CHERRY=y
CONFIG_HID_CHICONY=y
CONFIG_HID_CYPRESS=y
CONFIG_HID_DRAGONRISE=y
CONFIG_HID_EZKEY=y
CONFIG_HID_KYE=y
CONFIG_HID_GYRATION=y
CONFIG_HID_TWINHAN=y
CONFIG_HID_KENSINGTON=y
CONFIG_HID_LOGITECH=y
CONFIG_HID_MAGICMOUSE=y
CONFIG_HID_MICROSOFT=y
CONFIG_HID_MONTEREY=y
CONFIG_HID_PANTHERLORD=y
CONFIG_HID_PETALYNX=y
CONFIG_HID_SAMSUNG=y
CONFIG_HID_SUNPLUS=y
CONFIG_HID_GREENASIA=y
CONFIG_HID_SMARTJOYPLUS=y
CONFIG_HID_TOPSEED=y
CONFIG_HID_THRUSTMASTER=y
CONFIG_HID_ZEROPLUS=y
CONFIG_HW_ROOT_SCAN=y
CONFIG_HW_ROOT_SCAN_ENG_DEBUG=y
CONFIG_HUAWEI_EIMA=y
CONFIG_HUAWEI_ENG_EIMA=y
CONFIG_HUAWEI_EIMA_ACCESS_CONTROL=y
CONFIG_HW_KERNEL_STP=y
CONFIG_HW_KERNEL_STP_ENG_DEBUG=y
CONFIG_HUAWEI_SOP=y
CONFIG_HUAWEI_SOP_ENG=y
CONFIG_USB=y
CONFIG_USB_XHCI_HCD=y
CONFIG_USB_XHCI_MTK_SUSPEND=y
CONFIG_USB_STORAGE=y
CONFIG_USB_STORAGE_DATAFAB=y
CONFIG_USB_STORAGE_FREECOM=y
CONFIG_USB_STORAGE_ISD200=y
CONFIG_USB_STORAGE_USBAT=y
CONFIG_USB_STORAGE_SDDR09=y
CONFIG_USB_STORAGE_SDDR55=y
CONFIG_USB_STORAGE_JUMPSHOT=y
CONFIG_USB_STORAGE_ALAUDA=y
CONFIG_USB_STORAGE_ONETOUCH=y
CONFIG_USB_STORAGE_KARMA=y
CONFIG_USB_STORAGE_CYPRESS_ATACB=y
CONFIG_USB_MTU3=y
CONFIG_USB_MTU3_PLAT_PHONE=y
CONFIG_USB_TRANCEVIBRATOR=y
CONFIG_NOP_USB_XCEIV=y
CONFIG_DUAL_ROLE_USB_INTF=y
CONFIG_USB_GADGET_VBUS_DRAW=500
CONFIG_USB_CONFIGFS_SERIAL=y
CONFIG_USB_CONFIGFS_ACM=y
CONFIG_USB_CONFIGFS_RNDIS=y
CONFIG_USB_CONFIGFS_MASS_STORAGE=y
CONFIG_USB_CONFIGFS_F_HID=y
CONFIG_USB_CONFIGFS_NCM=y
CONFIG_USB_F_NCM=y
CONFIG_USB_U_ETHER=y
CONFIG_MMC=y
CONFIG_MMC_BLOCK_MINORS=32
CONFIG_MMC_MTK_PRO=y
CONFIG_MTK_EMMC_SUPPORT=y
CONFIG_MTK_EMMC_CACHE=y
CONFIG_MTK_EMMC_SUPPORT_OTP=y
CONFIG_MTK_EMMC_HW_CQ=y
CONFIG_NEW_LEDS=y
CONFIG_LEDS_CLASS=y
CONFIG_LEDS_TRIGGERS=y
CONFIG_LEDS_TRIGGER_TIMER=y
# CONFIG_RTC_SYSTOHC is not set
CONFIG_RTC_DRV_MT6358=y
CONFIG_DMADEVICES=y
CONFIG_DMA_MTK_UART=y
CONFIG_SW_SYNC=y
CONFIG_ANDROID_INTF_ALARM_DEV=y
CONFIG_ION=y
CONFIG_MTK_ION=y
CONFIG_MAILBOX=y
CONFIG_MTK_CMDQ_MBOX=y
CONFIG_MTK_RPMSG_MBOX=y
CONFIG_MTK_IOMMU_V2=y
CONFIG_MTK_IOMMU_PGTABLE_EXT=34
CONFIG_RPMSG_MTK=y
CONFIG_MTK_PMIC_WRAP=y
CONFIG_MTK_IPI=y
CONFIG_MTK_MBOX=y
CONFIG_EXTCON_MTK_USB=y
CONFIG_IIO=y
CONFIG_IIO_BUFFER=y
CONFIG_IIO_KFIFO_BUF=y
CONFIG_MEDIATEK_MT6577_AUXADC=y
CONFIG_MT635X_AUXADC=y
CONFIG_PWM=y
CONFIG_PWM_MTK_DISP=y
CONFIG_PHY_MTK_USB=y
CONFIG_EXT4_DEBUG=y
CONFIG_EROFS_FS=y
CONFIG_EROFS_FS_XATTR=y
# CONFIG_EROFS_FS_POSIX_ACL is not set
CONFIG_EROFS_FS_SECURITY=y
CONFIG_EROFS_FS_USE_VM_MAP_RAM=y
# CONFIG_EROFS_FAULT_INJECTION is not set
CONFIG_EROFS_FS_ZIP=y
CONFIG_EROFS_FS_CLUSTER_PAGE_LIMIT=1
# CONFIG_EROFS_FS_ZIP_NO_CACHE is not set
# CONFIG_EROFS_FS_ZIP_CACHE_UNIPOLAR is not set
CONFIG_EROFS_FS_ZIP_CACHE_BIPOLAR=y
CONFIG_EROFS_FS_HUAWEI_EXTENSION=y
CONFIG_TEE_ANTIROOT_CLIENT=y
CONFIG_TEE_KERNEL_MEASUREMENT_API=y
CONFIG_TEE_ANTIROOT_CLIENT_ENG_DEBUG=y
CONFIG_HW_ROOT_SCAN_RODATA_MEASUREMENT_API=y
CONFIG_ITRUSTEE_TRUSTED_UI=y
CONFIG_QUOTA=y
CONFIG_QUOTA_NETLINK_INTERFACE=y
CONFIG_QFMT_V2=y
CONFIG_FUSE_FS=y
CONFIG_ISO9660_FS=y
CONFIG_JOLIET=y
CONFIG_ZISOFS=y
CONFIG_MSDOS_FS=y
CONFIG_VFAT_FS=y
CONFIG_TMPFS=y
CONFIG_SDCARD_FS=y
CONFIG_PSTORE=y
CONFIG_PSTORE_CONSOLE=y
CONFIG_PSTORE_PMSG=y
CONFIG_PSTORE_RAM=y
# HW waudio configuration
CONFIG_HW_WAUDIO_MODULE=y
# CONFIG_NETWORK_FILESYSTEMS is not set
CONFIG_NLS_CODEPAGE_437=y
CONFIG_NLS_CODEPAGE_950=y
CONFIG_NLS_ASCII=y
CONFIG_NLS_ISO8859_1=y
CONFIG_NLS_UTF8=y
CONFIG_PRINTK_TIME=y
CONFIG_DYNAMIC_DEBUG=y
CONFIG_DEBUG_INFO=y
CONFIG_FRAME_WARN=3600
CONFIG_PAGE_OWNER=y
CONFIG_DEBUG_SECTION_MISMATCH=y
CONFIG_SECTION_MISMATCH_WARN_ONLY=y
CONFIG_DEBUG_PAGEALLOC=y
CONFIG_DEBUG_PAGEALLOC_ENABLE_DEFAULT=y
CONFIG_SLUB_DEBUG_ON=n
CONFIG_SLUB_DEBUG=y
CONFIG_DEBUG_KMEMLEAK=y
CONFIG_DEBUG_KMEMLEAK_EARLY_LOG_SIZE=9600
CONFIG_DEBUG_KMEMLEAK_DEFAULT_OFF=y
CONFIG_DEBUG_VIRTUAL=y
CONFIG_PANIC_ON_OOPS=y
CONFIG_PANIC_TIMEOUT=5
CONFIG_SCHEDSTATS=y
CONFIG_SCHED_STACK_END_CHECK=y
CONFIG_PROVE_LOCKING=y
CONFIG_DEBUG_LOCKDEP=y
CONFIG_DEBUG_ATOMIC_SLEEP=y
CONFIG_RCU_CPU_STALL_TIMEOUT=60
CONFIG_RCU_TRACE=y
CONFIG_FAULT_INJECTION=y
CONFIG_MTK_SCHED_TRACERS=y
CONFIG_MTK_FTRACE_DEFAULT_ENABLE=y
CONFIG_DMA_API_DEBUG=y
CONFIG_BUG_ON_DATA_CORRUPTION=y
CONFIG_KGDB=y
CONFIG_KGDB_KDB=y
CONFIG_SECURITYFS=y
CONFIG_SECURITY_SELINUX_BOOTPARAM=y
CONFIG_HIE_DEBUG=y
CONFIG_CRYPTO_TWOFISH=y
# CONFIG_CRYPTO_HW is not set
CONFIG_CRC8=y
CONFIG_MMC_DW_MUX_SDSIM=y
CONFIG_MSDC_SDSIM_DIRECT_CONNECT=y
CONFIG_RFFE_ANTENNA=y
CONFIG_HUAWEI_HW_DEV_DCT=y
CONFIG_RUNMODE_TYPE_PARSE=y
CONFIG_ANTENNA_BOARDID_ADC_MATCH=y
CONFIG_ANTENNA_BOARDID_GPIO_DETECT=n
CONFIG_HUAWEI_DATA_ACQUISITION=y
CONFIG_LCD_KIT_MTK=y
CONFIG_LCD_KIT_DRIVER=y
CONFIG_MTK_ROUND_CORNER_SUPPORT=y
#config for huawei audio drivers
CONFIG_AUDIOKIT=y
CONFIG_HUAWEI_AUDIO=y
# CONFIG_MTK_AURISYS_PHONE_CALL_SUPPORT=y
CONFIG_HUAWEI_ADSP_MISC=y
CONFIG_ADSP_CHR=y
CONFIG_ADSP_HUAWEI_SHARED_MEM=y
CONFIG_HUAWEI_SMARTPAKIT_AUDIO=y
CONFIG_HUAWEI_DEVICEBOX_AUDIO=y
CONFIG_HUAWEI_DSM_AUDIO=y
CONFIG_HUAWEI_ANA_HS_KIT_AUDIO=y
CONFIG_ANA_HS=y
CONFIG_ANA_HS_CORE=y
CONFIG_ANA_HS_EXTERN_OPS=y
#config for huawei charge
CONFIG_HUAWEI_CHARGER=y
CONFIG_HW_BOOSTER=y
CONFIG_HW_PACKET_FILTER_BYPASS=y
CONFIG_HW_DPIMARK_MODULE=y
#config for iaware
CONFIG_HW_QOS_THREAD=y
CONFIG_HW_NETQOS_SCHED=y
CONFIG_HW_BINDER_FG_REQ_FIRST=y
CONFIG_HW_BINDER_SCHED=y
CONFIG_HUAWEI_BOOST_KILL=y
CONFIG_HW_VIP_THREAD=y
CONFIG_VIP_SCHED_OPT=n
CONFIG_HUAWEI_SCHED_VIP=y
CONFIG_DISABLE_VIP_FORK_MSG=y
CONFIG_HW_CPULOAD_NOTI=y
CONFIG_HUAWEI_SWAP_ZDATA=y
CONFIG_HUAWEI_DIRECT_SWAPPINESS=y
CONFIG_HUAWEI_PROC_MEMORYINFO_FAST=y
CONFIG_HUAWEI_RCC=y
CONFIG_TASK_DELAY_ACCT=y
CONFIG_HW_CGROUP_WORKINGSET=y
CONFIG_MEMCG_PROTECT_LRU=y
CONFIG_MEMCG_FINE_GRANULARITY_PROTECT_LRU=y
CONFIG_HUAWEI_QOS_BLKIO=y
CONFIG_HUAWEI_KSTATE=y
#config for huawei adapter protocol
CONFIG_ADAPTER_PROTOCOL=y
CONFIG_ADAPTER_PROTOCOL_FCP=y
CONFIG_ADAPTER_PROTOCOL_SCP=y
CONFIG_ADAPTER_PROTOCOL_PD=y
# for switch
CONFIG_USB_SWITCH=y
CONFIG_SWITCH_FSA9685=y
#config for secure function
CONFIG_CC_SECUREC=y
#config for huawei direct charge
CONFIG_DIRECT_CHARGER=y
CONFIG_F2FS_FS=n
CONFIG_HW_F2FS_FS=y
CONFIG_F2FS_FS_ENCRYPTION=y
CONFIG_F2FS_FS_SECURITY=y
CONFIG_F2FS_FS_XATTR=y
CONFIG_HUAWEI_F2FS_DSM=y
CONFIG_F2FS_CHECK_FS=y
CONFIG_F2FS_STAT_FS=y
CONFIG_F2FS_JOURNAL_APPEND=y
CONFIG_F2FS_GRADING_SSR=y
# for Access Control Module
CONFIG_ACM=y
CONFIG_ACM_DSM=y
CONFIG_HUAWEI_DSM=y
CONFIG_LOGGER_EXTEND=y
CONFIG_LOG_EXCEPTION=y
CONFIG_HW_LOGGER=y
CONFIG_HW_GADGET=y
CONFIG_HUAWEI_USB=y
#config for common_module
CONFIG_HUAWEI_POWER_EMBEDDED_ISOLATION=y
CONFIG_HUAWEI_POWER_DEVICES_INFO=y
CONFIG_HUAWEI_POWER_THERMALZONE=y
CONFIG_HUAWEI_POWER_DEBUG=y
# for fcp
CONFIG_FCP_CHARGER=y
# config for hardware ic
CONFIG_RT9466_CHARGER=y
CONFIG_RT9471_CHARGER=y
CONFIG_LOADSWITCH=y
CONFIG_RT9748=y
CONFIG_SWITCHCAP=y
CONFIG_BQ25970=y
CONFIG_RT9759=y
CONFIG_LTC7820=y
CONFIG_SCHARGER_V600=y
#config for hardwire monitor
CONFIG_HUAWEI_WATER_DETECT=y
CONFIG_HUAWEI_SOC_DECIMAL=y
CONFIG_HUAWEI_SOC_CONTROL=y
CONFIG_HUAWEI_SMPL=y
CONFIG_HUAWEI_VBUS_MONITOR=y
CONFIG_HUAWEI_LGA_CHECK=y
CONFIG_HUAWEI_BTB_CHECK=y
# CONFIG_HUAWEI_FFC_CONTROL is not set
#config for hardware channel
CONFIG_WIRED_CHANNEL_SWITCH=y
CONFIG_WIRED_CHANNEL_OVP_SWITCH=y
CONFIG_USB_HW_F_ACM=y
CONFIG_USB_CONFIGFS_HW_ACM=y
CONFIG_USB_MASS_STORAGE_SUPPORT_MAC=y
CONFIG_BOOST_5V=y
#config for wireless charge
CONFIG_WIRELESS_CHARGER=y
CONFIG_WIRELESS_PROTOCOL=y
CONFIG_WIRELESS_PROTOCOL_QI=y
CONFIG_WIRELESS_CPS4057=y
CONFIG_WIRELESS_STWLC88=y
CONFIG_WIRELESS_STWLC68=y
#config for charge_pump
CONFIG_CHARGE_PUMP=y
CONFIG_CHARGE_PUMP_HL1506=y
CONFIG_CHARGE_PUMP_PCA9488=y
CONFIG_CHARGE_PUMP_HL1512=y
# config for slowpath
CONFIG_HUAWEI_SLOW_PATH_COUNT=y
# config for monitor
CONFIG_LOGGER_EXTEND=y
CONFIG_LOG_EXCEPTION=y
CONFIG_HW_MEMORY_MONITOR=y
CONFIG_TASK_DELAY_ACCT=y
#config for huawei battery
CONFIG_HUAWEI_BATTERY_SOH=y
CONFIG_HUAWEI_POWER_PROXY=y
CONFIG_HUAWEI_POWER_SUPPLY=y
CONFIG_HUAWEI_BATTERY_CORE=y
CONFIG_HUAWEI_BATTERY_FAULT=y
CONFIG_HUAWEI_BATTERY_MODEL=y
CONFIG_HUAWEI_BATTERY_UI_CAPACTIY=y
CONFIG_HUAWEI_COUL=y
# config for page tracker
CONFIG_HW_PAGE_TRACKER=y
# config for huawei USB
CONFIG_HUAWEI_PD=y
CONFIG_HUAWEI_WATER_DETECT=y
#config for huawei pmic ic
CONFIG_HUAWEI_PMIC_RT5112=y
CONFIG_HUAWEI_PMIC_FAN53880=y
#config for huawei pagecache optimize
CONFIG_FILE_MAP=y
CONFIG_HUAWEI_PAGECACHE_HELPER=y
# config for lmk debug
CONFIG_HUAWEI_LMK_DBG=y
CONFIG_HW_LOWMEM_DBG=y
# config for DFR
CONFIG_HANDSET_SYSRQ_RESET=y
CONFIG_HUAWEI_DETECT_SR=y
CONFIG_HUAWEI_DETECT_SR_DEBUG=y
# config for DFT
CONFIG_HW_LOGGER=y
CONFIG_LOGGER_EXTEND=y
CONFIG_LOG_EXCEPTION=y
CONFIG_HWLOG_KERNEL=y
CONFIG_LOG_JANK=y
CONFIG_HUAWEI_STORAGE_ROFA=y
CONFIG_HUAWEI_STORAGE_ROCHK=y
CONFIG_HUAWEI_DYNAMIC_BRD=y
CONFIG_HUAWEI_STORAGE_ROW=y
CONFIG_HUAWEI_STORAGE_ROFA_FOR_MTK=y
# CONFIG_USE_BOOTFAIL_RECOVERY_SOLUTION is not set
CONFIG_BOOT_DETECTOR=y
# CONFIG_BOOT_DETECTOR_HISI is not set
# CONFIG_BOOT_DETECTOR_QCOM is not set
CONFIG_BOOT_DETECTOR_MTK=y
# CONFIG_BOOT_DETECTOR_HONGHU is not set
CONFIG_BOOT_RECOVERY=y
# CONFIG_BOOT_DETECTOR_DBG is not set
# config for ZeroHung
CONFIG_HW_ZEROHUNG=y
CONFIG_MTK_ZRHUNG_FEATURE=y
CONFIG_HW_FDLEAK=y
CONFIG_HW_DIE_CATCH=y
# config for HungTask
CONFIG_DETECT_HUNG_TASK=y
CONFIG_DETECT_HUAWEI_HUNG_TASK=y
CONFIG_DETECT_HUAWEI_MMAP_SEM=y
CONFIG_DETECT_HUAWEI_MMAP_SEM_DBG=y
CONFIG_DEFAULT_HUNG_TASK_TIMEOUT=120
CONFIG_BOOTPARAM_HUNG_TASK_PANIC=y
CONFIG_BOOTPARAM_HUNG_TASK_PANIC_VALUE=1
# config for binder proc
CONFIG_TRACE_CLOCK=y
CONFIG_BINDER_HUAWEI_TRANSACTION_BRIEF=y
# config for rphone
CONFIG_HUAWEI_KERNEL=y
CONFIG_HUAWEI_KERNEL_DEBUG=y
CONFIG_HUAWEI_DUBAI=y
CONFIG_HUAWEI_DUBAI_TASK_CPU_POWER=y
CONFIG_HUAWEI_DUBAI_BATTERY_STATS=y
CONFIG_HUAWEI_DUBAI_GPU_STATS=y
CONFIG_HUAWEI_DUBAI_DDR_STATS=y
CONFIG_HUAWEI_DUBAI_VCORE_STATS=y
CONFIG_CPU_FREQ_POWER_STAT=y
CONFIG_HUAWEI_FREQ_STATS_COUNTING_IDLE=y
CONFIG_HUAWEI_IDLE_NOTIFY=y
# config for dmd
CONFIG_HUAWEI_DSM=y
# config for storage_info
CONFIG_SCSI_UFS_HI1861_VCMD=y
CONFIG_HUAWEI_UFS_VENDOR_MODE=y
CONFIG_HUAWEI_DSM_IOMT_HOST=y
CONFIG_HUAWEI_DSM_IOMT_UFS_HOST=y
# config for huawei xhub_router
CONFIG_XHUB_ROUTER=y
CONFIG_MTK_ENABLE_GENIEZONE=y
CONFIG_HUAWEI_DRAM_FREQ_CONTROL=y
CONFIG_HUAWEI_PMU_SHARE=y
# config for NFC
CONFIG_MTK_NFC_CLKBUF_ENABLE=y
CONFIG_NFC_CHIP_NXP=y
CONFIG_NFC_CHIP_SUPPORT=y
# config for huawei universal inline encryption
CONFIG_HUAWEI_FBE=y
CONFIG_HUAWEI_FBE_DBG=y

CONFIG_ENCRYPTED_KEYS=y
CONFIG_CRYPTO_GCM=y
CONFIG_CRYPTO_GHASH=y

CONFIG_CRYPTO_SHA256_ARM64=y
CONFIG_CRYPTO_SHA512_ARM64=y
CONFIG_CRYPTO_SHA1_ARM64_CE=y
CONFIG_CRYPTO_GHASH_ARM64_CE=y
CONFIG_CRYPTO_CRC32_ARM64_CE=y
CONFIG_CRYPTO_AES_ARM64=y
CONFIG_CRYPTO_AES_ARM64_CE=y
CONFIG_CRYPTO_AES_ARM64_CE_CCM=y
CONFIG_CRYPTO_AES_ARM64_NEON_BLK=y

CONFIG_ECRYPT_FS=y
CONFIG_ECRYPT_FS_FILTER=y

# config for huawei blackbox
CONFIG_HUAWEI_BB_ECALL=y
CONFIG_CONTEXTHUB=y
CONFIG_CONTEXTHUB_UNIFIED_TRANSFER=y

#
# HISI FLP configuration
#
CONFIG_HUAWEI_SOFTTIMER=y
CONFIG_HUAWEI_FLP=y
CONFIG_HUAWEI_FLP_GEOFENCE=y
CONFIG_HUAWEI_FLP_CELLFENCE=y
CONFIG_HUAWEI_FLP_WIFIFENCE=y
# CONFIG_HUAWEI_FLP_BATCHING is not set
# CONFIG_HUAWEI_FLP_DIAG is not set
CONFIG_HUAWEI_AR=y
# CONFIG_CONTEXTHUB_UNIFORM_INTERVAL is not set

CONFIG_HUAWEI_EMCOM=y
CONFIG_TCP_ARGO is not set
CONFIG_HUAWEI_XENGINE=y
# CONFIG_HUAWEI_EMCOM_CHANNEL=y
CONFIG_HW_NETWORK_MEASUREMENT=y
CONFIG_HW_SMARTCARE_FI=y
CONFIG_HUAWEI_NWEVAL=y
# CONFIG_HUAWEI_OPMP=y
CONFIG_HW_EMCOM_NSTACK=y
CONFIG_HW_NSTACK_FI=y

#
# TEE OS
#
CONFIG_TZDRIVER=y
# CONFIG_HISI_SECBOOT_IMG is not set
# CONFIG_HISI_SECBOOT_IMG_V2 is not set
# CONFIG_ASAN_DEBUG is not set
CONFIG_CLIENT_AUTH=y
CONFIG_ANDROID_HIDL=y
CONFIG_SELINUX_ADAPT=y
CONFIG_AUTH_ENHANCE=y
CONFIG_CPU_AFF_NR=0
# CONFIG_DRM_ADAPT is not set
CONFIG_TEECD_AUTH=y
CONFIG_TEE_AUDIT=y
CONFIG_KERNEL_CLIENT=y
# CONFIG_BIG_SESSION is not set
CONFIG_DYNAMIC_ION=y
CONFIG_STATIC_ION=y
# CONFIG_RDR_MEM is not set
CONFIG_TEELOG=y
CONFIG_TEE_LOG_ACHIVE_PATH="/data/log/tee/last_teemsg"
CONFIG_TEE_KTRACE=y
# CONFIG_TEE_LOG_EXCEPTION is not set
CONFIG_TEE_TUI=y
CONFIG_TEE_TUI_MTK=y
CONFIG_TEE_TUI_FP=y
CONFIG_TA_AFFINITY=y
CONFIG_TA_AFFINITY_CPU_NUMS=8
CONFIG_RPMB_AGENT=y

# config for irda
CONFIG_MTK_IRTX_PWM_SUPPORT=y
# config for exfat
CONFIG_STAGING_EXFAT_FS=y
CONFIG_STAGING_EXFAT_DISCARD=y
# CONFIG_STAGING_EXFAT_DELAYED_SYNC is not set
CONFIG_STAGING_EXFAT_KERNEL_DEBUG=y
# CONFIG_STAGING_EXFAT_DEBUG_MSG is not set
CONFIG_STAGING_EXFAT_DEFAULT_CODEPAGE=437
CONFIG_STAGING_EXFAT_DEFAULT_IOCHARSET="utf8"
CONFIG_HW_SYN_LINEAR_RETRY=y
CONFIG_HUAWEI_MSS_AUTO_CHANGE=y
# fuel gauge
CONFIG_BQ27Z561_FUEL_GAUGE=y
CONFIG_RT9426_FUEL_GAUGE=y
CONFIG_FUEL_GAUGE=y
CONFIG_ARM_MEMLAT_MON=y
CONFIG_DEVFREQ_GOV_MEMLAT=y
CONFIG_DEVFREQ_DEVBW=y
# config for huawei universal inline encryption
CONFIG_FS_UNI_ENCRYPTION=y
CONFIG_HWDPS=y
CONFIG_FS_SDP_ENCRYPTION=y
#config for cifs
CONFIG_NETWORK_FILESYSTEMS=y
# CONFIG_NFS_FS is not set
# CONFIG_NFSD is not set
# CONFIG_CEPH_FS is not set
CONFIG_CIFS=y
# CONFIG_CIFS_STATS is not set
# CONFIG_CIFS_WEAK_PW_HASH is not set
# CONFIG_CIFS_UPCALL is not set
# CONFIG_CIFS_XATTR is not set
CONFIG_CIFS_DEBUG=y
# CONFIG_CIFS_DEBUG2 is not set
# CONFIG_CIFS_DEBUG_DUMP_KEYS is not set
# CONFIG_CIFS_DFS_UPCALL is not set
# CONFIG_CIFS_SMB311 is not set
# config for memory leak
CONFIG_HW_MEMCHECK=y
CONFIG_MEMORY_STATIC_FOOTPRINT=y
CONFIG_MM_PAGE_TRACE=y
CONFIG_MM_PAGE_TRACE_TEST=y
#
# Huawei Performace Control
#
CONFIG_SCHED_INFO=y
CONFIG_SCHED_WALT=y
CONFIG_PELT_UTIL_HALFLIFE_8=y
CONFIG_HW_TASK_RAVG_SUM=y
CONFIG_RENDER_RT=y
CONFIG_RENDER_RT_DEBUG=y
CONFIG_HUAWEI_PERF_CTRL=y
CONFIG_SCHED_PERF_CTRL=y
CONFIG_HW_SCHED_CLUSTER=y
CONFIG_HW_SCHED_CLUSTER_DEBUG=y
CONFIG_HW_CPU_FREQ=y
CONFIG_HW_CPU_FREQ_GOV_SCHEDUTIL=y
CONFIG_HW_CPUFREQ_GOVERNOR_BACKUP=y
CONFIG_HW_CPU_FREQ_LOCK_DETECT=n
CONFIG_HW_PPM_DVFS_LIMIT=y
CONFIG_HW_CPU_FREQ_GOV_SCHEDUTIL_COMMON=y
CONFIG_HW_SCHED_CHECK_IRQLOAD=y
#
# HUAWEI Related Thread Group
#
CONFIG_HW_RTG=y
CONFIG_HW_RTG_BOOST=y
CONFIG_HW_RTG_NORMALIZED_UTIL=y
CONFIG_HW_RTG_WALT=y
CONFIG_HW_RTG_CPU_TIME=n
CONFIG_HW_RTG_FRAME=y
CONFIG_HW_RTG_AUX=y
CONFIG_HW_RTG_FRAME_RME=y
CONFIG_HW_RTG_DEBUG=y
CONFIG_HW_RTG_TRACE=y
CONFIG_HW_RTG_UCLAMP_UTIL=y
CONFIG_HW_RTG_FRAME_USE_MIN_UTIL=n
CONFIG_HW_RT_CAS=y
CONFIG_HW_RT_ACTIVE_LB=y
CONFIG_HW_RTG_FRAME_USE_NORMALIZED_UTIL=y
CONFIG_HW_RTG_PERF_CTRL=y
# CONFIG_HW_RTG_PSEUDO_TICK=y
#
# HUAWEI Scheduler
#
CONFIG_HW_FREQ_STATS_COUNTING_IDLE=n
# config for huawei early detection task feature
CONFIG_HW_ED_TASK=y
# config for huawei top task task
CONFIG_HW_TOP_TASK=y
CONFIG_HW_TOP_TASK_SKIP_HISPEED_LOGIC=y
CONFIG_HW_SCHED_PRED_LOAD=y
# config for huawei cpu topology
CONFIG_ARCH_HW=y
# config for huawei eas
CONFIG_HW_EAS_SCHED=y
CONFIG_HW_MIGRATION_NOTIFY=y
CONFIG_HW_BOOT_BOOST=y
CONFIG_HW_GLOBAL_BOOST=y
CONFIG_HW_BOOST=y
CONFIG_HW_FORK_BOOST=y
CONFIG_HW_NEGATIVE_BOOST=y
CONFIG_HW_MULTI_MARGIN=y
CONFIG_HW_SPREAD_TASK=y
CONFIG_HW_FAVOR_SMALL_CAP=y
CONFIG_HW_EAS_TRACE=y
#config for walt
CONFIG_HW_SCHED_PRED_LOAD=y
# config for huawei perfhub
CONFIG_HW_PERFHUB=y
CONFIG_HW_PERFHUB_TRACE=y
CONFIG_MT6873_USCP_ADC=y
CONFIG_HUAWEI_USB_SHORT_CIRCUIT_PROTECT=y
CONFIG_HUAWEI_CPUIDLE_LP_MODE=y
CONFIG_HUAWEI_SCHED_STAT_YIELD=y
CONFIG_HUAWEI_DUBAI=y
CONFIG_GPU_AI_FENCE_INFO=y
CONFIG_MALI_HUAWEI_CL_BOOST=y
CONFIG_HW_GPU_CORE_HOTPLUG=n
CONFIG_DEBUG_FS=y
CONFIG_HUAWEI_HIDESYMS=y
CONFIG_HUAWEI_HIDESYMS_DEBUGFS=y
CONFIG_HUAWEI_FREELIST_RANDOM_DEBUGFS=y
CONFIG_SLAB_FREELIST_RANDOM=y
CONFIG_STRICT_KERNEL_RWX=y
CONFIG_HARDENED_USERCOPY=y
CONFIG_HUAWEI_KASLR_DEBUGFS=y
CONFIG_SECURITY_SELINUX_DEVELOP=y
CONFIG_SECURITY_SELINUX_TRACE_LOG=y
CONFIG_HW_KERNEL_STP=y
CONFIG_HW_KERNEL_STP_ENG_DEBUG=y
# config for check_root
CONFIG_HUAWEI_PROC_CHECK_ROOT=y
CONFIG_HKIP_ATKINFO=y
CONFIG_HKIP_ATKINFO_DEBUGFS=y
# config for usercopy
CONFIG_MTK_KERNEL_HARDEN_DEBUG=y
CONFIG_SYSTEM_DATA_VERIFICATION=y
CONFIG_MODULE_SIG=y
CONFIG_MODULE_SIG_FORCE=y
CONFIG_MODULE_SIG_ALL=y
# CONFIG_MODULE_SIG_SHA1 is not set
# CONFIG_MODULE_SIG_SHA224 is not set
# CONFIG_MODULE_SIG_SHA256 is not set
# CONFIG_MODULE_SIG_SHA384 is not set
CONFIG_MODULE_SIG_SHA512=y
CONFIG_MODULE_SIG_HASH="sha512"
CONFIG_MODULE_SIG_KEY="huawei_signing_key.pem"
CONFIG_PGO_CLANG=y
CONFIG_LTO=y
CONFIG_ARCH_SUPPORTS_LTO_CLANG=y
# CONFIG_LTO_NONE is not set
CONFIG_LTO_CLANG=y
CONFIG_CFI=y
CONFIG_CFI_CLANG=y
CONFIG_CFI_CLANG_SHADOW=y
CONFIG_HUAWEI_CFI_TAG=0x0035c000
CONFIG_HUAWEI_CFI_DEBUG=y
CONFIG_GPU_GMC_GENERIC=y
# CONFIG_CFI_PERMISSIVE is not set
CONFIG_SCHED_TASK_UTIL_CLAMP=y
CONFIG_HUAWEI_FREQ_LINK=y
# config for huawei secmem
CONFIG_HW_VLTMM=y
CONFIG_HW_SECMEM=y
CONFIG_HW_SECMEM_DEBUG=y
# config for huawei hkip
CONFIG_HUAWEI_HKIP=y
# CONFIG_HUAWEI_HKIP_TOKEN is not set
# CONFIG_HKIP_MODULE_ALLOC is not set
# CONFIG_HKIP_UEFI is not set
CONFIG_HKIP_USING_IPI=y
CONFIG_HUAWEI_HKIP_DEBUG=y
CONFIG_HKIP_PRMEM=y
# CONFIG_HKIP_PRMEM_BYPASS is not set
CONFIG_DEBUG_HKIP_PRMEM=y
CONFIG_HKIP_SELINUX_PROT=y
CONFIG_HKIP_SELINUX_POLDB_SIZE_MB=8
CONFIG_HKIP_EARLY_RODATA_PROTECTION=y
# CONFIG_UNMAP_KERNEL_AT_EL0 is not set
# CONFIG_ARM64_SW_TTBR0_PAN is not set
CONFIG_TLS=y
CONFIG_STREAM_PARSER=y
CONFIG_MPTCP=y
CONFIG_MPTCP_PM_ADVANCED=y
CONFIG_MPTCP_FULLMESH=y
# CONFIG_MPTCP_NDIFFPORTS is not set
# CONFIG_MPTCP_BINDER is not set
CONFIG_DEFAULT_FULLMESH=y
# CONFIG_DEFAULT_DUMMY is not set
CONFIG_DEFAULT_MPTCP_PM="fullmesh"
CONFIG_MPTCP_SCHED_ADVANCED=y
# CONFIG_MPTCP_ROUNDROBIN is not set
CONFIG_MPTCP_REDUNDANT=y
CONFIG_DEFAULT_SCHEDULER=y
# CONFIG_DEFAULT_REDUNDANT is not set
CONFIG_DEFAULT_MPTCP_SCHED="default"
CONFIG_MPTCP_HEARTBEAT=y
CONFIG_MPTCP_EPC=y
CONFIG_MEM_INSPECT=y
CONFIG_MEMORY_FAILURE=y
CONFIG_SM5450=y
CONFIG_SC8545=y
CONFIG_AW32280=y
CONFIG_HUAWEI_DDR_HIGH_FREQ_CONTROL=y
CONFIG_HUAWEI_DDR_PERF_CTRL=y
CONFIG_HUAWEI_THERMAL_PERF_CTRL=y
CONFIG_HW_NETWORK_QOE=y
CONFIG_STREAM_DETECT=y
CONFIG_HW_GET_EXT_SIG=y
CONFIG_HW_GET_EXT_SIG_ULDELAY=y
CONFIG_HUAWEI_RT_BLOCKED_REASON=y
CONFIG_SCHED_DEBUG_TRACE=y
CONFIG_MTK_VOW_SUPPORT=y
CONFIG_MTK_VOW_BARGE_IN_SUPPORT=y
CONFIG_MTK_VOW_DUAL_MIC_SUPPORT=y
# CONFIG_HW_RECLAIM_ACCT is not set
CONFIG_HUAWEI_FEATURE_PRINT_PID_NAME=y
CONFIG_HUAWEI_BASTET_MTK=y
CONFIG_HUAWEI_BATTERY_INFORMATION=y
CONFIG_HUAWEI_BATTCT_SLE95250=y
CONFIG_HUAWEI_BATTERY_TYPE_IDENTIFY=y
```
