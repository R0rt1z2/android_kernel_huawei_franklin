## drivers/cpufreq/Kconfig.huawei
```kconfig
config CPU_FREQ_POWER_STAT
	bool "Estimation of task power consumption"
	depends on CPU_FREQ_STAT
	select CPU_FREQ_TIMES
	default n
	help
	  Keep track of amount of power each task consumes and report power per uid

config HUAWEI_FREQ_STATS_COUNTING_IDLE
	bool "time in state seperate active and idle time"
	depends on CPU_FREQ_STAT && CPU_IDLE
	default n
	help
	  Account active and idle time in different frequencies.

config HUAWEI_FREQ_LINK
	bool "cpu and devices freq link switch"
	default n
	help
	  Cpu and dev freq link switch.
```

## drivers/cpufreq/hw/Kconfig.arm
```kconfig
config HW_CPU_FREQ
	bool "Huawei cpufreq optimize for huawei schedutil"
	default n
	help
	  This modifies the platform cpufreq driver to achieve
	  better performance with huawei schedutil.

config HW_CPU_FREQ_GOV_SCHEDUTIL
	bool "Huawei schedutil cpufreq governor optimize"
	depends on CPU_FREQ_GOV_SCHEDUTIL
	select HW_CPU_FREQ_GOV_SCHEDUTIL_COMMON
	select HW_CPU_FREQ
	default n
	help
	  This extends the functionality of existing schedutil governor.

config HW_CPU_FREQ_LOCK_DETECT
	bool "Huawei schedutil detect freq lock&unlock"
	depends on HW_CPU_FREQ_GOV_SCHEDUTIL
	default n
	help
	  This extends min_sample_time when boost scene finish.

config HW_PPM_DVFS_LIMIT
	bool "Offer dvfs_limit and dvfs_limit_enabled interfaces"
	depends on HW_CPU_FREQ
	default n
	help
	  This config is used to enhance mtk ppm and offer two interfaces.
	  ppm's dvfs limit can be read from dvfs_limit, and dvfs_limit_enabled
	  can be used to disable ppm to set dvfs limit to policy.

#
# CPUFREQ level
#
config HW_CPUFREQ_GOVERNOR_BACKUP
	bool "Huawei backup cpufreq governor tunables"
	depends on CPU_FREQ
	default n
	help
	  Huawei save and restore cpufreq governor tunables set by userspace.

config HW_FREQ_STATS_COUNTING_IDLE
	bool "time in state seperate active and idle time"
	depends on CPU_FREQ_STAT && CPU_IDLE
	default n
	help
	  Account active and idle time in different frequencies.
```

## drivers/cpuidle/Kconfig.huawei
```kconfig
config HUAWEI_IDLE_NOTIFY
	bool "CPU idle enter and exit notify"
	depends on CPU_IDLE
	default n

config HUAWEI_CPUIDLE_LP_MODE
	bool "Support C-state reselect with lowpower mode"
	depends on CPU_IDLE
	default n
	help
	  Allows the cpuidle C-state reselect with lowpower mode.
	  If unsure say N.
```

## drivers/huawei_platform/Kconfig
```kconfig
#=============================================================================
#  add new config for devices check
#  add new config for factory cmdline parse
#  add new config for antenna board gpio match
#=============================================================================

menu "Huawei Platform Drivers"
source "drivers/huawei_platform/hw_kstate/Kconfig"
source "drivers/huawei_platform/antenna_board_gpio_match/Kconfig"
source "drivers/huawei_platform/antenna_board_adc_match/Kconfig"
source "drivers/huawei_platform/audio/Kconfig"
source "drivers/huawei_platform/sensors/Kconfig"
source "drivers/huawei_platform/antenna_cable/Kconfig"
source "drivers/huawei_platform/net/Kconfig"

source "drivers/huawei_platform/sensor/Kconfig"
source "drivers/huawei_platform/ioinfo/Kconfig"
source "drivers/huawei_platform/power/Kconfig"
source "drivers/huawei_platform/hwpower/Kconfig"
source "drivers/huawei_platform/pmeminfo/Kconfig"
source "drivers/huawei_platform/card_tray/Kconfig"
source "drivers/huawei_platform/virt_to_phys/Kconfig"
source "drivers/huawei_platform/sensor2_0/Kconfig"
source "drivers/huawei_platform/comb_key/Kconfig"
source "drivers/huawei_platform/dp/Kconfig"
source "drivers/huawei_platform/sensor_ap/Kconfig"
source "drivers/huawei_platform/usb/Kconfig"
source "drivers/huawei_platform/hwdps/Kconfig"
source "drivers/huawei_platform/scsi/ufs/Kconfig"
source "drivers/huawei_platform/vibrator/Kconfig"
source "drivers/huawei_platform/rmeminspect/Kconfig"
source "drivers/huawei_platform/popup/Kconfig"
endmenu
```

## drivers/huawei_platform/antenna_board_adc_match/Kconfig
```kconfig
config ANTENNA_BOARDID_ADC_MATCH
    bool "antenna boardid adc match support"
    default n
```

## drivers/huawei_platform/antenna_board_gpio_match/Kconfig
```kconfig
#
# antenna boardid gpio detect
#


config ANTENNA_BOARDID_GPIO_DETECT
    bool "antenna boardid gpio detect support"
    default n
```

## drivers/huawei_platform/antenna_cable/Kconfig
```kconfig
config RFFE_ANTENNA
	bool "support antenna cable state check function"
	default n
```

## drivers/huawei_platform/audio/Kconfig
```kconfig
menu "Audio configuration"
config HUAWEI_AUDIO
        bool "Audio support"
        default n
        select REGMAP_I2C
        help
          Enable support for audio
if HUAWEI_AUDIO
source "drivers/huawei_platform/audio/aw882xx/Kconfig"
source "drivers/huawei_platform/audio/fs18xx/Kconfig"
source "drivers/huawei_platform/audio/tfa98xx/Kconfig"
source "drivers/huawei_platform/audio/cs35lxx/Kconfig"
source "drivers/huawei_platform/audio/cs35axx/Kconfig"
source "drivers/huawei_platform/audio/hs_auto_calib/Kconfig"
source "drivers/huawei_platform/audio/extern_adc/Kconfig"
source "drivers/huawei_platform/audio/ana_hs_extern_ops/Kconfig"
source "drivers/huawei_platform/audio/adsp_chr/Kconfig"
endif # if HUAWEI_AUDIO
endmenu
```

## drivers/huawei_platform/audio/adsp_chr/Kconfig
```kconfig
#
# adsp_chr report configuration
#

config ADSP_CHR
    tristate "adsp_chr"
    default n
    help
      add this to support adsp_chr
```

## drivers/huawei_platform/audio/cs35axx/Kconfig
```kconfig
#
# Misc strange devices
#
config CS35AXX
	tristate "Cirrus Logic C35AXX Amplifier misc i2c driver"
	depends on I2C
	select  SND_SOC_CS35AXX
	select  REGMAP_I2C
```

## drivers/huawei_platform/audio/cs35lxx/Kconfig
```kconfig
#
# Misc strange devices
#
config CS35LXX
	bool "Cirrus CS35LXX smartpa misc driver"
    default n
```

## drivers/huawei_platform/audio/extern_adc/Kconfig
```kconfig
config HUAWEI_EXTERN_ADC
	tristate "extern adc driver"
	default n
	help
		Say Y to enable extern adc driver support
```

## drivers/huawei_platform/audio/tfa98xx/Kconfig
```kconfig
#
# Misc strange devices
#
config TFA98XX
	bool "Goodix TFA98XX smartpa misc driver"
    default n
```

## drivers/huawei_platform/comb_key/Kconfig
```kconfig
#
# comb key info
#

menuconfig HW_COMB_KEY
    bool "Comb key info"
    default n
    help
      Say yes if you want device detect driver.
      This is for device connected version. If unsure, say N here.
```

## drivers/huawei_platform/dp/Kconfig
```kconfig
config DP_AUX_SWITCH
        bool "huawei DP_AUX_SWITCH"
        default n
        help
          If you say yes here you get support for huawei DP AUX switch check.

config HUAWEI_DP
        bool "HUAWEI_DP"
        default n
        help
          If you say yes here you get support for huawei DP AUX switch check.
```

## drivers/huawei_platform/hwdps/Kconfig
```kconfig
config hwdps
	bool "hwdps System"
	default n
	help
	Huawei Application Authentication System
```

## drivers/huawei_platform/hwpower/proxy/Kconfig
```kconfig
config HUAWEI_POWER_PROXY
	bool "huawei power proxy"
	default n
	help
	  Say Y here to enable power proxy driver.
	  This driver provides interfaces to get battery operation
	  information for platform charger when using tripartite coulometer.
```

## drivers/huawei_platform/net/Kconfig
```kconfig
source "drivers/huawei_platform/net/bastet/Kconfig"
source "drivers/huawei_platform/net/ipv4/Kconfig"
```

## drivers/huawei_platform/net/ipv4/Kconfig
```kconfig
config HUAWEI_MSS_AUTO_CHANGE
        bool "Huawei MSS auto change function support"
        default n
```

## drivers/huawei_platform/pmeminfo/Kconfig
```kconfig
menu "Huawei memory info dump"

config HUAWEI_MEMINFO_DUMP
	bool "Memory info dump for TopN"
	default n
	help
	   Dump process info and memory info for TopN

endmenu
```
